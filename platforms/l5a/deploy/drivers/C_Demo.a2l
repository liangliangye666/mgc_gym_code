ASAP2_VERSION 1 71
/begin PROJECT Demo ""
/begin HEADER "" VERSION "1.0" /end HEADER
/begin MODULE Demo ""
/include "XCP_104.aml"
/begin MOD_COMMON "" BYTE_ORDER MSB_LAST ALIGNMENT_BYTE 1 ALIGNMENT_WORD 1 ALIGNMENT_LONG 1 ALIGNMENT_FLOAT16_IEEE 1 ALIGNMENT_FLOAT32_IEEE 1 ALIGNMENT_FLOAT64_IEEE 1 ALIGNMENT_INT64 1 /end MOD_COMMON
/begin RECORD_LAYOUT R_FLOAT64_IEEE FNC_VALUES 1 FLOAT64_IEEE ROW_DIR DIRECT /end RECORD_LAYOUT
/begin RECORD_LAYOUT R_FLOAT32_IEEE FNC_VALUES 1 FLOAT32_IEEE ROW_DIR DIRECT /end RECORD_LAYOUT
/begin RECORD_LAYOUT R_A_INT64 FNC_VALUES 1 A_INT64 ROW_DIR DIRECT /end RECORD_LAYOUT
/begin RECORD_LAYOUT R_SLONG FNC_VALUES 1 SLONG ROW_DIR DIRECT /end RECORD_LAYOUT
/begin RECORD_LAYOUT R_SBYTE FNC_VALUES 1 SBYTE ROW_DIR DIRECT /end RECORD_LAYOUT
/begin MOD_PAR "" EPK "Oct 22 2025 10:26:29" ADDR_EPK 0x0006F780
 /begin MEMORY_SEGMENT CALRAM "" DATA FLASH INTERN 0x0006F780 0x000000B0 -1 -1 -1 -1 -1
  /begin IF_DATA XCP
   /begin SEGMENT 0x01 0x02 0x00 0x00 0x00 /begin CHECKSUM XCP_ADD_44 MAX_BLOCK_SIZE 0xFFFF EXTERNAL_FUNCTION "" /end CHECKSUM
    /begin PAGE 0x01 ECU_ACCESS_WITH_XCP_ONLY XCP_READ_ACCESS_WITH_ECU_ONLY XCP_WRITE_ACCESS_NOT_ALLOWED /end PAGE
    /begin PAGE 0x00 ECU_ACCESS_WITH_XCP_ONLY XCP_READ_ACCESS_WITH_ECU_ONLY XCP_WRITE_ACCESS_WITH_ECU_ONLY /end PAGE
   /end SEGMENT
  /end IF_DATA
 /end MEMORY_SEGMENT
/end MOD_PAR
/begin CHARACTERISTIC ecuPar.ampl "Amplitude" VALUE 0x6F7C0 R_FLOAT64_IEEE 0 NO_COMPU_METHOD 0 800 PHYS_UNIT "V" /end CHARACTERISTIC
/begin CHARACTERISTIC ecuPar.offset "RefOffset" VALUE 0x6F7B0 R_FLOAT64_IEEE 0 NO_COMPU_METHOD -200 200 PHYS_UNIT "V" /end CHARACTERISTIC
/begin CHARACTERISTIC ecuPar.phase "Phase" VALUE 0x6F7B8 R_FLOAT64_IEEE 0 NO_COMPU_METHOD 0 6.28319 PHYS_UNIT "" /end CHARACTERISTIC
/begin CHARACTERISTIC ecuPar.period "Period in s" VALUE 0x6F7A8 R_FLOAT64_IEEE 0 NO_COMPU_METHOD 0 10 PHYS_UNIT "s" /end CHARACTERISTIC
/begin CHARACTERISTIC ecuPar.cycleTimeUs "ECU task cycle time in us" VALUE 0x6F7A0 R_SLONG 0 NO_COMPU_METHOD 50 1e+08 PHYS_UNIT "us" /end CHARACTERISTIC
/begin CHARACTERISTIC ecuPar.map1_8_8 "8*8 byte calibration array" MAP 0x6F7C8 R_SBYTE 0 NO_COMPU_METHOD -128 127
 /begin AXIS_DESCR FIX_AXIS NO_INPUT_QUANTITY NO_COMPU_METHOD 8 0 7 FIX_AXIS_PAR_DIST 0 1 8 /end AXIS_DESCR
 /begin AXIS_DESCR FIX_AXIS NO_INPUT_QUANTITY NO_COMPU_METHOD 8 0 7 FIX_AXIS_PAR_DIST 0 1 8 /end AXIS_DESCR
 PHYS_UNIT "" /end CHARACTERISTIC
/begin CHARACTERISTIC ecuPar.curve1_32 "32 byte calibration array" CURVE 0x6F808 R_SBYTE 0 NO_COMPU_METHOD -128 127
 /begin AXIS_DESCR FIX_AXIS NO_INPUT_QUANTITY NO_COMPU_METHOD 32 0 31 FIX_AXIS_PAR_DIST 0 1 32 /end AXIS_DESCR
 PHYS_UNIT "" /end CHARACTERISTIC
/begin GROUP Parameters ""
 /begin REF_CHARACTERISTIC ecuPar.cycleTimeUs ecuPar.map1_8_8 ecuPar.curve1_32 ecuPar.period ecuPar.ampl ecuPar.phase ecuPar.offset ledSwitch /end REF_CHARACTERISTIC
/end GROUP
/begin CHARACTERISTIC pid_para.PID_balance_P "PID_balance_P" VALUE 0x72708 R_FLOAT64_IEEE 0 NO_COMPU_METHOD -1e+08 1e+08 PHYS_UNIT "" /end CHARACTERISTIC
/begin CHARACTERISTIC pid_para.PID_balance_I "PID_balance_I" VALUE 0x72710 R_FLOAT64_IEEE 0 NO_COMPU_METHOD -1e+08 1e+08 PHYS_UNIT "" /end CHARACTERISTIC
/begin CHARACTERISTIC pid_para.PID_balance_D "PID_balance_D" VALUE 0x72718 R_FLOAT64_IEEE 0 NO_COMPU_METHOD -1e+08 1e+08 PHYS_UNIT "" /end CHARACTERISTIC
/begin CHARACTERISTIC pid_para.PID_drive_P "PID_drive_P" VALUE 0x72720 R_FLOAT64_IEEE 0 NO_COMPU_METHOD -1e+08 1e+08 PHYS_UNIT "" /end CHARACTERISTIC
/begin CHARACTERISTIC pid_para.PID_drive_I "PID_drive_I" VALUE 0x72728 R_FLOAT64_IEEE 0 NO_COMPU_METHOD -1e+08 1e+08 PHYS_UNIT "" /end CHARACTERISTIC
/begin CHARACTERISTIC pid_para.PID_drive_D "PID_drive_D" VALUE 0x72730 R_FLOAT64_IEEE 0 NO_COMPU_METHOD -1e+08 1e+08 PHYS_UNIT "" /end CHARACTERISTIC
/begin CHARACTERISTIC pid_para.PID_steer_P "PID_steer_P" VALUE 0x72738 R_FLOAT64_IEEE 0 NO_COMPU_METHOD -1e+08 1e+08 PHYS_UNIT "" /end CHARACTERISTIC
/begin CHARACTERISTIC pid_para.PID_steer_I "PID_steer_I" VALUE 0x72740 R_FLOAT64_IEEE 0 NO_COMPU_METHOD -1e+08 1e+08 PHYS_UNIT "" /end CHARACTERISTIC
/begin CHARACTERISTIC pid_para.PID_steer_D "PID_steer_D" VALUE 0x72748 R_FLOAT64_IEEE 0 NO_COMPU_METHOD -1e+08 1e+08 PHYS_UNIT "" /end CHARACTERISTIC
/begin CHARACTERISTIC pid_para.PID_roll_P "PID_roll_P" VALUE 0x72750 R_FLOAT64_IEEE 0 NO_COMPU_METHOD -1e+08 1e+08 PHYS_UNIT "" /end CHARACTERISTIC
/begin CHARACTERISTIC pid_para.PID_roll_I "PID_roll_I" VALUE 0x72758 R_FLOAT64_IEEE 0 NO_COMPU_METHOD -1e+08 1e+08 PHYS_UNIT "" /end CHARACTERISTIC
/begin CHARACTERISTIC pid_para.PID_roll_D "PID_roll_D" VALUE 0x72760 R_FLOAT64_IEEE 0 NO_COMPU_METHOD -1e+08 1e+08 PHYS_UNIT "" /end CHARACTERISTIC
/begin CHARACTERISTIC pid_para.PID_pitch_P "PID_pitch_P" VALUE 0x72768 R_FLOAT64_IEEE 0 NO_COMPU_METHOD -1e+08 1e+08 PHYS_UNIT "" /end CHARACTERISTIC
/begin CHARACTERISTIC pid_para.PID_pitch_I "PID_pitch_I" VALUE 0x72770 R_FLOAT64_IEEE 0 NO_COMPU_METHOD -1e+08 1e+08 PHYS_UNIT "" /end CHARACTERISTIC
/begin CHARACTERISTIC pid_para.PID_pitch_D "PID_pitch_D" VALUE 0x72778 R_FLOAT64_IEEE 0 NO_COMPU_METHOD -1e+08 1e+08 PHYS_UNIT "" /end CHARACTERISTIC
/begin CHARACTERISTIC pid_para.PID_chairX_P "PID_chairX_P" VALUE 0x72780 R_FLOAT64_IEEE 0 NO_COMPU_METHOD -1e+08 1e+08 PHYS_UNIT "" /end CHARACTERISTIC
/begin CHARACTERISTIC pid_para.PID_chairX_I "PID_chairX_I" VALUE 0x72788 R_FLOAT64_IEEE 0 NO_COMPU_METHOD -1e+08 1e+08 PHYS_UNIT "" /end CHARACTERISTIC
/begin CHARACTERISTIC pid_para.PID_chairX_D "PID_chairX_D" VALUE 0x72790 R_FLOAT64_IEEE 0 NO_COMPU_METHOD -1e+08 1e+08 PHYS_UNIT "" /end CHARACTERISTIC
/begin CHARACTERISTIC pid_para.PID_chairZ_P "PID_chairZ_P" VALUE 0x72798 R_FLOAT64_IEEE 0 NO_COMPU_METHOD -1e+08 1e+08 PHYS_UNIT "" /end CHARACTERISTIC
/begin CHARACTERISTIC pid_para.PID_chairZ_I "PID_chairZ_I" VALUE 0x727A0 R_FLOAT64_IEEE 0 NO_COMPU_METHOD -1e+08 1e+08 PHYS_UNIT "" /end CHARACTERISTIC
/begin CHARACTERISTIC pid_para.PID_chairZ_D "PID_chairZ_D" VALUE 0x727A8 R_FLOAT64_IEEE 0 NO_COMPU_METHOD -1e+08 1e+08 PHYS_UNIT "" /end CHARACTERISTIC
/begin GROUP PID_Para ""
 /begin REF_CHARACTERISTIC pid_para.PID_balance_P pid_para.PID_balance_I pid_para.PID_balance_D pid_para.PID_drive_P pid_para.PID_drive_I pid_para.PID_drive_D pid_para.PID_steer_P pid_para.PID_steer_I pid_para.PID_steer_D pid_para.PID_roll_P pid_para.PID_roll_I pid_para.PID_roll_D pid_para.PID_pitch_P pid_para.PID_pitch_I pid_para.PID_pitch_D pid_para.PID_chairX_P pid_para.PID_chairX_I pid_para.PID_chairX_D pid_para.PID_chairZ_P pid_para.PID_chairZ_I pid_para.PID_chairZ_D /end REF_CHARACTERISTIC
/end GROUP
/begin CHARACTERISTIC Para_001 "Para_001" VALUE 0x727B0 R_FLOAT64_IEEE 0 NO_COMPU_METHOD -1e+08 1e+08 PHYS_UNIT "" /end CHARACTERISTIC
/begin CHARACTERISTIC Para_002 "Para_002" VALUE 0x727B8 R_FLOAT64_IEEE 0 NO_COMPU_METHOD -1e+08 1e+08 PHYS_UNIT "" /end CHARACTERISTIC
/begin CHARACTERISTIC Para_003 "Para_003" VALUE 0x727C0 R_FLOAT64_IEEE 0 NO_COMPU_METHOD -1e+08 1e+08 PHYS_UNIT "" /end CHARACTERISTIC
/begin CHARACTERISTIC Para_004 "Para_004" VALUE 0x727C8 R_FLOAT64_IEEE 0 NO_COMPU_METHOD -1e+08 1e+08 PHYS_UNIT "" /end CHARACTERISTIC
/begin CHARACTERISTIC Para_005 "Para_005" VALUE 0x727D0 R_FLOAT64_IEEE 0 NO_COMPU_METHOD -1e+08 1e+08 PHYS_UNIT "" /end CHARACTERISTIC
/begin CHARACTERISTIC Para_006 "Para_006" VALUE 0x727D8 R_FLOAT64_IEEE 0 NO_COMPU_METHOD -1e+08 1e+08 PHYS_UNIT "" /end CHARACTERISTIC
/begin CHARACTERISTIC Para_007 "Para_007" VALUE 0x727E0 R_FLOAT64_IEEE 0 NO_COMPU_METHOD -1e+08 1e+08 PHYS_UNIT "" /end CHARACTERISTIC
/begin CHARACTERISTIC Para_008 "Para_008" VALUE 0x727E8 R_FLOAT64_IEEE 0 NO_COMPU_METHOD -1e+08 1e+08 PHYS_UNIT "" /end CHARACTERISTIC
/begin CHARACTERISTIC Para_009 "Para_009" VALUE 0x727F0 R_FLOAT64_IEEE 0 NO_COMPU_METHOD -1e+08 1e+08 PHYS_UNIT "" /end CHARACTERISTIC
/begin CHARACTERISTIC Para_010 "Para_010" VALUE 0x727F8 R_FLOAT64_IEEE 0 NO_COMPU_METHOD -1e+08 1e+08 PHYS_UNIT "" /end CHARACTERISTIC
/begin CHARACTERISTIC Para_011 "Para_011" VALUE 0x72800 R_FLOAT64_IEEE 0 NO_COMPU_METHOD -1e+08 1e+08 PHYS_UNIT "" /end CHARACTERISTIC
/begin CHARACTERISTIC Para_012 "Para_012" VALUE 0x72808 R_FLOAT64_IEEE 0 NO_COMPU_METHOD -1e+08 1e+08 PHYS_UNIT "" /end CHARACTERISTIC
/begin CHARACTERISTIC Para_013 "Para_013" VALUE 0x72810 R_FLOAT64_IEEE 0 NO_COMPU_METHOD -1e+08 1e+08 PHYS_UNIT "" /end CHARACTERISTIC
/begin CHARACTERISTIC Para_014 "Para_014" VALUE 0x72818 R_FLOAT64_IEEE 0 NO_COMPU_METHOD -1e+08 1e+08 PHYS_UNIT "" /end CHARACTERISTIC
/begin CHARACTERISTIC Para_015 "Para_015" VALUE 0x72820 R_FLOAT64_IEEE 0 NO_COMPU_METHOD -1e+08 1e+08 PHYS_UNIT "" /end CHARACTERISTIC
/begin CHARACTERISTIC Para_016 "Para_016" VALUE 0x72828 R_FLOAT64_IEEE 0 NO_COMPU_METHOD -1e+08 1e+08 PHYS_UNIT "" /end CHARACTERISTIC
/begin CHARACTERISTIC Para_017 "Para_017" VALUE 0x72830 R_FLOAT64_IEEE 0 NO_COMPU_METHOD -1e+08 1e+08 PHYS_UNIT "" /end CHARACTERISTIC
/begin CHARACTERISTIC Para_018 "Para_018" VALUE 0x72838 R_FLOAT64_IEEE 0 NO_COMPU_METHOD -1e+08 1e+08 PHYS_UNIT "" /end CHARACTERISTIC
/begin CHARACTERISTIC Para_019 "Para_019" VALUE 0x72840 R_FLOAT64_IEEE 0 NO_COMPU_METHOD -1e+08 1e+08 PHYS_UNIT "" /end CHARACTERISTIC
/begin CHARACTERISTIC Para_020 "Para_020" VALUE 0x72848 R_FLOAT64_IEEE 0 NO_COMPU_METHOD -1e+08 1e+08 PHYS_UNIT "" /end CHARACTERISTIC
/begin CHARACTERISTIC Para_021 "Para_021" VALUE 0x72850 R_FLOAT64_IEEE 0 NO_COMPU_METHOD -1e+08 1e+08 PHYS_UNIT "" /end CHARACTERISTIC
/begin CHARACTERISTIC Para_022 "Para_022" VALUE 0x72858 R_FLOAT64_IEEE 0 NO_COMPU_METHOD -1e+08 1e+08 PHYS_UNIT "" /end CHARACTERISTIC
/begin CHARACTERISTIC Para_023 "Para_023" VALUE 0x72860 R_FLOAT64_IEEE 0 NO_COMPU_METHOD -1e+08 1e+08 PHYS_UNIT "" /end CHARACTERISTIC
/begin CHARACTERISTIC Para_024 "Para_024" VALUE 0x72868 R_FLOAT64_IEEE 0 NO_COMPU_METHOD -1e+08 1e+08 PHYS_UNIT "" /end CHARACTERISTIC
/begin CHARACTERISTIC Para_025 "Para_025" VALUE 0x72870 R_FLOAT64_IEEE 0 NO_COMPU_METHOD -1e+08 1e+08 PHYS_UNIT "" /end CHARACTERISTIC
/begin CHARACTERISTIC Para_026 "Para_026" VALUE 0x72878 R_FLOAT64_IEEE 0 NO_COMPU_METHOD -1e+08 1e+08 PHYS_UNIT "" /end CHARACTERISTIC
/begin CHARACTERISTIC Para_027 "Para_027" VALUE 0x72880 R_FLOAT64_IEEE 0 NO_COMPU_METHOD -1e+08 1e+08 PHYS_UNIT "" /end CHARACTERISTIC
/begin CHARACTERISTIC Para_028 "Para_028" VALUE 0x72888 R_FLOAT64_IEEE 0 NO_COMPU_METHOD -1e+08 1e+08 PHYS_UNIT "" /end CHARACTERISTIC
/begin CHARACTERISTIC Para_029 "Para_029" VALUE 0x72890 R_FLOAT64_IEEE 0 NO_COMPU_METHOD -1e+08 1e+08 PHYS_UNIT "" /end CHARACTERISTIC
/begin CHARACTERISTIC Para_030 "Para_030" VALUE 0x72898 R_FLOAT64_IEEE 0 NO_COMPU_METHOD -1e+08 1e+08 PHYS_UNIT "" /end CHARACTERISTIC
/begin CHARACTERISTIC Para_031 "Para_031" VALUE 0x728A0 R_FLOAT64_IEEE 0 NO_COMPU_METHOD -1e+08 1e+08 PHYS_UNIT "" /end CHARACTERISTIC
/begin CHARACTERISTIC Para_032 "Para_032" VALUE 0x728A8 R_FLOAT64_IEEE 0 NO_COMPU_METHOD -1e+08 1e+08 PHYS_UNIT "" /end CHARACTERISTIC
/begin CHARACTERISTIC Para_033 "Para_033" VALUE 0x728B0 R_FLOAT64_IEEE 0 NO_COMPU_METHOD -1e+08 1e+08 PHYS_UNIT "" /end CHARACTERISTIC
/begin CHARACTERISTIC Para_034 "Para_034" VALUE 0x728B8 R_FLOAT64_IEEE 0 NO_COMPU_METHOD -1e+08 1e+08 PHYS_UNIT "" /end CHARACTERISTIC
/begin CHARACTERISTIC Para_035 "Para_035" VALUE 0x728C0 R_FLOAT64_IEEE 0 NO_COMPU_METHOD -1e+08 1e+08 PHYS_UNIT "" /end CHARACTERISTIC
/begin CHARACTERISTIC Para_036 "Para_036" VALUE 0x728C8 R_FLOAT64_IEEE 0 NO_COMPU_METHOD -1e+08 1e+08 PHYS_UNIT "" /end CHARACTERISTIC
/begin CHARACTERISTIC Para_037 "Para_037" VALUE 0x728D0 R_FLOAT64_IEEE 0 NO_COMPU_METHOD -1e+08 1e+08 PHYS_UNIT "" /end CHARACTERISTIC
/begin CHARACTERISTIC Para_038 "Para_038" VALUE 0x728D8 R_FLOAT64_IEEE 0 NO_COMPU_METHOD -1e+08 1e+08 PHYS_UNIT "" /end CHARACTERISTIC
/begin CHARACTERISTIC Para_039 "Para_039" VALUE 0x728E0 R_FLOAT64_IEEE 0 NO_COMPU_METHOD -1e+08 1e+08 PHYS_UNIT "" /end CHARACTERISTIC
/begin CHARACTERISTIC Para_040 "Para_040" VALUE 0x728E8 R_FLOAT64_IEEE 0 NO_COMPU_METHOD -1e+08 1e+08 PHYS_UNIT "" /end CHARACTERISTIC
/begin CHARACTERISTIC Para_041 "Para_041" VALUE 0x728F0 R_FLOAT64_IEEE 0 NO_COMPU_METHOD -1e+08 1e+08 PHYS_UNIT "" /end CHARACTERISTIC
/begin CHARACTERISTIC Para_042 "Para_042" VALUE 0x728F8 R_FLOAT64_IEEE 0 NO_COMPU_METHOD -1e+08 1e+08 PHYS_UNIT "" /end CHARACTERISTIC
/begin CHARACTERISTIC Para_043 "Para_043" VALUE 0x72900 R_FLOAT64_IEEE 0 NO_COMPU_METHOD -1e+08 1e+08 PHYS_UNIT "" /end CHARACTERISTIC
/begin CHARACTERISTIC Para_044 "Para_044" VALUE 0x72908 R_FLOAT64_IEEE 0 NO_COMPU_METHOD -1e+08 1e+08 PHYS_UNIT "" /end CHARACTERISTIC
/begin CHARACTERISTIC Para_045 "Para_045" VALUE 0x72910 R_FLOAT64_IEEE 0 NO_COMPU_METHOD -1e+08 1e+08 PHYS_UNIT "" /end CHARACTERISTIC
/begin CHARACTERISTIC Para_046 "Para_046" VALUE 0x72918 R_FLOAT64_IEEE 0 NO_COMPU_METHOD -1e+08 1e+08 PHYS_UNIT "" /end CHARACTERISTIC
/begin CHARACTERISTIC Para_047 "Para_047" VALUE 0x72920 R_FLOAT64_IEEE 0 NO_COMPU_METHOD -1e+08 1e+08 PHYS_UNIT "" /end CHARACTERISTIC
/begin CHARACTERISTIC Para_048 "Para_048" VALUE 0x72928 R_FLOAT64_IEEE 0 NO_COMPU_METHOD -1e+08 1e+08 PHYS_UNIT "" /end CHARACTERISTIC
/begin CHARACTERISTIC Para_049 "Para_049" VALUE 0x72930 R_FLOAT64_IEEE 0 NO_COMPU_METHOD -1e+08 1e+08 PHYS_UNIT "" /end CHARACTERISTIC
/begin CHARACTERISTIC Para_050 "Para_050" VALUE 0x72938 R_FLOAT64_IEEE 0 NO_COMPU_METHOD -1e+08 1e+08 PHYS_UNIT "" /end CHARACTERISTIC
/begin CHARACTERISTIC Para_051 "Para_051" VALUE 0x72940 R_FLOAT64_IEEE 0 NO_COMPU_METHOD -1e+08 1e+08 PHYS_UNIT "" /end CHARACTERISTIC
/begin CHARACTERISTIC Para_052 "Para_052" VALUE 0x72948 R_FLOAT64_IEEE 0 NO_COMPU_METHOD -1e+08 1e+08 PHYS_UNIT "" /end CHARACTERISTIC
/begin CHARACTERISTIC Para_053 "Para_053" VALUE 0x72950 R_FLOAT64_IEEE 0 NO_COMPU_METHOD -1e+08 1e+08 PHYS_UNIT "" /end CHARACTERISTIC
/begin CHARACTERISTIC Para_054 "Para_054" VALUE 0x72958 R_FLOAT64_IEEE 0 NO_COMPU_METHOD -1e+08 1e+08 PHYS_UNIT "" /end CHARACTERISTIC
/begin CHARACTERISTIC Para_055 "Para_055" VALUE 0x72960 R_FLOAT64_IEEE 0 NO_COMPU_METHOD -1e+08 1e+08 PHYS_UNIT "" /end CHARACTERISTIC
/begin CHARACTERISTIC Para_056 "Para_056" VALUE 0x72968 R_FLOAT64_IEEE 0 NO_COMPU_METHOD -1e+08 1e+08 PHYS_UNIT "" /end CHARACTERISTIC
/begin CHARACTERISTIC Para_057 "Para_057" VALUE 0x72970 R_FLOAT64_IEEE 0 NO_COMPU_METHOD -1e+08 1e+08 PHYS_UNIT "" /end CHARACTERISTIC
/begin CHARACTERISTIC Para_058 "Para_058" VALUE 0x72978 R_FLOAT64_IEEE 0 NO_COMPU_METHOD -1e+08 1e+08 PHYS_UNIT "" /end CHARACTERISTIC
/begin CHARACTERISTIC Para_059 "Para_059" VALUE 0x72980 R_FLOAT64_IEEE 0 NO_COMPU_METHOD -1e+08 1e+08 PHYS_UNIT "" /end CHARACTERISTIC
/begin CHARACTERISTIC Para_060 "Para_060" VALUE 0x72988 R_FLOAT64_IEEE 0 NO_COMPU_METHOD -1e+08 1e+08 PHYS_UNIT "" /end CHARACTERISTIC
/begin CHARACTERISTIC Para_061 "Para_061" VALUE 0x72990 R_FLOAT64_IEEE 0 NO_COMPU_METHOD -1e+08 1e+08 PHYS_UNIT "" /end CHARACTERISTIC
/begin CHARACTERISTIC Para_062 "Para_062" VALUE 0x72998 R_FLOAT64_IEEE 0 NO_COMPU_METHOD -1e+08 1e+08 PHYS_UNIT "" /end CHARACTERISTIC
/begin CHARACTERISTIC Para_063 "Para_063" VALUE 0x729A0 R_FLOAT64_IEEE 0 NO_COMPU_METHOD -1e+08 1e+08 PHYS_UNIT "" /end CHARACTERISTIC
/begin CHARACTERISTIC Para_064 "Para_064" VALUE 0x729A8 R_FLOAT64_IEEE 0 NO_COMPU_METHOD -1e+08 1e+08 PHYS_UNIT "" /end CHARACTERISTIC
/begin CHARACTERISTIC Para_065 "Para_065" VALUE 0x729B0 R_FLOAT64_IEEE 0 NO_COMPU_METHOD -1e+08 1e+08 PHYS_UNIT "" /end CHARACTERISTIC
/begin CHARACTERISTIC Para_066 "Para_066" VALUE 0x729B8 R_FLOAT64_IEEE 0 NO_COMPU_METHOD -1e+08 1e+08 PHYS_UNIT "" /end CHARACTERISTIC
/begin CHARACTERISTIC Para_067 "Para_067" VALUE 0x729C0 R_FLOAT64_IEEE 0 NO_COMPU_METHOD -1e+08 1e+08 PHYS_UNIT "" /end CHARACTERISTIC
/begin CHARACTERISTIC Para_068 "Para_068" VALUE 0x729C8 R_FLOAT64_IEEE 0 NO_COMPU_METHOD -1e+08 1e+08 PHYS_UNIT "" /end CHARACTERISTIC
/begin CHARACTERISTIC Para_069 "Para_069" VALUE 0x729D0 R_FLOAT64_IEEE 0 NO_COMPU_METHOD -1e+08 1e+08 PHYS_UNIT "" /end CHARACTERISTIC
/begin CHARACTERISTIC Para_070 "Para_070" VALUE 0x729D8 R_FLOAT64_IEEE 0 NO_COMPU_METHOD -1e+08 1e+08 PHYS_UNIT "" /end CHARACTERISTIC
/begin CHARACTERISTIC Para_071 "Para_071" VALUE 0x729E0 R_FLOAT64_IEEE 0 NO_COMPU_METHOD -1e+08 1e+08 PHYS_UNIT "" /end CHARACTERISTIC
/begin CHARACTERISTIC Para_072 "Para_072" VALUE 0x729E8 R_FLOAT64_IEEE 0 NO_COMPU_METHOD -1e+08 1e+08 PHYS_UNIT "" /end CHARACTERISTIC
/begin CHARACTERISTIC Para_073 "Para_073" VALUE 0x729F0 R_FLOAT64_IEEE 0 NO_COMPU_METHOD -1e+08 1e+08 PHYS_UNIT "" /end CHARACTERISTIC
/begin CHARACTERISTIC Para_074 "Para_074" VALUE 0x729F8 R_FLOAT64_IEEE 0 NO_COMPU_METHOD -1e+08 1e+08 PHYS_UNIT "" /end CHARACTERISTIC
/begin CHARACTERISTIC Para_075 "Para_075" VALUE 0x72A00 R_FLOAT64_IEEE 0 NO_COMPU_METHOD -1e+08 1e+08 PHYS_UNIT "" /end CHARACTERISTIC
/begin CHARACTERISTIC Para_076 "Para_076" VALUE 0x72A08 R_FLOAT64_IEEE 0 NO_COMPU_METHOD -1e+08 1e+08 PHYS_UNIT "" /end CHARACTERISTIC
/begin CHARACTERISTIC Para_077 "Para_077" VALUE 0x72A10 R_FLOAT64_IEEE 0 NO_COMPU_METHOD -1e+08 1e+08 PHYS_UNIT "" /end CHARACTERISTIC
/begin CHARACTERISTIC Para_078 "Para_078" VALUE 0x72A18 R_FLOAT64_IEEE 0 NO_COMPU_METHOD -1e+08 1e+08 PHYS_UNIT "" /end CHARACTERISTIC
/begin CHARACTERISTIC Para_079 "Para_079" VALUE 0x72A20 R_FLOAT64_IEEE 0 NO_COMPU_METHOD -1e+08 1e+08 PHYS_UNIT "" /end CHARACTERISTIC
/begin CHARACTERISTIC Para_080 "Para_080" VALUE 0x72A28 R_FLOAT64_IEEE 0 NO_COMPU_METHOD -1e+08 1e+08 PHYS_UNIT "" /end CHARACTERISTIC
/begin CHARACTERISTIC Para_081 "Para_081" VALUE 0x72A30 R_FLOAT64_IEEE 0 NO_COMPU_METHOD -1e+08 1e+08 PHYS_UNIT "" /end CHARACTERISTIC
/begin CHARACTERISTIC Para_082 "Para_082" VALUE 0x72A38 R_FLOAT64_IEEE 0 NO_COMPU_METHOD -1e+08 1e+08 PHYS_UNIT "" /end CHARACTERISTIC
/begin CHARACTERISTIC Para_083 "Para_083" VALUE 0x72A40 R_FLOAT64_IEEE 0 NO_COMPU_METHOD -1e+08 1e+08 PHYS_UNIT "" /end CHARACTERISTIC
/begin CHARACTERISTIC Para_084 "Para_084" VALUE 0x72A48 R_FLOAT64_IEEE 0 NO_COMPU_METHOD -1e+08 1e+08 PHYS_UNIT "" /end CHARACTERISTIC
/begin CHARACTERISTIC Para_085 "Para_085" VALUE 0x72A50 R_FLOAT64_IEEE 0 NO_COMPU_METHOD -1e+08 1e+08 PHYS_UNIT "" /end CHARACTERISTIC
/begin CHARACTERISTIC Para_086 "Para_086" VALUE 0x72A58 R_FLOAT64_IEEE 0 NO_COMPU_METHOD -1e+08 1e+08 PHYS_UNIT "" /end CHARACTERISTIC
/begin CHARACTERISTIC Para_087 "Para_087" VALUE 0x72A60 R_FLOAT64_IEEE 0 NO_COMPU_METHOD -1e+08 1e+08 PHYS_UNIT "" /end CHARACTERISTIC
/begin CHARACTERISTIC Para_088 "Para_088" VALUE 0x72A68 R_FLOAT64_IEEE 0 NO_COMPU_METHOD -1e+08 1e+08 PHYS_UNIT "" /end CHARACTERISTIC
/begin CHARACTERISTIC Para_089 "Para_089" VALUE 0x72A70 R_FLOAT64_IEEE 0 NO_COMPU_METHOD -1e+08 1e+08 PHYS_UNIT "" /end CHARACTERISTIC
/begin CHARACTERISTIC Para_090 "Para_090" VALUE 0x72A78 R_FLOAT64_IEEE 0 NO_COMPU_METHOD -1e+08 1e+08 PHYS_UNIT "" /end CHARACTERISTIC
/begin CHARACTERISTIC Para_091 "Para_091" VALUE 0x72A80 R_FLOAT64_IEEE 0 NO_COMPU_METHOD -1e+08 1e+08 PHYS_UNIT "" /end CHARACTERISTIC
/begin CHARACTERISTIC Para_092 "Para_092" VALUE 0x72A88 R_FLOAT64_IEEE 0 NO_COMPU_METHOD -1e+08 1e+08 PHYS_UNIT "" /end CHARACTERISTIC
/begin CHARACTERISTIC Para_093 "Para_093" VALUE 0x72A90 R_FLOAT64_IEEE 0 NO_COMPU_METHOD -1e+08 1e+08 PHYS_UNIT "" /end CHARACTERISTIC
/begin CHARACTERISTIC Para_094 "Para_094" VALUE 0x72A98 R_FLOAT64_IEEE 0 NO_COMPU_METHOD -1e+08 1e+08 PHYS_UNIT "" /end CHARACTERISTIC
/begin CHARACTERISTIC Para_095 "Para_095" VALUE 0x72AA0 R_FLOAT64_IEEE 0 NO_COMPU_METHOD -1e+08 1e+08 PHYS_UNIT "" /end CHARACTERISTIC
/begin CHARACTERISTIC Para_096 "Para_096" VALUE 0x72AA8 R_FLOAT64_IEEE 0 NO_COMPU_METHOD -1e+08 1e+08 PHYS_UNIT "" /end CHARACTERISTIC
/begin CHARACTERISTIC Para_097 "Para_097" VALUE 0x72AB0 R_FLOAT64_IEEE 0 NO_COMPU_METHOD -1e+08 1e+08 PHYS_UNIT "" /end CHARACTERISTIC
/begin CHARACTERISTIC Para_098 "Para_098" VALUE 0x72AB8 R_FLOAT64_IEEE 0 NO_COMPU_METHOD -1e+08 1e+08 PHYS_UNIT "" /end CHARACTERISTIC
/begin CHARACTERISTIC Para_099 "Para_099" VALUE 0x72AC0 R_FLOAT64_IEEE 0 NO_COMPU_METHOD -1e+08 1e+08 PHYS_UNIT "" /end CHARACTERISTIC
/begin CHARACTERISTIC Para_100 "Para_100" VALUE 0x72AC8 R_FLOAT64_IEEE 0 NO_COMPU_METHOD -1e+08 1e+08 PHYS_UNIT "" /end CHARACTERISTIC
/begin GROUP PID_Para_1_100 ""
 /begin REF_MEASUREMENT Para_001 Para_002 Para_003 Para_004 Para_005 Para_006 Para_007 Para_008 Para_009 Para_010 Para_011 Para_012 Para_013 Para_014 Para_015 Para_016 Para_017 Para_018 Para_019 Para_020 Para_021 Para_022 Para_023 Para_024 Para_025 Para_026 Para_027 Para_028 Para_029 Para_030 Para_031 Para_032 Para_033 Para_034 Para_035 Para_036 Para_037 Para_038 Para_039 Para_040 Para_041 Para_042 Para_043 Para_044 Para_045 Para_046 Para_047 Para_048 Para_049 Para_050 Para_051 Para_052 Para_053 Para_054 Para_055 Para_056 Para_057 Para_058 Para_059 Para_060 Para_061 Para_062 Para_063 Para_064 Para_065 Para_066 Para_067 Para_068 Para_069 Para_070 Para_071 Para_072 Para_073 Para_074 Para_075 Para_076 Para_077 Para_078 Para_079 Para_080 Para_081 Para_082 Para_083 Para_084 Para_085 Para_086 Para_087 Para_088 Para_089 Para_090 Para_091 Para_092 Para_093 Para_094 Para_095 Para_096 Para_097 Para_098 Para_099 Para_100 /end REF_MEASUREMENT
/end GROUP
/begin COMPU_METHOD byteCounter_COMPU_METHOD "" LINEAR "%6.3" "" COEFFS_LINEAR 1 0 /end COMPU_METHOD
/begin MEASUREMENT byteCounter "" SBYTE byteCounter_COMPU_METHOD 0 0 -128 127 ECU_ADDRESS 0x712A2
 /begin IF_DATA XCP
  /begin DAQ_EVENT FIXED_EVENT_LIST EVENT 0x0 /end DAQ_EVENT
 /end IF_DATA
/end MEASUREMENT
/begin COMPU_METHOD wordCounter_COMPU_METHOD "" LINEAR "%6.3" "" COEFFS_LINEAR 1 0 /end COMPU_METHOD
/begin MEASUREMENT wordCounter "" SWORD wordCounter_COMPU_METHOD 0 0 -32768 32767 ECU_ADDRESS 0x712A0
 /begin IF_DATA XCP
  /begin DAQ_EVENT FIXED_EVENT_LIST EVENT 0x0 /end DAQ_EVENT
 /end IF_DATA
/end MEASUREMENT
/begin COMPU_METHOD dwordCounter_COMPU_METHOD "" LINEAR "%6.3" "" COEFFS_LINEAR 1 0 /end COMPU_METHOD
/begin MEASUREMENT dwordCounter "" SLONG dwordCounter_COMPU_METHOD 0 0 -2147483648 2147483647 ECU_ADDRESS 0x7129C
 /begin IF_DATA XCP
  /begin DAQ_EVENT FIXED_EVENT_LIST EVENT 0x0 /end DAQ_EVENT
 /end IF_DATA
/end MEASUREMENT
/begin COMPU_METHOD sbyteCounter_COMPU_METHOD "" LINEAR "%6.3" "" COEFFS_LINEAR 1 0 /end COMPU_METHOD
/begin MEASUREMENT sbyteCounter "" SBYTE sbyteCounter_COMPU_METHOD 0 0 -128 127 ECU_ADDRESS 0x7129A
 /begin IF_DATA XCP
  /begin DAQ_EVENT FIXED_EVENT_LIST EVENT 0x0 /end DAQ_EVENT
 /end IF_DATA
/end MEASUREMENT
/begin COMPU_METHOD swordCounter_COMPU_METHOD "" LINEAR "%6.3" "" COEFFS_LINEAR 1 0 /end COMPU_METHOD
/begin MEASUREMENT swordCounter "" SWORD swordCounter_COMPU_METHOD 0 0 -32768 32767 ECU_ADDRESS 0x71298
 /begin IF_DATA XCP
  /begin DAQ_EVENT FIXED_EVENT_LIST EVENT 0x0 /end DAQ_EVENT
 /end IF_DATA
/end MEASUREMENT
/begin COMPU_METHOD sdwordCounter_COMPU_METHOD "" LINEAR "%6.3" "" COEFFS_LINEAR 1 0 /end COMPU_METHOD
/begin MEASUREMENT sdwordCounter "" SLONG sdwordCounter_COMPU_METHOD 0 0 -2147483648 2147483647 ECU_ADDRESS 0x71294
 /begin IF_DATA XCP
  /begin DAQ_EVENT FIXED_EVENT_LIST EVENT 0x0 /end DAQ_EVENT
 /end IF_DATA
/end MEASUREMENT
/begin COMPU_METHOD ledStatus_COMPU_METHOD "" LINEAR "%6.3" "" COEFFS_LINEAR 1 0 /end COMPU_METHOD
/begin MEASUREMENT ledStatus "ledStatus" SBYTE ledStatus_COMPU_METHOD 0 0 -128 127 ECU_ADDRESS 0x71290
 /begin IF_DATA XCP
  /begin DAQ_EVENT FIXED_EVENT_LIST EVENT 0x0 /end DAQ_EVENT
 /end IF_DATA
/end MEASUREMENT
/begin COMPU_METHOD channel1_COMPU_METHOD "" LINEAR "%6.3" "" COEFFS_LINEAR 1 0 /end COMPU_METHOD
/begin MEASUREMENT channel1 "Sinus signal 1" FLOAT64_IEEE channel1_COMPU_METHOD 0 0 -1E12 1E12 ECU_ADDRESS 0x726B8
 /begin IF_DATA XCP
  /begin DAQ_EVENT FIXED_EVENT_LIST EVENT 0x0 /end DAQ_EVENT
 /end IF_DATA
/end MEASUREMENT
/begin CHARACTERISTIC byteArray1 "" VAL_BLK 0x722A8 R_SBYTE 0 NO_COMPU_METHOD -128 127 MATRIX_DIM 1024
 /begin IF_DATA XCP
  /begin DAQ_EVENT FIXED_EVENT_LIST EVENT 0x0 /end DAQ_EVENT
 /end IF_DATA
/end CHARACTERISTIC
/begin CHARACTERISTIC longArray1 "" VAL_BLK 0x712A8 R_SLONG 0 NO_COMPU_METHOD -2147483648 2147483647 MATRIX_DIM 1024
 /begin IF_DATA XCP
  /begin DAQ_EVENT FIXED_EVENT_LIST EVENT 0x0 /end DAQ_EVENT
 /end IF_DATA
/end CHARACTERISTIC
/begin GROUP EcuTaskSignals ""
 /begin REF_MEASUREMENT channel1 channel2 channel3 byteCounter wordCounter dwordCounter sbyteCounter swordCounter sdwordCounter longArray1 byteArray1 ledStatus /end REF_MEASUREMENT
/end GROUP
/begin COMPU_METHOD sd_input.IMU_signals.IMU_wx_body_COMPU_METHOD "" LINEAR "%6.3" "" COEFFS_LINEAR 1 0 /end COMPU_METHOD
/begin MEASUREMENT sd_input.IMU_signals.IMU_wx_body "IMU_wx_body " FLOAT64_IEEE sd_input.IMU_signals.IMU_wx_body_COMPU_METHOD 0 0 -1E12 1E12 ECU_ADDRESS 0x6FA98
 /begin IF_DATA XCP
  /begin DAQ_EVENT FIXED_EVENT_LIST EVENT 0x0 /end DAQ_EVENT
 /end IF_DATA
/end MEASUREMENT
/begin COMPU_METHOD sd_input.IMU_signals.IMU_wy_body_COMPU_METHOD "" LINEAR "%6.3" "" COEFFS_LINEAR 1 0 /end COMPU_METHOD
/begin MEASUREMENT sd_input.IMU_signals.IMU_wy_body "IMU_wy_body " FLOAT64_IEEE sd_input.IMU_signals.IMU_wy_body_COMPU_METHOD 0 0 -1E12 1E12 ECU_ADDRESS 0x6FAA0
 /begin IF_DATA XCP
  /begin DAQ_EVENT FIXED_EVENT_LIST EVENT 0x0 /end DAQ_EVENT
 /end IF_DATA
/end MEASUREMENT
/begin COMPU_METHOD sd_input.IMU_signals.IMU_wz_body_COMPU_METHOD "" LINEAR "%6.3" "" COEFFS_LINEAR 1 0 /end COMPU_METHOD
/begin MEASUREMENT sd_input.IMU_signals.IMU_wz_body "IMU_wz_body " FLOAT64_IEEE sd_input.IMU_signals.IMU_wz_body_COMPU_METHOD 0 0 -1E12 1E12 ECU_ADDRESS 0x6FAA8
 /begin IF_DATA XCP
  /begin DAQ_EVENT FIXED_EVENT_LIST EVENT 0x0 /end DAQ_EVENT
 /end IF_DATA
/end MEASUREMENT
/begin COMPU_METHOD sd_input.IMU_signals.IMU_accx_COMPU_METHOD "" LINEAR "%6.3" "" COEFFS_LINEAR 1 0 /end COMPU_METHOD
/begin MEASUREMENT sd_input.IMU_signals.IMU_accx "IMU_accx    " FLOAT64_IEEE sd_input.IMU_signals.IMU_accx_COMPU_METHOD 0 0 -1E12 1E12 ECU_ADDRESS 0x6FAB0
 /begin IF_DATA XCP
  /begin DAQ_EVENT FIXED_EVENT_LIST EVENT 0x0 /end DAQ_EVENT
 /end IF_DATA
/end MEASUREMENT
/begin COMPU_METHOD sd_input.IMU_signals.IMU_accy_COMPU_METHOD "" LINEAR "%6.3" "" COEFFS_LINEAR 1 0 /end COMPU_METHOD
/begin MEASUREMENT sd_input.IMU_signals.IMU_accy "IMU_accy    " FLOAT64_IEEE sd_input.IMU_signals.IMU_accy_COMPU_METHOD 0 0 -1E12 1E12 ECU_ADDRESS 0x6FAB8
 /begin IF_DATA XCP
  /begin DAQ_EVENT FIXED_EVENT_LIST EVENT 0x0 /end DAQ_EVENT
 /end IF_DATA
/end MEASUREMENT
/begin COMPU_METHOD sd_input.IMU_signals.IMU_accz_COMPU_METHOD "" LINEAR "%6.3" "" COEFFS_LINEAR 1 0 /end COMPU_METHOD
/begin MEASUREMENT sd_input.IMU_signals.IMU_accz "IMU_accz    " FLOAT64_IEEE sd_input.IMU_signals.IMU_accz_COMPU_METHOD 0 0 -1E12 1E12 ECU_ADDRESS 0x6FAC0
 /begin IF_DATA XCP
  /begin DAQ_EVENT FIXED_EVENT_LIST EVENT 0x0 /end DAQ_EVENT
 /end IF_DATA
/end MEASUREMENT
/begin COMPU_METHOD sd_input.IMU_signals.IMU_wx_world_COMPU_METHOD "" LINEAR "%6.3" "" COEFFS_LINEAR 1 0 /end COMPU_METHOD
/begin MEASUREMENT sd_input.IMU_signals.IMU_wx_world "IMU_wx_world" FLOAT64_IEEE sd_input.IMU_signals.IMU_wx_world_COMPU_METHOD 0 0 -1E12 1E12 ECU_ADDRESS 0x6FAC8
 /begin IF_DATA XCP
  /begin DAQ_EVENT FIXED_EVENT_LIST EVENT 0x0 /end DAQ_EVENT
 /end IF_DATA
/end MEASUREMENT
/begin COMPU_METHOD sd_input.IMU_signals.IMU_wy_world_COMPU_METHOD "" LINEAR "%6.3" "" COEFFS_LINEAR 1 0 /end COMPU_METHOD
/begin MEASUREMENT sd_input.IMU_signals.IMU_wy_world "IMU_wy_world" FLOAT64_IEEE sd_input.IMU_signals.IMU_wy_world_COMPU_METHOD 0 0 -1E12 1E12 ECU_ADDRESS 0x6FAD0
 /begin IF_DATA XCP
  /begin DAQ_EVENT FIXED_EVENT_LIST EVENT 0x0 /end DAQ_EVENT
 /end IF_DATA
/end MEASUREMENT
/begin COMPU_METHOD sd_input.IMU_signals.IMU_wz_world_COMPU_METHOD "" LINEAR "%6.3" "" COEFFS_LINEAR 1 0 /end COMPU_METHOD
/begin MEASUREMENT sd_input.IMU_signals.IMU_wz_world "IMU_wz_world" FLOAT64_IEEE sd_input.IMU_signals.IMU_wz_world_COMPU_METHOD 0 0 -1E12 1E12 ECU_ADDRESS 0x6FAD8
 /begin IF_DATA XCP
  /begin DAQ_EVENT FIXED_EVENT_LIST EVENT 0x0 /end DAQ_EVENT
 /end IF_DATA
/end MEASUREMENT
/begin COMPU_METHOD sd_input.IMU_signals.IMU_roll_COMPU_METHOD "" LINEAR "%6.3" "" COEFFS_LINEAR 1 0 /end COMPU_METHOD
/begin MEASUREMENT sd_input.IMU_signals.IMU_roll "IMU_roll " FLOAT64_IEEE sd_input.IMU_signals.IMU_roll_COMPU_METHOD 0 0 -1E12 1E12 ECU_ADDRESS 0x6FAE0
 /begin IF_DATA XCP
  /begin DAQ_EVENT FIXED_EVENT_LIST EVENT 0x0 /end DAQ_EVENT
 /end IF_DATA
/end MEASUREMENT
/begin COMPU_METHOD sd_input.IMU_signals.IMU_pitch_COMPU_METHOD "" LINEAR "%6.3" "" COEFFS_LINEAR 1 0 /end COMPU_METHOD
/begin MEASUREMENT sd_input.IMU_signals.IMU_pitch "IMU_pitch" FLOAT64_IEEE sd_input.IMU_signals.IMU_pitch_COMPU_METHOD 0 0 -1E12 1E12 ECU_ADDRESS 0x6FAE8
 /begin IF_DATA XCP
  /begin DAQ_EVENT FIXED_EVENT_LIST EVENT 0x0 /end DAQ_EVENT
 /end IF_DATA
/end MEASUREMENT
/begin COMPU_METHOD sd_input.IMU_signals.IMU_yaw_COMPU_METHOD "" LINEAR "%6.3" "" COEFFS_LINEAR 1 0 /end COMPU_METHOD
/begin MEASUREMENT sd_input.IMU_signals.IMU_yaw "IMU_yaw  " FLOAT64_IEEE sd_input.IMU_signals.IMU_yaw_COMPU_METHOD 0 0 -1E12 1E12 ECU_ADDRESS 0x6FAF0
 /begin IF_DATA XCP
  /begin DAQ_EVENT FIXED_EVENT_LIST EVENT 0x0 /end DAQ_EVENT
 /end IF_DATA
/end MEASUREMENT
/begin COMPU_METHOD sd_input.IMU_signals.IMU_qw_COMPU_METHOD "" LINEAR "%6.3" "" COEFFS_LINEAR 1 0 /end COMPU_METHOD
/begin MEASUREMENT sd_input.IMU_signals.IMU_qw "IMU_qw   " FLOAT64_IEEE sd_input.IMU_signals.IMU_qw_COMPU_METHOD 0 0 -1E12 1E12 ECU_ADDRESS 0x6FAF8
 /begin IF_DATA XCP
  /begin DAQ_EVENT FIXED_EVENT_LIST EVENT 0x0 /end DAQ_EVENT
 /end IF_DATA
/end MEASUREMENT
/begin COMPU_METHOD sd_input.IMU_signals.IMU_qx_COMPU_METHOD "" LINEAR "%6.3" "" COEFFS_LINEAR 1 0 /end COMPU_METHOD
/begin MEASUREMENT sd_input.IMU_signals.IMU_qx "IMU_qx   " FLOAT64_IEEE sd_input.IMU_signals.IMU_qx_COMPU_METHOD 0 0 -1E12 1E12 ECU_ADDRESS 0x6FB00
 /begin IF_DATA XCP
  /begin DAQ_EVENT FIXED_EVENT_LIST EVENT 0x0 /end DAQ_EVENT
 /end IF_DATA
/end MEASUREMENT
/begin COMPU_METHOD sd_input.IMU_signals.IMU_qy_COMPU_METHOD "" LINEAR "%6.3" "" COEFFS_LINEAR 1 0 /end COMPU_METHOD
/begin MEASUREMENT sd_input.IMU_signals.IMU_qy "IMU_qy   " FLOAT64_IEEE sd_input.IMU_signals.IMU_qy_COMPU_METHOD 0 0 -1E12 1E12 ECU_ADDRESS 0x6FB08
 /begin IF_DATA XCP
  /begin DAQ_EVENT FIXED_EVENT_LIST EVENT 0x0 /end DAQ_EVENT
 /end IF_DATA
/end MEASUREMENT
/begin COMPU_METHOD sd_input.IMU_signals.IMU_qz_COMPU_METHOD "" LINEAR "%6.3" "" COEFFS_LINEAR 1 0 /end COMPU_METHOD
/begin MEASUREMENT sd_input.IMU_signals.IMU_qz "IMU_qz   " FLOAT64_IEEE sd_input.IMU_signals.IMU_qz_COMPU_METHOD 0 0 -1E12 1E12 ECU_ADDRESS 0x6FB10
 /begin IF_DATA XCP
  /begin DAQ_EVENT FIXED_EVENT_LIST EVENT 0x0 /end DAQ_EVENT
 /end IF_DATA
/end MEASUREMENT
/begin GROUP IMU ""
 /begin REF_MEASUREMENT sd_input.IMU_signals.IMU_wx_body sd_input.IMU_signals.IMU_wy_body sd_input.IMU_signals.IMU_wz_body sd_input.IMU_signals.IMU_accx sd_input.IMU_signals.IMU_accy sd_input.IMU_signals.IMU_accz sd_input.IMU_signals.IMU_wx_world sd_input.IMU_signals.IMU_wy_world sd_input.IMU_signals.IMU_wz_world sd_input.IMU_signals.IMU_roll sd_input.IMU_signals.IMU_pitch sd_input.IMU_signals.IMU_yaw sd_input.IMU_signals.IMU_qw sd_input.IMU_signals.IMU_qx sd_input.IMU_signals.IMU_qy sd_input.IMU_signals.IMU_qz /end REF_MEASUREMENT
/end GROUP
/begin COMPU_METHOD sd_input.arms_status.mass_sum_COMPU_METHOD "" LINEAR "%6.3" "" COEFFS_LINEAR 1 0 /end COMPU_METHOD
/begin MEASUREMENT sd_input.arms_status.mass_sum "mass_sum" FLOAT64_IEEE sd_input.arms_status.mass_sum_COMPU_METHOD 0 0 -1E12 1E12 ECU_ADDRESS 0x70298
 /begin IF_DATA XCP
  /begin DAQ_EVENT FIXED_EVENT_LIST EVENT 0x0 /end DAQ_EVENT
 /end IF_DATA
/end MEASUREMENT
/begin CHARACTERISTIC sd_input.arms_status.mass_center_sum "" VAL_BLK 0x702A0 R_FLOAT64_IEEE 0 NO_COMPU_METHOD -1E12 1E12 MATRIX_DIM 3
 /begin IF_DATA XCP
  /begin DAQ_EVENT FIXED_EVENT_LIST EVENT 0x0 /end DAQ_EVENT
 /end IF_DATA
/end CHARACTERISTIC
/begin GROUP arms_status ""
 /begin REF_MEASUREMENT sd_input.arms_status.mass_sum sd_input.arms_status.mass_center_sum /end REF_MEASUREMENT
/end GROUP
/begin COMPU_METHOD channel_01_COMPU_METHOD "" LINEAR "%6.3" "" COEFFS_LINEAR 1 0 /end COMPU_METHOD
/begin MEASUREMENT channel_01 "channel_01" FLOAT64_IEEE channel_01_COMPU_METHOD 0 0 -1E12 1E12 ECU_ADDRESS 0x70700
 /begin IF_DATA XCP
  /begin DAQ_EVENT FIXED_EVENT_LIST EVENT 0x0 /end DAQ_EVENT
 /end IF_DATA
/end MEASUREMENT
/begin COMPU_METHOD channel_02_COMPU_METHOD "" LINEAR "%6.3" "" COEFFS_LINEAR 1 0 /end COMPU_METHOD
/begin MEASUREMENT channel_02 "channel_02" FLOAT64_IEEE channel_02_COMPU_METHOD 0 0 -1E12 1E12 ECU_ADDRESS 0x70708
 /begin IF_DATA XCP
  /begin DAQ_EVENT FIXED_EVENT_LIST EVENT 0x0 /end DAQ_EVENT
 /end IF_DATA
/end MEASUREMENT
/begin COMPU_METHOD channel_03_COMPU_METHOD "" LINEAR "%6.3" "" COEFFS_LINEAR 1 0 /end COMPU_METHOD
/begin MEASUREMENT channel_03 "channel_03" FLOAT64_IEEE channel_03_COMPU_METHOD 0 0 -1E12 1E12 ECU_ADDRESS 0x70710
 /begin IF_DATA XCP
  /begin DAQ_EVENT FIXED_EVENT_LIST EVENT 0x0 /end DAQ_EVENT
 /end IF_DATA
/end MEASUREMENT
/begin COMPU_METHOD channel_04_COMPU_METHOD "" LINEAR "%6.3" "" COEFFS_LINEAR 1 0 /end COMPU_METHOD
/begin MEASUREMENT channel_04 "channel_04" FLOAT64_IEEE channel_04_COMPU_METHOD 0 0 -1E12 1E12 ECU_ADDRESS 0x70718
 /begin IF_DATA XCP
  /begin DAQ_EVENT FIXED_EVENT_LIST EVENT 0x0 /end DAQ_EVENT
 /end IF_DATA
/end MEASUREMENT
/begin COMPU_METHOD channel_05_COMPU_METHOD "" LINEAR "%6.3" "" COEFFS_LINEAR 1 0 /end COMPU_METHOD
/begin MEASUREMENT channel_05 "channel_05" FLOAT64_IEEE channel_05_COMPU_METHOD 0 0 -1E12 1E12 ECU_ADDRESS 0x70720
 /begin IF_DATA XCP
  /begin DAQ_EVENT FIXED_EVENT_LIST EVENT 0x0 /end DAQ_EVENT
 /end IF_DATA
/end MEASUREMENT
/begin COMPU_METHOD channel_06_COMPU_METHOD "" LINEAR "%6.3" "" COEFFS_LINEAR 1 0 /end COMPU_METHOD
/begin MEASUREMENT channel_06 "channel_06" FLOAT64_IEEE channel_06_COMPU_METHOD 0 0 -1E12 1E12 ECU_ADDRESS 0x70728
 /begin IF_DATA XCP
  /begin DAQ_EVENT FIXED_EVENT_LIST EVENT 0x0 /end DAQ_EVENT
 /end IF_DATA
/end MEASUREMENT
/begin COMPU_METHOD channel_07_COMPU_METHOD "" LINEAR "%6.3" "" COEFFS_LINEAR 1 0 /end COMPU_METHOD
/begin MEASUREMENT channel_07 "channel_07" FLOAT64_IEEE channel_07_COMPU_METHOD 0 0 -1E12 1E12 ECU_ADDRESS 0x70730
 /begin IF_DATA XCP
  /begin DAQ_EVENT FIXED_EVENT_LIST EVENT 0x0 /end DAQ_EVENT
 /end IF_DATA
/end MEASUREMENT
/begin COMPU_METHOD channel_08_COMPU_METHOD "" LINEAR "%6.3" "" COEFFS_LINEAR 1 0 /end COMPU_METHOD
/begin MEASUREMENT channel_08 "channel_08" FLOAT64_IEEE channel_08_COMPU_METHOD 0 0 -1E12 1E12 ECU_ADDRESS 0x70738
 /begin IF_DATA XCP
  /begin DAQ_EVENT FIXED_EVENT_LIST EVENT 0x0 /end DAQ_EVENT
 /end IF_DATA
/end MEASUREMENT
/begin COMPU_METHOD channel_09_COMPU_METHOD "" LINEAR "%6.3" "" COEFFS_LINEAR 1 0 /end COMPU_METHOD
/begin MEASUREMENT channel_09 "channel_09" FLOAT64_IEEE channel_09_COMPU_METHOD 0 0 -1E12 1E12 ECU_ADDRESS 0x70740
 /begin IF_DATA XCP
  /begin DAQ_EVENT FIXED_EVENT_LIST EVENT 0x0 /end DAQ_EVENT
 /end IF_DATA
/end MEASUREMENT
/begin COMPU_METHOD channel_10_COMPU_METHOD "" LINEAR "%6.3" "" COEFFS_LINEAR 1 0 /end COMPU_METHOD
/begin MEASUREMENT channel_10 "channel_10" FLOAT64_IEEE channel_10_COMPU_METHOD 0 0 -1E12 1E12 ECU_ADDRESS 0x70748
 /begin IF_DATA XCP
  /begin DAQ_EVENT FIXED_EVENT_LIST EVENT 0x0 /end DAQ_EVENT
 /end IF_DATA
/end MEASUREMENT
/begin COMPU_METHOD channel_11_COMPU_METHOD "" LINEAR "%6.3" "" COEFFS_LINEAR 1 0 /end COMPU_METHOD
/begin MEASUREMENT channel_11 "channel_11" FLOAT64_IEEE channel_11_COMPU_METHOD 0 0 -1E12 1E12 ECU_ADDRESS 0x70750
 /begin IF_DATA XCP
  /begin DAQ_EVENT FIXED_EVENT_LIST EVENT 0x0 /end DAQ_EVENT
 /end IF_DATA
/end MEASUREMENT
/begin COMPU_METHOD channel_12_COMPU_METHOD "" LINEAR "%6.3" "" COEFFS_LINEAR 1 0 /end COMPU_METHOD
/begin MEASUREMENT channel_12 "channel_12" FLOAT64_IEEE channel_12_COMPU_METHOD 0 0 -1E12 1E12 ECU_ADDRESS 0x70758
 /begin IF_DATA XCP
  /begin DAQ_EVENT FIXED_EVENT_LIST EVENT 0x0 /end DAQ_EVENT
 /end IF_DATA
/end MEASUREMENT
/begin COMPU_METHOD channel_13_COMPU_METHOD "" LINEAR "%6.3" "" COEFFS_LINEAR 1 0 /end COMPU_METHOD
/begin MEASUREMENT channel_13 "channel_13" FLOAT64_IEEE channel_13_COMPU_METHOD 0 0 -1E12 1E12 ECU_ADDRESS 0x70760
 /begin IF_DATA XCP
  /begin DAQ_EVENT FIXED_EVENT_LIST EVENT 0x0 /end DAQ_EVENT
 /end IF_DATA
/end MEASUREMENT
/begin COMPU_METHOD channel_14_COMPU_METHOD "" LINEAR "%6.3" "" COEFFS_LINEAR 1 0 /end COMPU_METHOD
/begin MEASUREMENT channel_14 "channel_14" FLOAT64_IEEE channel_14_COMPU_METHOD 0 0 -1E12 1E12 ECU_ADDRESS 0x70768
 /begin IF_DATA XCP
  /begin DAQ_EVENT FIXED_EVENT_LIST EVENT 0x0 /end DAQ_EVENT
 /end IF_DATA
/end MEASUREMENT
/begin COMPU_METHOD channel_15_COMPU_METHOD "" LINEAR "%6.3" "" COEFFS_LINEAR 1 0 /end COMPU_METHOD
/begin MEASUREMENT channel_15 "channel_15" FLOAT64_IEEE channel_15_COMPU_METHOD 0 0 -1E12 1E12 ECU_ADDRESS 0x70770
 /begin IF_DATA XCP
  /begin DAQ_EVENT FIXED_EVENT_LIST EVENT 0x0 /end DAQ_EVENT
 /end IF_DATA
/end MEASUREMENT
/begin COMPU_METHOD channel_16_COMPU_METHOD "" LINEAR "%6.3" "" COEFFS_LINEAR 1 0 /end COMPU_METHOD
/begin MEASUREMENT channel_16 "channel_16" FLOAT64_IEEE channel_16_COMPU_METHOD 0 0 -1E12 1E12 ECU_ADDRESS 0x70778
 /begin IF_DATA XCP
  /begin DAQ_EVENT FIXED_EVENT_LIST EVENT 0x0 /end DAQ_EVENT
 /end IF_DATA
/end MEASUREMENT
/begin COMPU_METHOD channel_17_COMPU_METHOD "" LINEAR "%6.3" "" COEFFS_LINEAR 1 0 /end COMPU_METHOD
/begin MEASUREMENT channel_17 "channel_17" FLOAT64_IEEE channel_17_COMPU_METHOD 0 0 -1E12 1E12 ECU_ADDRESS 0x70780
 /begin IF_DATA XCP
  /begin DAQ_EVENT FIXED_EVENT_LIST EVENT 0x0 /end DAQ_EVENT
 /end IF_DATA
/end MEASUREMENT
/begin COMPU_METHOD channel_18_COMPU_METHOD "" LINEAR "%6.3" "" COEFFS_LINEAR 1 0 /end COMPU_METHOD
/begin MEASUREMENT channel_18 "channel_18" FLOAT64_IEEE channel_18_COMPU_METHOD 0 0 -1E12 1E12 ECU_ADDRESS 0x70788
 /begin IF_DATA XCP
  /begin DAQ_EVENT FIXED_EVENT_LIST EVENT 0x0 /end DAQ_EVENT
 /end IF_DATA
/end MEASUREMENT
/begin COMPU_METHOD channel_19_COMPU_METHOD "" LINEAR "%6.3" "" COEFFS_LINEAR 1 0 /end COMPU_METHOD
/begin MEASUREMENT channel_19 "channel_19" FLOAT64_IEEE channel_19_COMPU_METHOD 0 0 -1E12 1E12 ECU_ADDRESS 0x70790
 /begin IF_DATA XCP
  /begin DAQ_EVENT FIXED_EVENT_LIST EVENT 0x0 /end DAQ_EVENT
 /end IF_DATA
/end MEASUREMENT
/begin COMPU_METHOD channel_20_COMPU_METHOD "" LINEAR "%6.3" "" COEFFS_LINEAR 1 0 /end COMPU_METHOD
/begin MEASUREMENT channel_20 "channel_20" FLOAT64_IEEE channel_20_COMPU_METHOD 0 0 -1E12 1E12 ECU_ADDRESS 0x70798
 /begin IF_DATA XCP
  /begin DAQ_EVENT FIXED_EVENT_LIST EVENT 0x0 /end DAQ_EVENT
 /end IF_DATA
/end MEASUREMENT
/begin COMPU_METHOD channel_21_COMPU_METHOD "" LINEAR "%6.3" "" COEFFS_LINEAR 1 0 /end COMPU_METHOD
/begin MEASUREMENT channel_21 "channel_21" FLOAT64_IEEE channel_21_COMPU_METHOD 0 0 -1E12 1E12 ECU_ADDRESS 0x707A0
 /begin IF_DATA XCP
  /begin DAQ_EVENT FIXED_EVENT_LIST EVENT 0x0 /end DAQ_EVENT
 /end IF_DATA
/end MEASUREMENT
/begin COMPU_METHOD channel_22_COMPU_METHOD "" LINEAR "%6.3" "" COEFFS_LINEAR 1 0 /end COMPU_METHOD
/begin MEASUREMENT channel_22 "channel_22" FLOAT64_IEEE channel_22_COMPU_METHOD 0 0 -1E12 1E12 ECU_ADDRESS 0x707A8
 /begin IF_DATA XCP
  /begin DAQ_EVENT FIXED_EVENT_LIST EVENT 0x0 /end DAQ_EVENT
 /end IF_DATA
/end MEASUREMENT
/begin COMPU_METHOD channel_23_COMPU_METHOD "" LINEAR "%6.3" "" COEFFS_LINEAR 1 0 /end COMPU_METHOD
/begin MEASUREMENT channel_23 "channel_23" FLOAT64_IEEE channel_23_COMPU_METHOD 0 0 -1E12 1E12 ECU_ADDRESS 0x707B0
 /begin IF_DATA XCP
  /begin DAQ_EVENT FIXED_EVENT_LIST EVENT 0x0 /end DAQ_EVENT
 /end IF_DATA
/end MEASUREMENT
/begin COMPU_METHOD channel_24_COMPU_METHOD "" LINEAR "%6.3" "" COEFFS_LINEAR 1 0 /end COMPU_METHOD
/begin MEASUREMENT channel_24 "channel_24" FLOAT64_IEEE channel_24_COMPU_METHOD 0 0 -1E12 1E12 ECU_ADDRESS 0x707B8
 /begin IF_DATA XCP
  /begin DAQ_EVENT FIXED_EVENT_LIST EVENT 0x0 /end DAQ_EVENT
 /end IF_DATA
/end MEASUREMENT
/begin COMPU_METHOD channel_25_COMPU_METHOD "" LINEAR "%6.3" "" COEFFS_LINEAR 1 0 /end COMPU_METHOD
/begin MEASUREMENT channel_25 "channel_25" FLOAT64_IEEE channel_25_COMPU_METHOD 0 0 -1E12 1E12 ECU_ADDRESS 0x707C0
 /begin IF_DATA XCP
  /begin DAQ_EVENT FIXED_EVENT_LIST EVENT 0x0 /end DAQ_EVENT
 /end IF_DATA
/end MEASUREMENT
/begin COMPU_METHOD channel_26_COMPU_METHOD "" LINEAR "%6.3" "" COEFFS_LINEAR 1 0 /end COMPU_METHOD
/begin MEASUREMENT channel_26 "channel_26" FLOAT64_IEEE channel_26_COMPU_METHOD 0 0 -1E12 1E12 ECU_ADDRESS 0x707C8
 /begin IF_DATA XCP
  /begin DAQ_EVENT FIXED_EVENT_LIST EVENT 0x0 /end DAQ_EVENT
 /end IF_DATA
/end MEASUREMENT
/begin COMPU_METHOD channel_27_COMPU_METHOD "" LINEAR "%6.3" "" COEFFS_LINEAR 1 0 /end COMPU_METHOD
/begin MEASUREMENT channel_27 "channel_27" FLOAT64_IEEE channel_27_COMPU_METHOD 0 0 -1E12 1E12 ECU_ADDRESS 0x707D0
 /begin IF_DATA XCP
  /begin DAQ_EVENT FIXED_EVENT_LIST EVENT 0x0 /end DAQ_EVENT
 /end IF_DATA
/end MEASUREMENT
/begin COMPU_METHOD channel_28_COMPU_METHOD "" LINEAR "%6.3" "" COEFFS_LINEAR 1 0 /end COMPU_METHOD
/begin MEASUREMENT channel_28 "channel_28" FLOAT64_IEEE channel_28_COMPU_METHOD 0 0 -1E12 1E12 ECU_ADDRESS 0x707D8
 /begin IF_DATA XCP
  /begin DAQ_EVENT FIXED_EVENT_LIST EVENT 0x0 /end DAQ_EVENT
 /end IF_DATA
/end MEASUREMENT
/begin COMPU_METHOD channel_29_COMPU_METHOD "" LINEAR "%6.3" "" COEFFS_LINEAR 1 0 /end COMPU_METHOD
/begin MEASUREMENT channel_29 "channel_29" FLOAT64_IEEE channel_29_COMPU_METHOD 0 0 -1E12 1E12 ECU_ADDRESS 0x707E0
 /begin IF_DATA XCP
  /begin DAQ_EVENT FIXED_EVENT_LIST EVENT 0x0 /end DAQ_EVENT
 /end IF_DATA
/end MEASUREMENT
/begin COMPU_METHOD channel_30_COMPU_METHOD "" LINEAR "%6.3" "" COEFFS_LINEAR 1 0 /end COMPU_METHOD
/begin MEASUREMENT channel_30 "channel_30" FLOAT64_IEEE channel_30_COMPU_METHOD 0 0 -1E12 1E12 ECU_ADDRESS 0x707E8
 /begin IF_DATA XCP
  /begin DAQ_EVENT FIXED_EVENT_LIST EVENT 0x0 /end DAQ_EVENT
 /end IF_DATA
/end MEASUREMENT
/begin COMPU_METHOD channel_31_COMPU_METHOD "" LINEAR "%6.3" "" COEFFS_LINEAR 1 0 /end COMPU_METHOD
/begin MEASUREMENT channel_31 "channel_31" FLOAT64_IEEE channel_31_COMPU_METHOD 0 0 -1E12 1E12 ECU_ADDRESS 0x707F0
 /begin IF_DATA XCP
  /begin DAQ_EVENT FIXED_EVENT_LIST EVENT 0x0 /end DAQ_EVENT
 /end IF_DATA
/end MEASUREMENT
/begin COMPU_METHOD channel_32_COMPU_METHOD "" LINEAR "%6.3" "" COEFFS_LINEAR 1 0 /end COMPU_METHOD
/begin MEASUREMENT channel_32 "channel_32" FLOAT64_IEEE channel_32_COMPU_METHOD 0 0 -1E12 1E12 ECU_ADDRESS 0x707F8
 /begin IF_DATA XCP
  /begin DAQ_EVENT FIXED_EVENT_LIST EVENT 0x0 /end DAQ_EVENT
 /end IF_DATA
/end MEASUREMENT
/begin COMPU_METHOD channel_33_COMPU_METHOD "" LINEAR "%6.3" "" COEFFS_LINEAR 1 0 /end COMPU_METHOD
/begin MEASUREMENT channel_33 "channel_33" FLOAT64_IEEE channel_33_COMPU_METHOD 0 0 -1E12 1E12 ECU_ADDRESS 0x70800
 /begin IF_DATA XCP
  /begin DAQ_EVENT FIXED_EVENT_LIST EVENT 0x0 /end DAQ_EVENT
 /end IF_DATA
/end MEASUREMENT
/begin COMPU_METHOD channel_34_COMPU_METHOD "" LINEAR "%6.3" "" COEFFS_LINEAR 1 0 /end COMPU_METHOD
/begin MEASUREMENT channel_34 "channel_34" FLOAT64_IEEE channel_34_COMPU_METHOD 0 0 -1E12 1E12 ECU_ADDRESS 0x70808
 /begin IF_DATA XCP
  /begin DAQ_EVENT FIXED_EVENT_LIST EVENT 0x0 /end DAQ_EVENT
 /end IF_DATA
/end MEASUREMENT
/begin COMPU_METHOD channel_35_COMPU_METHOD "" LINEAR "%6.3" "" COEFFS_LINEAR 1 0 /end COMPU_METHOD
/begin MEASUREMENT channel_35 "channel_35" FLOAT64_IEEE channel_35_COMPU_METHOD 0 0 -1E12 1E12 ECU_ADDRESS 0x70810
 /begin IF_DATA XCP
  /begin DAQ_EVENT FIXED_EVENT_LIST EVENT 0x0 /end DAQ_EVENT
 /end IF_DATA
/end MEASUREMENT
/begin COMPU_METHOD channel_36_COMPU_METHOD "" LINEAR "%6.3" "" COEFFS_LINEAR 1 0 /end COMPU_METHOD
/begin MEASUREMENT channel_36 "channel_36" FLOAT64_IEEE channel_36_COMPU_METHOD 0 0 -1E12 1E12 ECU_ADDRESS 0x70818
 /begin IF_DATA XCP
  /begin DAQ_EVENT FIXED_EVENT_LIST EVENT 0x0 /end DAQ_EVENT
 /end IF_DATA
/end MEASUREMENT
/begin COMPU_METHOD channel_37_COMPU_METHOD "" LINEAR "%6.3" "" COEFFS_LINEAR 1 0 /end COMPU_METHOD
/begin MEASUREMENT channel_37 "channel_37" FLOAT64_IEEE channel_37_COMPU_METHOD 0 0 -1E12 1E12 ECU_ADDRESS 0x70820
 /begin IF_DATA XCP
  /begin DAQ_EVENT FIXED_EVENT_LIST EVENT 0x0 /end DAQ_EVENT
 /end IF_DATA
/end MEASUREMENT
/begin COMPU_METHOD channel_38_COMPU_METHOD "" LINEAR "%6.3" "" COEFFS_LINEAR 1 0 /end COMPU_METHOD
/begin MEASUREMENT channel_38 "channel_38" FLOAT64_IEEE channel_38_COMPU_METHOD 0 0 -1E12 1E12 ECU_ADDRESS 0x70828
 /begin IF_DATA XCP
  /begin DAQ_EVENT FIXED_EVENT_LIST EVENT 0x0 /end DAQ_EVENT
 /end IF_DATA
/end MEASUREMENT
/begin COMPU_METHOD channel_39_COMPU_METHOD "" LINEAR "%6.3" "" COEFFS_LINEAR 1 0 /end COMPU_METHOD
/begin MEASUREMENT channel_39 "channel_39" FLOAT64_IEEE channel_39_COMPU_METHOD 0 0 -1E12 1E12 ECU_ADDRESS 0x70830
 /begin IF_DATA XCP
  /begin DAQ_EVENT FIXED_EVENT_LIST EVENT 0x0 /end DAQ_EVENT
 /end IF_DATA
/end MEASUREMENT
/begin COMPU_METHOD channel_40_COMPU_METHOD "" LINEAR "%6.3" "" COEFFS_LINEAR 1 0 /end COMPU_METHOD
/begin MEASUREMENT channel_40 "channel_40" FLOAT64_IEEE channel_40_COMPU_METHOD 0 0 -1E12 1E12 ECU_ADDRESS 0x70838
 /begin IF_DATA XCP
  /begin DAQ_EVENT FIXED_EVENT_LIST EVENT 0x0 /end DAQ_EVENT
 /end IF_DATA
/end MEASUREMENT
/begin COMPU_METHOD channel_41_COMPU_METHOD "" LINEAR "%6.3" "" COEFFS_LINEAR 1 0 /end COMPU_METHOD
/begin MEASUREMENT channel_41 "channel_41" FLOAT64_IEEE channel_41_COMPU_METHOD 0 0 -1E12 1E12 ECU_ADDRESS 0x70840
 /begin IF_DATA XCP
  /begin DAQ_EVENT FIXED_EVENT_LIST EVENT 0x0 /end DAQ_EVENT
 /end IF_DATA
/end MEASUREMENT
/begin COMPU_METHOD channel_42_COMPU_METHOD "" LINEAR "%6.3" "" COEFFS_LINEAR 1 0 /end COMPU_METHOD
/begin MEASUREMENT channel_42 "channel_42" FLOAT64_IEEE channel_42_COMPU_METHOD 0 0 -1E12 1E12 ECU_ADDRESS 0x70848
 /begin IF_DATA XCP
  /begin DAQ_EVENT FIXED_EVENT_LIST EVENT 0x0 /end DAQ_EVENT
 /end IF_DATA
/end MEASUREMENT
/begin COMPU_METHOD channel_43_COMPU_METHOD "" LINEAR "%6.3" "" COEFFS_LINEAR 1 0 /end COMPU_METHOD
/begin MEASUREMENT channel_43 "channel_43" FLOAT64_IEEE channel_43_COMPU_METHOD 0 0 -1E12 1E12 ECU_ADDRESS 0x70850
 /begin IF_DATA XCP
  /begin DAQ_EVENT FIXED_EVENT_LIST EVENT 0x0 /end DAQ_EVENT
 /end IF_DATA
/end MEASUREMENT
/begin COMPU_METHOD channel_44_COMPU_METHOD "" LINEAR "%6.3" "" COEFFS_LINEAR 1 0 /end COMPU_METHOD
/begin MEASUREMENT channel_44 "channel_44" FLOAT64_IEEE channel_44_COMPU_METHOD 0 0 -1E12 1E12 ECU_ADDRESS 0x70858
 /begin IF_DATA XCP
  /begin DAQ_EVENT FIXED_EVENT_LIST EVENT 0x0 /end DAQ_EVENT
 /end IF_DATA
/end MEASUREMENT
/begin COMPU_METHOD channel_45_COMPU_METHOD "" LINEAR "%6.3" "" COEFFS_LINEAR 1 0 /end COMPU_METHOD
/begin MEASUREMENT channel_45 "channel_45" FLOAT64_IEEE channel_45_COMPU_METHOD 0 0 -1E12 1E12 ECU_ADDRESS 0x70860
 /begin IF_DATA XCP
  /begin DAQ_EVENT FIXED_EVENT_LIST EVENT 0x0 /end DAQ_EVENT
 /end IF_DATA
/end MEASUREMENT
/begin COMPU_METHOD channel_46_COMPU_METHOD "" LINEAR "%6.3" "" COEFFS_LINEAR 1 0 /end COMPU_METHOD
/begin MEASUREMENT channel_46 "channel_46" FLOAT64_IEEE channel_46_COMPU_METHOD 0 0 -1E12 1E12 ECU_ADDRESS 0x70868
 /begin IF_DATA XCP
  /begin DAQ_EVENT FIXED_EVENT_LIST EVENT 0x0 /end DAQ_EVENT
 /end IF_DATA
/end MEASUREMENT
/begin COMPU_METHOD channel_47_COMPU_METHOD "" LINEAR "%6.3" "" COEFFS_LINEAR 1 0 /end COMPU_METHOD
/begin MEASUREMENT channel_47 "channel_47" FLOAT64_IEEE channel_47_COMPU_METHOD 0 0 -1E12 1E12 ECU_ADDRESS 0x70870
 /begin IF_DATA XCP
  /begin DAQ_EVENT FIXED_EVENT_LIST EVENT 0x0 /end DAQ_EVENT
 /end IF_DATA
/end MEASUREMENT
/begin COMPU_METHOD channel_48_COMPU_METHOD "" LINEAR "%6.3" "" COEFFS_LINEAR 1 0 /end COMPU_METHOD
/begin MEASUREMENT channel_48 "channel_48" FLOAT64_IEEE channel_48_COMPU_METHOD 0 0 -1E12 1E12 ECU_ADDRESS 0x70878
 /begin IF_DATA XCP
  /begin DAQ_EVENT FIXED_EVENT_LIST EVENT 0x0 /end DAQ_EVENT
 /end IF_DATA
/end MEASUREMENT
/begin COMPU_METHOD channel_49_COMPU_METHOD "" LINEAR "%6.3" "" COEFFS_LINEAR 1 0 /end COMPU_METHOD
/begin MEASUREMENT channel_49 "channel_49" FLOAT64_IEEE channel_49_COMPU_METHOD 0 0 -1E12 1E12 ECU_ADDRESS 0x70880
 /begin IF_DATA XCP
  /begin DAQ_EVENT FIXED_EVENT_LIST EVENT 0x0 /end DAQ_EVENT
 /end IF_DATA
/end MEASUREMENT
/begin COMPU_METHOD channel_50_COMPU_METHOD "" LINEAR "%6.3" "" COEFFS_LINEAR 1 0 /end COMPU_METHOD
/begin MEASUREMENT channel_50 "channel_50" FLOAT64_IEEE channel_50_COMPU_METHOD 0 0 -1E12 1E12 ECU_ADDRESS 0x70888
 /begin IF_DATA XCP
  /begin DAQ_EVENT FIXED_EVENT_LIST EVENT 0x0 /end DAQ_EVENT
 /end IF_DATA
/end MEASUREMENT
/begin COMPU_METHOD channel_51_COMPU_METHOD "" LINEAR "%6.3" "" COEFFS_LINEAR 1 0 /end COMPU_METHOD
/begin MEASUREMENT channel_51 "channel_51" FLOAT64_IEEE channel_51_COMPU_METHOD 0 0 -1E12 1E12 ECU_ADDRESS 0x70890
 /begin IF_DATA XCP
  /begin DAQ_EVENT FIXED_EVENT_LIST EVENT 0x0 /end DAQ_EVENT
 /end IF_DATA
/end MEASUREMENT
/begin COMPU_METHOD channel_52_COMPU_METHOD "" LINEAR "%6.3" "" COEFFS_LINEAR 1 0 /end COMPU_METHOD
/begin MEASUREMENT channel_52 "channel_52" FLOAT64_IEEE channel_52_COMPU_METHOD 0 0 -1E12 1E12 ECU_ADDRESS 0x70898
 /begin IF_DATA XCP
  /begin DAQ_EVENT FIXED_EVENT_LIST EVENT 0x0 /end DAQ_EVENT
 /end IF_DATA
/end MEASUREMENT
/begin COMPU_METHOD channel_53_COMPU_METHOD "" LINEAR "%6.3" "" COEFFS_LINEAR 1 0 /end COMPU_METHOD
/begin MEASUREMENT channel_53 "channel_53" FLOAT64_IEEE channel_53_COMPU_METHOD 0 0 -1E12 1E12 ECU_ADDRESS 0x708A0
 /begin IF_DATA XCP
  /begin DAQ_EVENT FIXED_EVENT_LIST EVENT 0x0 /end DAQ_EVENT
 /end IF_DATA
/end MEASUREMENT
/begin COMPU_METHOD channel_54_COMPU_METHOD "" LINEAR "%6.3" "" COEFFS_LINEAR 1 0 /end COMPU_METHOD
/begin MEASUREMENT channel_54 "channel_54" FLOAT64_IEEE channel_54_COMPU_METHOD 0 0 -1E12 1E12 ECU_ADDRESS 0x708A8
 /begin IF_DATA XCP
  /begin DAQ_EVENT FIXED_EVENT_LIST EVENT 0x0 /end DAQ_EVENT
 /end IF_DATA
/end MEASUREMENT
/begin COMPU_METHOD channel_55_COMPU_METHOD "" LINEAR "%6.3" "" COEFFS_LINEAR 1 0 /end COMPU_METHOD
/begin MEASUREMENT channel_55 "channel_55" FLOAT64_IEEE channel_55_COMPU_METHOD 0 0 -1E12 1E12 ECU_ADDRESS 0x708B0
 /begin IF_DATA XCP
  /begin DAQ_EVENT FIXED_EVENT_LIST EVENT 0x0 /end DAQ_EVENT
 /end IF_DATA
/end MEASUREMENT
/begin COMPU_METHOD channel_56_COMPU_METHOD "" LINEAR "%6.3" "" COEFFS_LINEAR 1 0 /end COMPU_METHOD
/begin MEASUREMENT channel_56 "channel_56" FLOAT64_IEEE channel_56_COMPU_METHOD 0 0 -1E12 1E12 ECU_ADDRESS 0x708B8
 /begin IF_DATA XCP
  /begin DAQ_EVENT FIXED_EVENT_LIST EVENT 0x0 /end DAQ_EVENT
 /end IF_DATA
/end MEASUREMENT
/begin COMPU_METHOD channel_57_COMPU_METHOD "" LINEAR "%6.3" "" COEFFS_LINEAR 1 0 /end COMPU_METHOD
/begin MEASUREMENT channel_57 "channel_57" FLOAT64_IEEE channel_57_COMPU_METHOD 0 0 -1E12 1E12 ECU_ADDRESS 0x708C0
 /begin IF_DATA XCP
  /begin DAQ_EVENT FIXED_EVENT_LIST EVENT 0x0 /end DAQ_EVENT
 /end IF_DATA
/end MEASUREMENT
/begin COMPU_METHOD channel_58_COMPU_METHOD "" LINEAR "%6.3" "" COEFFS_LINEAR 1 0 /end COMPU_METHOD
/begin MEASUREMENT channel_58 "channel_58" FLOAT64_IEEE channel_58_COMPU_METHOD 0 0 -1E12 1E12 ECU_ADDRESS 0x708C8
 /begin IF_DATA XCP
  /begin DAQ_EVENT FIXED_EVENT_LIST EVENT 0x0 /end DAQ_EVENT
 /end IF_DATA
/end MEASUREMENT
/begin COMPU_METHOD channel_59_COMPU_METHOD "" LINEAR "%6.3" "" COEFFS_LINEAR 1 0 /end COMPU_METHOD
/begin MEASUREMENT channel_59 "channel_59" FLOAT64_IEEE channel_59_COMPU_METHOD 0 0 -1E12 1E12 ECU_ADDRESS 0x708D0
 /begin IF_DATA XCP
  /begin DAQ_EVENT FIXED_EVENT_LIST EVENT 0x0 /end DAQ_EVENT
 /end IF_DATA
/end MEASUREMENT
/begin COMPU_METHOD channel_60_COMPU_METHOD "" LINEAR "%6.3" "" COEFFS_LINEAR 1 0 /end COMPU_METHOD
/begin MEASUREMENT channel_60 "channel_60" FLOAT64_IEEE channel_60_COMPU_METHOD 0 0 -1E12 1E12 ECU_ADDRESS 0x708D8
 /begin IF_DATA XCP
  /begin DAQ_EVENT FIXED_EVENT_LIST EVENT 0x0 /end DAQ_EVENT
 /end IF_DATA
/end MEASUREMENT
/begin COMPU_METHOD channel_61_COMPU_METHOD "" LINEAR "%6.3" "" COEFFS_LINEAR 1 0 /end COMPU_METHOD
/begin MEASUREMENT channel_61 "channel_61" FLOAT64_IEEE channel_61_COMPU_METHOD 0 0 -1E12 1E12 ECU_ADDRESS 0x708E0
 /begin IF_DATA XCP
  /begin DAQ_EVENT FIXED_EVENT_LIST EVENT 0x0 /end DAQ_EVENT
 /end IF_DATA
/end MEASUREMENT
/begin COMPU_METHOD channel_62_COMPU_METHOD "" LINEAR "%6.3" "" COEFFS_LINEAR 1 0 /end COMPU_METHOD
/begin MEASUREMENT channel_62 "channel_62" FLOAT64_IEEE channel_62_COMPU_METHOD 0 0 -1E12 1E12 ECU_ADDRESS 0x708E8
 /begin IF_DATA XCP
  /begin DAQ_EVENT FIXED_EVENT_LIST EVENT 0x0 /end DAQ_EVENT
 /end IF_DATA
/end MEASUREMENT
/begin COMPU_METHOD channel_63_COMPU_METHOD "" LINEAR "%6.3" "" COEFFS_LINEAR 1 0 /end COMPU_METHOD
/begin MEASUREMENT channel_63 "channel_63" FLOAT64_IEEE channel_63_COMPU_METHOD 0 0 -1E12 1E12 ECU_ADDRESS 0x708F0
 /begin IF_DATA XCP
  /begin DAQ_EVENT FIXED_EVENT_LIST EVENT 0x0 /end DAQ_EVENT
 /end IF_DATA
/end MEASUREMENT
/begin COMPU_METHOD channel_64_COMPU_METHOD "" LINEAR "%6.3" "" COEFFS_LINEAR 1 0 /end COMPU_METHOD
/begin MEASUREMENT channel_64 "channel_64" FLOAT64_IEEE channel_64_COMPU_METHOD 0 0 -1E12 1E12 ECU_ADDRESS 0x708F8
 /begin IF_DATA XCP
  /begin DAQ_EVENT FIXED_EVENT_LIST EVENT 0x0 /end DAQ_EVENT
 /end IF_DATA
/end MEASUREMENT
/begin COMPU_METHOD channel_65_COMPU_METHOD "" LINEAR "%6.3" "" COEFFS_LINEAR 1 0 /end COMPU_METHOD
/begin MEASUREMENT channel_65 "channel_65" FLOAT64_IEEE channel_65_COMPU_METHOD 0 0 -1E12 1E12 ECU_ADDRESS 0x70900
 /begin IF_DATA XCP
  /begin DAQ_EVENT FIXED_EVENT_LIST EVENT 0x0 /end DAQ_EVENT
 /end IF_DATA
/end MEASUREMENT
/begin COMPU_METHOD channel_66_COMPU_METHOD "" LINEAR "%6.3" "" COEFFS_LINEAR 1 0 /end COMPU_METHOD
/begin MEASUREMENT channel_66 "channel_66" FLOAT64_IEEE channel_66_COMPU_METHOD 0 0 -1E12 1E12 ECU_ADDRESS 0x70908
 /begin IF_DATA XCP
  /begin DAQ_EVENT FIXED_EVENT_LIST EVENT 0x0 /end DAQ_EVENT
 /end IF_DATA
/end MEASUREMENT
/begin COMPU_METHOD channel_67_COMPU_METHOD "" LINEAR "%6.3" "" COEFFS_LINEAR 1 0 /end COMPU_METHOD
/begin MEASUREMENT channel_67 "channel_67" FLOAT64_IEEE channel_67_COMPU_METHOD 0 0 -1E12 1E12 ECU_ADDRESS 0x70910
 /begin IF_DATA XCP
  /begin DAQ_EVENT FIXED_EVENT_LIST EVENT 0x0 /end DAQ_EVENT
 /end IF_DATA
/end MEASUREMENT
/begin COMPU_METHOD channel_68_COMPU_METHOD "" LINEAR "%6.3" "" COEFFS_LINEAR 1 0 /end COMPU_METHOD
/begin MEASUREMENT channel_68 "channel_68" FLOAT64_IEEE channel_68_COMPU_METHOD 0 0 -1E12 1E12 ECU_ADDRESS 0x70918
 /begin IF_DATA XCP
  /begin DAQ_EVENT FIXED_EVENT_LIST EVENT 0x0 /end DAQ_EVENT
 /end IF_DATA
/end MEASUREMENT
/begin COMPU_METHOD channel_69_COMPU_METHOD "" LINEAR "%6.3" "" COEFFS_LINEAR 1 0 /end COMPU_METHOD
/begin MEASUREMENT channel_69 "channel_69" FLOAT64_IEEE channel_69_COMPU_METHOD 0 0 -1E12 1E12 ECU_ADDRESS 0x70920
 /begin IF_DATA XCP
  /begin DAQ_EVENT FIXED_EVENT_LIST EVENT 0x0 /end DAQ_EVENT
 /end IF_DATA
/end MEASUREMENT
/begin COMPU_METHOD channel_70_COMPU_METHOD "" LINEAR "%6.3" "" COEFFS_LINEAR 1 0 /end COMPU_METHOD
/begin MEASUREMENT channel_70 "channel_70" FLOAT64_IEEE channel_70_COMPU_METHOD 0 0 -1E12 1E12 ECU_ADDRESS 0x70928
 /begin IF_DATA XCP
  /begin DAQ_EVENT FIXED_EVENT_LIST EVENT 0x0 /end DAQ_EVENT
 /end IF_DATA
/end MEASUREMENT
/begin COMPU_METHOD channel_71_COMPU_METHOD "" LINEAR "%6.3" "" COEFFS_LINEAR 1 0 /end COMPU_METHOD
/begin MEASUREMENT channel_71 "channel_71" FLOAT64_IEEE channel_71_COMPU_METHOD 0 0 -1E12 1E12 ECU_ADDRESS 0x70930
 /begin IF_DATA XCP
  /begin DAQ_EVENT FIXED_EVENT_LIST EVENT 0x0 /end DAQ_EVENT
 /end IF_DATA
/end MEASUREMENT
/begin COMPU_METHOD channel_72_COMPU_METHOD "" LINEAR "%6.3" "" COEFFS_LINEAR 1 0 /end COMPU_METHOD
/begin MEASUREMENT channel_72 "channel_72" FLOAT64_IEEE channel_72_COMPU_METHOD 0 0 -1E12 1E12 ECU_ADDRESS 0x70938
 /begin IF_DATA XCP
  /begin DAQ_EVENT FIXED_EVENT_LIST EVENT 0x0 /end DAQ_EVENT
 /end IF_DATA
/end MEASUREMENT
/begin COMPU_METHOD channel_73_COMPU_METHOD "" LINEAR "%6.3" "" COEFFS_LINEAR 1 0 /end COMPU_METHOD
/begin MEASUREMENT channel_73 "channel_73" FLOAT64_IEEE channel_73_COMPU_METHOD 0 0 -1E12 1E12 ECU_ADDRESS 0x70940
 /begin IF_DATA XCP
  /begin DAQ_EVENT FIXED_EVENT_LIST EVENT 0x0 /end DAQ_EVENT
 /end IF_DATA
/end MEASUREMENT
/begin COMPU_METHOD channel_74_COMPU_METHOD "" LINEAR "%6.3" "" COEFFS_LINEAR 1 0 /end COMPU_METHOD
/begin MEASUREMENT channel_74 "channel_74" FLOAT64_IEEE channel_74_COMPU_METHOD 0 0 -1E12 1E12 ECU_ADDRESS 0x70948
 /begin IF_DATA XCP
  /begin DAQ_EVENT FIXED_EVENT_LIST EVENT 0x0 /end DAQ_EVENT
 /end IF_DATA
/end MEASUREMENT
/begin COMPU_METHOD channel_75_COMPU_METHOD "" LINEAR "%6.3" "" COEFFS_LINEAR 1 0 /end COMPU_METHOD
/begin MEASUREMENT channel_75 "channel_75" FLOAT64_IEEE channel_75_COMPU_METHOD 0 0 -1E12 1E12 ECU_ADDRESS 0x70950
 /begin IF_DATA XCP
  /begin DAQ_EVENT FIXED_EVENT_LIST EVENT 0x0 /end DAQ_EVENT
 /end IF_DATA
/end MEASUREMENT
/begin COMPU_METHOD channel_76_COMPU_METHOD "" LINEAR "%6.3" "" COEFFS_LINEAR 1 0 /end COMPU_METHOD
/begin MEASUREMENT channel_76 "channel_76" FLOAT64_IEEE channel_76_COMPU_METHOD 0 0 -1E12 1E12 ECU_ADDRESS 0x70958
 /begin IF_DATA XCP
  /begin DAQ_EVENT FIXED_EVENT_LIST EVENT 0x0 /end DAQ_EVENT
 /end IF_DATA
/end MEASUREMENT
/begin COMPU_METHOD channel_77_COMPU_METHOD "" LINEAR "%6.3" "" COEFFS_LINEAR 1 0 /end COMPU_METHOD
/begin MEASUREMENT channel_77 "channel_77" FLOAT64_IEEE channel_77_COMPU_METHOD 0 0 -1E12 1E12 ECU_ADDRESS 0x70960
 /begin IF_DATA XCP
  /begin DAQ_EVENT FIXED_EVENT_LIST EVENT 0x0 /end DAQ_EVENT
 /end IF_DATA
/end MEASUREMENT
/begin COMPU_METHOD channel_78_COMPU_METHOD "" LINEAR "%6.3" "" COEFFS_LINEAR 1 0 /end COMPU_METHOD
/begin MEASUREMENT channel_78 "channel_78" FLOAT64_IEEE channel_78_COMPU_METHOD 0 0 -1E12 1E12 ECU_ADDRESS 0x70968
 /begin IF_DATA XCP
  /begin DAQ_EVENT FIXED_EVENT_LIST EVENT 0x0 /end DAQ_EVENT
 /end IF_DATA
/end MEASUREMENT
/begin COMPU_METHOD channel_79_COMPU_METHOD "" LINEAR "%6.3" "" COEFFS_LINEAR 1 0 /end COMPU_METHOD
/begin MEASUREMENT channel_79 "channel_79" FLOAT64_IEEE channel_79_COMPU_METHOD 0 0 -1E12 1E12 ECU_ADDRESS 0x70970
 /begin IF_DATA XCP
  /begin DAQ_EVENT FIXED_EVENT_LIST EVENT 0x0 /end DAQ_EVENT
 /end IF_DATA
/end MEASUREMENT
/begin COMPU_METHOD channel_80_COMPU_METHOD "" LINEAR "%6.3" "" COEFFS_LINEAR 1 0 /end COMPU_METHOD
/begin MEASUREMENT channel_80 "channel_80" FLOAT64_IEEE channel_80_COMPU_METHOD 0 0 -1E12 1E12 ECU_ADDRESS 0x70978
 /begin IF_DATA XCP
  /begin DAQ_EVENT FIXED_EVENT_LIST EVENT 0x0 /end DAQ_EVENT
 /end IF_DATA
/end MEASUREMENT
/begin GROUP observed_channel ""
 /begin REF_MEASUREMENT channel_01 channel_02 channel_03 channel_04 channel_05 channel_06 channel_07 channel_08 channel_09 channel_10 channel_11 channel_12 channel_13 channel_14 channel_15 channel_16 channel_17 channel_18 channel_19 channel_20 channel_21 channel_22 channel_23 channel_24 channel_25 channel_26 channel_27 channel_28 channel_29 channel_30 channel_31 channel_32 channel_33 channel_34 channel_35 channel_36 channel_37 channel_38 channel_39 channel_40 channel_41 channel_42 channel_43 channel_44 channel_45 channel_46 channel_47 channel_48 channel_49 channel_50 channel_51 channel_52 channel_53 channel_54 channel_55 channel_56 channel_57 channel_58 channel_59 channel_60 channel_61 channel_62 channel_63 channel_64 channel_65 channel_66 channel_67 channel_68 channel_69 channel_70 channel_71 channel_72 channel_73 channel_74 channel_75 channel_76 channel_77 channel_78 channel_79 channel_80 /end REF_MEASUREMENT
/end GROUP
/begin COMPU_METHOD wr.00.pos_cmd_COMPU_METHOD "" LINEAR "%6.3" "" COEFFS_LINEAR 1 0 /end COMPU_METHOD
/begin MEASUREMENT wr.00.pos_cmd "pos_cmd" FLOAT64_IEEE wr.00.pos_cmd_COMPU_METHOD 0 0 -1E12 1E12 ECU_ADDRESS 0x70980
 /begin IF_DATA XCP
  /begin DAQ_EVENT FIXED_EVENT_LIST EVENT 0x0 /end DAQ_EVENT
 /end IF_DATA
/end MEASUREMENT
/begin COMPU_METHOD wr.00.vel_cmd_COMPU_METHOD "" LINEAR "%6.3" "" COEFFS_LINEAR 1 0 /end COMPU_METHOD
/begin MEASUREMENT wr.00.vel_cmd "vel_cmd" FLOAT64_IEEE wr.00.vel_cmd_COMPU_METHOD 0 0 -1E12 1E12 ECU_ADDRESS 0x70988
 /begin IF_DATA XCP
  /begin DAQ_EVENT FIXED_EVENT_LIST EVENT 0x0 /end DAQ_EVENT
 /end IF_DATA
/end MEASUREMENT
/begin COMPU_METHOD wr.00.torque_cmd_COMPU_METHOD "" LINEAR "%6.3" "" COEFFS_LINEAR 1 0 /end COMPU_METHOD
/begin MEASUREMENT wr.00.torque_cmd "torque_cmd" FLOAT64_IEEE wr.00.torque_cmd_COMPU_METHOD 0 0 -1E12 1E12 ECU_ADDRESS 0x70990
 /begin IF_DATA XCP
  /begin DAQ_EVENT FIXED_EVENT_LIST EVENT 0x0 /end DAQ_EVENT
 /end IF_DATA
/end MEASUREMENT
/begin COMPU_METHOD wr.00.current_cmd_COMPU_METHOD "" LINEAR "%6.3" "" COEFFS_LINEAR 1 0 /end COMPU_METHOD
/begin MEASUREMENT wr.00.current_cmd "current_cmd" FLOAT64_IEEE wr.00.current_cmd_COMPU_METHOD 0 0 -1E12 1E12 ECU_ADDRESS 0x70998
 /begin IF_DATA XCP
  /begin DAQ_EVENT FIXED_EVENT_LIST EVENT 0x0 /end DAQ_EVENT
 /end IF_DATA
/end MEASUREMENT
/begin COMPU_METHOD wr.00.velocity_COMPU_METHOD "" LINEAR "%6.3" "" COEFFS_LINEAR 1 0 /end COMPU_METHOD
/begin MEASUREMENT wr.00.velocity "velocity" FLOAT64_IEEE wr.00.velocity_COMPU_METHOD 0 0 -1E12 1E12 ECU_ADDRESS 0x709A0
 /begin IF_DATA XCP
  /begin DAQ_EVENT FIXED_EVENT_LIST EVENT 0x0 /end DAQ_EVENT
 /end IF_DATA
/end MEASUREMENT
/begin COMPU_METHOD wr.00.max_velocity_COMPU_METHOD "" LINEAR "%6.3" "" COEFFS_LINEAR 1 0 /end COMPU_METHOD
/begin MEASUREMENT wr.00.max_velocity "max_velocity" FLOAT64_IEEE wr.00.max_velocity_COMPU_METHOD 0 0 -1E12 1E12 ECU_ADDRESS 0x709A8
 /begin IF_DATA XCP
  /begin DAQ_EVENT FIXED_EVENT_LIST EVENT 0x0 /end DAQ_EVENT
 /end IF_DATA
/end MEASUREMENT
/begin COMPU_METHOD wr.00.acceleration_COMPU_METHOD "" LINEAR "%6.3" "" COEFFS_LINEAR 1 0 /end COMPU_METHOD
/begin MEASUREMENT wr.00.acceleration "acceleration" FLOAT64_IEEE wr.00.acceleration_COMPU_METHOD 0 0 -1E12 1E12 ECU_ADDRESS 0x709B0
 /begin IF_DATA XCP
  /begin DAQ_EVENT FIXED_EVENT_LIST EVENT 0x0 /end DAQ_EVENT
 /end IF_DATA
/end MEASUREMENT
/begin COMPU_METHOD wr.00.deceleration_COMPU_METHOD "" LINEAR "%6.3" "" COEFFS_LINEAR 1 0 /end COMPU_METHOD
/begin MEASUREMENT wr.00.deceleration "deceleration" FLOAT64_IEEE wr.00.deceleration_COMPU_METHOD 0 0 -1E12 1E12 ECU_ADDRESS 0x709B8
 /begin IF_DATA XCP
  /begin DAQ_EVENT FIXED_EVENT_LIST EVENT 0x0 /end DAQ_EVENT
 /end IF_DATA
/end MEASUREMENT
/begin COMPU_METHOD wr.00.KP_COMPU_METHOD "" LINEAR "%6.3" "" COEFFS_LINEAR 1 0 /end COMPU_METHOD
/begin MEASUREMENT wr.00.KP "KP" FLOAT64_IEEE wr.00.KP_COMPU_METHOD 0 0 -1E12 1E12 ECU_ADDRESS 0x709C0
 /begin IF_DATA XCP
  /begin DAQ_EVENT FIXED_EVENT_LIST EVENT 0x0 /end DAQ_EVENT
 /end IF_DATA
/end MEASUREMENT
/begin COMPU_METHOD wr.00.KD_COMPU_METHOD "" LINEAR "%6.3" "" COEFFS_LINEAR 1 0 /end COMPU_METHOD
/begin MEASUREMENT wr.00.KD "KD" FLOAT64_IEEE wr.00.KD_COMPU_METHOD 0 0 -1E12 1E12 ECU_ADDRESS 0x709C8
 /begin IF_DATA XCP
  /begin DAQ_EVENT FIXED_EVENT_LIST EVENT 0x0 /end DAQ_EVENT
 /end IF_DATA
/end MEASUREMENT
/begin COMPU_METHOD wr.00.enable_COMPU_METHOD "" LINEAR "%6.3" "" COEFFS_LINEAR 1 0 /end COMPU_METHOD
/begin MEASUREMENT wr.00.enable "enable" SBYTE wr.00.enable_COMPU_METHOD 0 0 -128 127 ECU_ADDRESS 0x709D0
 /begin IF_DATA XCP
  /begin DAQ_EVENT FIXED_EVENT_LIST EVENT 0x0 /end DAQ_EVENT
 /end IF_DATA
/end MEASUREMENT
/begin COMPU_METHOD wr.00.operation_mode_COMPU_METHOD "" LINEAR "%6.3" "" COEFFS_LINEAR 1 0 /end COMPU_METHOD
/begin MEASUREMENT wr.00.operation_mode "operation_mode" SBYTE wr.00.operation_mode_COMPU_METHOD 0 0 -128 127 ECU_ADDRESS 0x709D1
 /begin IF_DATA XCP
  /begin DAQ_EVENT FIXED_EVENT_LIST EVENT 0x0 /end DAQ_EVENT
 /end IF_DATA
/end MEASUREMENT
/begin COMPU_METHOD wr.00.polarity_COMPU_METHOD "" LINEAR "%6.3" "" COEFFS_LINEAR 1 0 /end COMPU_METHOD
/begin MEASUREMENT wr.00.polarity "polarity" UBYTE wr.00.polarity_COMPU_METHOD 0 0 0 255 ECU_ADDRESS 0x709D2
 /begin IF_DATA XCP
  /begin DAQ_EVENT FIXED_EVENT_LIST EVENT 0x0 /end DAQ_EVENT
 /end IF_DATA
/end MEASUREMENT
/begin GROUP joints_cmd.00.wr ""
 /begin REF_MEASUREMENT wr.00.pos_cmd wr.00.vel_cmd wr.00.torque_cmd wr.00.current_cmd wr.00.velocity wr.00.max_velocity wr.00.acceleration wr.00.deceleration wr.00.KP wr.00.KD wr.00.enable wr.00.operation_mode wr.00.polarity /end REF_MEASUREMENT
/end GROUP
/begin COMPU_METHOD wr.00.pos_fb_COMPU_METHOD "" LINEAR "%6.3" "" COEFFS_LINEAR 1 0 /end COMPU_METHOD
/begin MEASUREMENT wr.00.pos_fb "pos_fb" FLOAT64_IEEE wr.00.pos_fb_COMPU_METHOD 0 0 -1E12 1E12 ECU_ADDRESS 0x6FB18
 /begin IF_DATA XCP
  /begin DAQ_EVENT FIXED_EVENT_LIST EVENT 0x0 /end DAQ_EVENT
 /end IF_DATA
/end MEASUREMENT
/begin COMPU_METHOD wr.00.vel_fb_COMPU_METHOD "" LINEAR "%6.3" "" COEFFS_LINEAR 1 0 /end COMPU_METHOD
/begin MEASUREMENT wr.00.vel_fb "vel_fb" FLOAT64_IEEE wr.00.vel_fb_COMPU_METHOD 0 0 -1E12 1E12 ECU_ADDRESS 0x6FB20
 /begin IF_DATA XCP
  /begin DAQ_EVENT FIXED_EVENT_LIST EVENT 0x0 /end DAQ_EVENT
 /end IF_DATA
/end MEASUREMENT
/begin COMPU_METHOD wr.00.torque_fb_COMPU_METHOD "" LINEAR "%6.3" "" COEFFS_LINEAR 1 0 /end COMPU_METHOD
/begin MEASUREMENT wr.00.torque_fb "torque_fb" FLOAT64_IEEE wr.00.torque_fb_COMPU_METHOD 0 0 -1E12 1E12 ECU_ADDRESS 0x6FB28
 /begin IF_DATA XCP
  /begin DAQ_EVENT FIXED_EVENT_LIST EVENT 0x0 /end DAQ_EVENT
 /end IF_DATA
/end MEASUREMENT
/begin COMPU_METHOD wr.00.current_fb_COMPU_METHOD "" LINEAR "%6.3" "" COEFFS_LINEAR 1 0 /end COMPU_METHOD
/begin MEASUREMENT wr.00.current_fb "current_fb" FLOAT64_IEEE wr.00.current_fb_COMPU_METHOD 0 0 -1E12 1E12 ECU_ADDRESS 0x6FB30
 /begin IF_DATA XCP
  /begin DAQ_EVENT FIXED_EVENT_LIST EVENT 0x0 /end DAQ_EVENT
 /end IF_DATA
/end MEASUREMENT
/begin COMPU_METHOD wr.00.motor_temper_COMPU_METHOD "" LINEAR "%6.3" "" COEFFS_LINEAR 1 0 /end COMPU_METHOD
/begin MEASUREMENT wr.00.motor_temper "motor_temper" FLOAT64_IEEE wr.00.motor_temper_COMPU_METHOD 0 0 -1E12 1E12 ECU_ADDRESS 0x6FB38
 /begin IF_DATA XCP
  /begin DAQ_EVENT FIXED_EVENT_LIST EVENT 0x0 /end DAQ_EVENT
 /end IF_DATA
/end MEASUREMENT
/begin COMPU_METHOD wr.00.min_soft_position_limit_COMPU_METHOD "" LINEAR "%6.3" "" COEFFS_LINEAR 1 0 /end COMPU_METHOD
/begin MEASUREMENT wr.00.min_soft_position_limit "min_soft_position_limit" FLOAT64_IEEE wr.00.min_soft_position_limit_COMPU_METHOD 0 0 -1E12 1E12 ECU_ADDRESS 0x6FB40
 /begin IF_DATA XCP
  /begin DAQ_EVENT FIXED_EVENT_LIST EVENT 0x0 /end DAQ_EVENT
 /end IF_DATA
/end MEASUREMENT
/begin COMPU_METHOD wr.00.max_soft_position_limit_COMPU_METHOD "" LINEAR "%6.3" "" COEFFS_LINEAR 1 0 /end COMPU_METHOD
/begin MEASUREMENT wr.00.max_soft_position_limit "max_soft_position_limit" FLOAT64_IEEE wr.00.max_soft_position_limit_COMPU_METHOD 0 0 -1E12 1E12 ECU_ADDRESS 0x6FB48
 /begin IF_DATA XCP
  /begin DAQ_EVENT FIXED_EVENT_LIST EVENT 0x0 /end DAQ_EVENT
 /end IF_DATA
/end MEASUREMENT
/begin COMPU_METHOD wr.00.max_profile_velocity_COMPU_METHOD "" LINEAR "%6.3" "" COEFFS_LINEAR 1 0 /end COMPU_METHOD
/begin MEASUREMENT wr.00.max_profile_velocity "max_profile_velocity" FLOAT64_IEEE wr.00.max_profile_velocity_COMPU_METHOD 0 0 -1E12 1E12 ECU_ADDRESS 0x6FB50
 /begin IF_DATA XCP
  /begin DAQ_EVENT FIXED_EVENT_LIST EVENT 0x0 /end DAQ_EVENT
 /end IF_DATA
/end MEASUREMENT
/begin COMPU_METHOD wr.00.voltage_COMPU_METHOD "" LINEAR "%6.3" "" COEFFS_LINEAR 1 0 /end COMPU_METHOD
/begin MEASUREMENT wr.00.voltage "voltage" FLOAT64_IEEE wr.00.voltage_COMPU_METHOD 0 0 -1E12 1E12 ECU_ADDRESS 0x6FB60
 /begin IF_DATA XCP
  /begin DAQ_EVENT FIXED_EVENT_LIST EVENT 0x0 /end DAQ_EVENT
 /end IF_DATA
/end MEASUREMENT
/begin COMPU_METHOD wr.00.enabled_COMPU_METHOD "" LINEAR "%6.3" "" COEFFS_LINEAR 1 0 /end COMPU_METHOD
/begin MEASUREMENT wr.00.enabled "enabled" SBYTE wr.00.enabled_COMPU_METHOD 0 0 -128 127 ECU_ADDRESS 0x6FB58
 /begin IF_DATA XCP
  /begin DAQ_EVENT FIXED_EVENT_LIST EVENT 0x0 /end DAQ_EVENT
 /end IF_DATA
/end MEASUREMENT
/begin COMPU_METHOD wr.00.error_COMPU_METHOD "" LINEAR "%6.3" "" COEFFS_LINEAR 1 0 /end COMPU_METHOD
/begin MEASUREMENT wr.00.error "error" SBYTE wr.00.error_COMPU_METHOD 0 0 -128 127 ECU_ADDRESS 0x6FB59
 /begin IF_DATA XCP
  /begin DAQ_EVENT FIXED_EVENT_LIST EVENT 0x0 /end DAQ_EVENT
 /end IF_DATA
/end MEASUREMENT
/begin COMPU_METHOD wr.00.operation_mode_display_COMPU_METHOD "" LINEAR "%6.3" "" COEFFS_LINEAR 1 0 /end COMPU_METHOD
/begin MEASUREMENT wr.00.operation_mode_display "operation_mode_display" SBYTE wr.00.operation_mode_display_COMPU_METHOD 0 0 -128 127 ECU_ADDRESS 0x6FB5A
 /begin IF_DATA XCP
  /begin DAQ_EVENT FIXED_EVENT_LIST EVENT 0x0 /end DAQ_EVENT
 /end IF_DATA
/end MEASUREMENT
/begin GROUP joints_status.00.wr ""
 /begin REF_MEASUREMENT wr.00.pos_fb wr.00.vel_fb wr.00.torque_fb wr.00.current_fb wr.00.motor_temper wr.00.min_soft_position_limit wr.00.max_soft_position_limit wr.00.max_profile_velocity wr.00.voltage wr.00.enabled wr.00.error wr.00.operation_mode_display /end REF_MEASUREMENT
/end GROUP
/begin COMPU_METHOD wrb.01.pos_cmd_COMPU_METHOD "" LINEAR "%6.3" "" COEFFS_LINEAR 1 0 /end COMPU_METHOD
/begin MEASUREMENT wrb.01.pos_cmd "pos_cmd" FLOAT64_IEEE wrb.01.pos_cmd_COMPU_METHOD 0 0 -1E12 1E12 ECU_ADDRESS 0x709D8
 /begin IF_DATA XCP
  /begin DAQ_EVENT FIXED_EVENT_LIST EVENT 0x0 /end DAQ_EVENT
 /end IF_DATA
/end MEASUREMENT
/begin COMPU_METHOD wrb.01.vel_cmd_COMPU_METHOD "" LINEAR "%6.3" "" COEFFS_LINEAR 1 0 /end COMPU_METHOD
/begin MEASUREMENT wrb.01.vel_cmd "vel_cmd" FLOAT64_IEEE wrb.01.vel_cmd_COMPU_METHOD 0 0 -1E12 1E12 ECU_ADDRESS 0x709E0
 /begin IF_DATA XCP
  /begin DAQ_EVENT FIXED_EVENT_LIST EVENT 0x0 /end DAQ_EVENT
 /end IF_DATA
/end MEASUREMENT
/begin COMPU_METHOD wrb.01.torque_cmd_COMPU_METHOD "" LINEAR "%6.3" "" COEFFS_LINEAR 1 0 /end COMPU_METHOD
/begin MEASUREMENT wrb.01.torque_cmd "torque_cmd" FLOAT64_IEEE wrb.01.torque_cmd_COMPU_METHOD 0 0 -1E12 1E12 ECU_ADDRESS 0x709E8
 /begin IF_DATA XCP
  /begin DAQ_EVENT FIXED_EVENT_LIST EVENT 0x0 /end DAQ_EVENT
 /end IF_DATA
/end MEASUREMENT
/begin COMPU_METHOD wrb.01.current_cmd_COMPU_METHOD "" LINEAR "%6.3" "" COEFFS_LINEAR 1 0 /end COMPU_METHOD
/begin MEASUREMENT wrb.01.current_cmd "current_cmd" FLOAT64_IEEE wrb.01.current_cmd_COMPU_METHOD 0 0 -1E12 1E12 ECU_ADDRESS 0x709F0
 /begin IF_DATA XCP
  /begin DAQ_EVENT FIXED_EVENT_LIST EVENT 0x0 /end DAQ_EVENT
 /end IF_DATA
/end MEASUREMENT
/begin COMPU_METHOD wrb.01.velocity_COMPU_METHOD "" LINEAR "%6.3" "" COEFFS_LINEAR 1 0 /end COMPU_METHOD
/begin MEASUREMENT wrb.01.velocity "velocity" FLOAT64_IEEE wrb.01.velocity_COMPU_METHOD 0 0 -1E12 1E12 ECU_ADDRESS 0x709F8
 /begin IF_DATA XCP
  /begin DAQ_EVENT FIXED_EVENT_LIST EVENT 0x0 /end DAQ_EVENT
 /end IF_DATA
/end MEASUREMENT
/begin COMPU_METHOD wrb.01.max_velocity_COMPU_METHOD "" LINEAR "%6.3" "" COEFFS_LINEAR 1 0 /end COMPU_METHOD
/begin MEASUREMENT wrb.01.max_velocity "max_velocity" FLOAT64_IEEE wrb.01.max_velocity_COMPU_METHOD 0 0 -1E12 1E12 ECU_ADDRESS 0x70A00
 /begin IF_DATA XCP
  /begin DAQ_EVENT FIXED_EVENT_LIST EVENT 0x0 /end DAQ_EVENT
 /end IF_DATA
/end MEASUREMENT
/begin COMPU_METHOD wrb.01.acceleration_COMPU_METHOD "" LINEAR "%6.3" "" COEFFS_LINEAR 1 0 /end COMPU_METHOD
/begin MEASUREMENT wrb.01.acceleration "acceleration" FLOAT64_IEEE wrb.01.acceleration_COMPU_METHOD 0 0 -1E12 1E12 ECU_ADDRESS 0x70A08
 /begin IF_DATA XCP
  /begin DAQ_EVENT FIXED_EVENT_LIST EVENT 0x0 /end DAQ_EVENT
 /end IF_DATA
/end MEASUREMENT
/begin COMPU_METHOD wrb.01.deceleration_COMPU_METHOD "" LINEAR "%6.3" "" COEFFS_LINEAR 1 0 /end COMPU_METHOD
/begin MEASUREMENT wrb.01.deceleration "deceleration" FLOAT64_IEEE wrb.01.deceleration_COMPU_METHOD 0 0 -1E12 1E12 ECU_ADDRESS 0x70A10
 /begin IF_DATA XCP
  /begin DAQ_EVENT FIXED_EVENT_LIST EVENT 0x0 /end DAQ_EVENT
 /end IF_DATA
/end MEASUREMENT
/begin COMPU_METHOD wrb.01.KP_COMPU_METHOD "" LINEAR "%6.3" "" COEFFS_LINEAR 1 0 /end COMPU_METHOD
/begin MEASUREMENT wrb.01.KP "KP" FLOAT64_IEEE wrb.01.KP_COMPU_METHOD 0 0 -1E12 1E12 ECU_ADDRESS 0x70A18
 /begin IF_DATA XCP
  /begin DAQ_EVENT FIXED_EVENT_LIST EVENT 0x0 /end DAQ_EVENT
 /end IF_DATA
/end MEASUREMENT
/begin COMPU_METHOD wrb.01.KD_COMPU_METHOD "" LINEAR "%6.3" "" COEFFS_LINEAR 1 0 /end COMPU_METHOD
/begin MEASUREMENT wrb.01.KD "KD" FLOAT64_IEEE wrb.01.KD_COMPU_METHOD 0 0 -1E12 1E12 ECU_ADDRESS 0x70A20
 /begin IF_DATA XCP
  /begin DAQ_EVENT FIXED_EVENT_LIST EVENT 0x0 /end DAQ_EVENT
 /end IF_DATA
/end MEASUREMENT
/begin COMPU_METHOD wrb.01.enable_COMPU_METHOD "" LINEAR "%6.3" "" COEFFS_LINEAR 1 0 /end COMPU_METHOD
/begin MEASUREMENT wrb.01.enable "enable" SBYTE wrb.01.enable_COMPU_METHOD 0 0 -128 127 ECU_ADDRESS 0x70A28
 /begin IF_DATA XCP
  /begin DAQ_EVENT FIXED_EVENT_LIST EVENT 0x0 /end DAQ_EVENT
 /end IF_DATA
/end MEASUREMENT
/begin COMPU_METHOD wrb.01.operation_mode_COMPU_METHOD "" LINEAR "%6.3" "" COEFFS_LINEAR 1 0 /end COMPU_METHOD
/begin MEASUREMENT wrb.01.operation_mode "operation_mode" SBYTE wrb.01.operation_mode_COMPU_METHOD 0 0 -128 127 ECU_ADDRESS 0x70A29
 /begin IF_DATA XCP
  /begin DAQ_EVENT FIXED_EVENT_LIST EVENT 0x0 /end DAQ_EVENT
 /end IF_DATA
/end MEASUREMENT
/begin COMPU_METHOD wrb.01.polarity_COMPU_METHOD "" LINEAR "%6.3" "" COEFFS_LINEAR 1 0 /end COMPU_METHOD
/begin MEASUREMENT wrb.01.polarity "polarity" UBYTE wrb.01.polarity_COMPU_METHOD 0 0 0 255 ECU_ADDRESS 0x70A2A
 /begin IF_DATA XCP
  /begin DAQ_EVENT FIXED_EVENT_LIST EVENT 0x0 /end DAQ_EVENT
 /end IF_DATA
/end MEASUREMENT
/begin GROUP joints_cmd.01.wrb ""
 /begin REF_MEASUREMENT wrb.01.pos_cmd wrb.01.vel_cmd wrb.01.torque_cmd wrb.01.current_cmd wrb.01.velocity wrb.01.max_velocity wrb.01.acceleration wrb.01.deceleration wrb.01.KP wrb.01.KD wrb.01.enable wrb.01.operation_mode wrb.01.polarity /end REF_MEASUREMENT
/end GROUP
/begin COMPU_METHOD wrb.01.pos_fb_COMPU_METHOD "" LINEAR "%6.3" "" COEFFS_LINEAR 1 0 /end COMPU_METHOD
/begin MEASUREMENT wrb.01.pos_fb "pos_fb" FLOAT64_IEEE wrb.01.pos_fb_COMPU_METHOD 0 0 -1E12 1E12 ECU_ADDRESS 0x6FB68
 /begin IF_DATA XCP
  /begin DAQ_EVENT FIXED_EVENT_LIST EVENT 0x0 /end DAQ_EVENT
 /end IF_DATA
/end MEASUREMENT
/begin COMPU_METHOD wrb.01.vel_fb_COMPU_METHOD "" LINEAR "%6.3" "" COEFFS_LINEAR 1 0 /end COMPU_METHOD
/begin MEASUREMENT wrb.01.vel_fb "vel_fb" FLOAT64_IEEE wrb.01.vel_fb_COMPU_METHOD 0 0 -1E12 1E12 ECU_ADDRESS 0x6FB70
 /begin IF_DATA XCP
  /begin DAQ_EVENT FIXED_EVENT_LIST EVENT 0x0 /end DAQ_EVENT
 /end IF_DATA
/end MEASUREMENT
/begin COMPU_METHOD wrb.01.torque_fb_COMPU_METHOD "" LINEAR "%6.3" "" COEFFS_LINEAR 1 0 /end COMPU_METHOD
/begin MEASUREMENT wrb.01.torque_fb "torque_fb" FLOAT64_IEEE wrb.01.torque_fb_COMPU_METHOD 0 0 -1E12 1E12 ECU_ADDRESS 0x6FB78
 /begin IF_DATA XCP
  /begin DAQ_EVENT FIXED_EVENT_LIST EVENT 0x0 /end DAQ_EVENT
 /end IF_DATA
/end MEASUREMENT
/begin COMPU_METHOD wrb.01.current_fb_COMPU_METHOD "" LINEAR "%6.3" "" COEFFS_LINEAR 1 0 /end COMPU_METHOD
/begin MEASUREMENT wrb.01.current_fb "current_fb" FLOAT64_IEEE wrb.01.current_fb_COMPU_METHOD 0 0 -1E12 1E12 ECU_ADDRESS 0x6FB80
 /begin IF_DATA XCP
  /begin DAQ_EVENT FIXED_EVENT_LIST EVENT 0x0 /end DAQ_EVENT
 /end IF_DATA
/end MEASUREMENT
/begin COMPU_METHOD wrb.01.motor_temper_COMPU_METHOD "" LINEAR "%6.3" "" COEFFS_LINEAR 1 0 /end COMPU_METHOD
/begin MEASUREMENT wrb.01.motor_temper "motor_temper" FLOAT64_IEEE wrb.01.motor_temper_COMPU_METHOD 0 0 -1E12 1E12 ECU_ADDRESS 0x6FB88
 /begin IF_DATA XCP
  /begin DAQ_EVENT FIXED_EVENT_LIST EVENT 0x0 /end DAQ_EVENT
 /end IF_DATA
/end MEASUREMENT
/begin COMPU_METHOD wrb.01.min_soft_position_limit_COMPU_METHOD "" LINEAR "%6.3" "" COEFFS_LINEAR 1 0 /end COMPU_METHOD
/begin MEASUREMENT wrb.01.min_soft_position_limit "min_soft_position_limit" FLOAT64_IEEE wrb.01.min_soft_position_limit_COMPU_METHOD 0 0 -1E12 1E12 ECU_ADDRESS 0x6FB90
 /begin IF_DATA XCP
  /begin DAQ_EVENT FIXED_EVENT_LIST EVENT 0x0 /end DAQ_EVENT
 /end IF_DATA
/end MEASUREMENT
/begin COMPU_METHOD wrb.01.max_soft_position_limit_COMPU_METHOD "" LINEAR "%6.3" "" COEFFS_LINEAR 1 0 /end COMPU_METHOD
/begin MEASUREMENT wrb.01.max_soft_position_limit "max_soft_position_limit" FLOAT64_IEEE wrb.01.max_soft_position_limit_COMPU_METHOD 0 0 -1E12 1E12 ECU_ADDRESS 0x6FB98
 /begin IF_DATA XCP
  /begin DAQ_EVENT FIXED_EVENT_LIST EVENT 0x0 /end DAQ_EVENT
 /end IF_DATA
/end MEASUREMENT
/begin COMPU_METHOD wrb.01.max_profile_velocity_COMPU_METHOD "" LINEAR "%6.3" "" COEFFS_LINEAR 1 0 /end COMPU_METHOD
/begin MEASUREMENT wrb.01.max_profile_velocity "max_profile_velocity" FLOAT64_IEEE wrb.01.max_profile_velocity_COMPU_METHOD 0 0 -1E12 1E12 ECU_ADDRESS 0x6FBA0
 /begin IF_DATA XCP
  /begin DAQ_EVENT FIXED_EVENT_LIST EVENT 0x0 /end DAQ_EVENT
 /end IF_DATA
/end MEASUREMENT
/begin COMPU_METHOD wrb.01.voltage_COMPU_METHOD "" LINEAR "%6.3" "" COEFFS_LINEAR 1 0 /end COMPU_METHOD
/begin MEASUREMENT wrb.01.voltage "voltage" FLOAT64_IEEE wrb.01.voltage_COMPU_METHOD 0 0 -1E12 1E12 ECU_ADDRESS 0x6FBB0
 /begin IF_DATA XCP
  /begin DAQ_EVENT FIXED_EVENT_LIST EVENT 0x0 /end DAQ_EVENT
 /end IF_DATA
/end MEASUREMENT
/begin COMPU_METHOD wrb.01.enabled_COMPU_METHOD "" LINEAR "%6.3" "" COEFFS_LINEAR 1 0 /end COMPU_METHOD
/begin MEASUREMENT wrb.01.enabled "enabled" SBYTE wrb.01.enabled_COMPU_METHOD 0 0 -128 127 ECU_ADDRESS 0x6FBA8
 /begin IF_DATA XCP
  /begin DAQ_EVENT FIXED_EVENT_LIST EVENT 0x0 /end DAQ_EVENT
 /end IF_DATA
/end MEASUREMENT
/begin COMPU_METHOD wrb.01.error_COMPU_METHOD "" LINEAR "%6.3" "" COEFFS_LINEAR 1 0 /end COMPU_METHOD
/begin MEASUREMENT wrb.01.error "error" SBYTE wrb.01.error_COMPU_METHOD 0 0 -128 127 ECU_ADDRESS 0x6FBA9
 /begin IF_DATA XCP
  /begin DAQ_EVENT FIXED_EVENT_LIST EVENT 0x0 /end DAQ_EVENT
 /end IF_DATA
/end MEASUREMENT
/begin COMPU_METHOD wrb.01.operation_mode_display_COMPU_METHOD "" LINEAR "%6.3" "" COEFFS_LINEAR 1 0 /end COMPU_METHOD
/begin MEASUREMENT wrb.01.operation_mode_display "operation_mode_display" SBYTE wrb.01.operation_mode_display_COMPU_METHOD 0 0 -128 127 ECU_ADDRESS 0x6FBAA
 /begin IF_DATA XCP
  /begin DAQ_EVENT FIXED_EVENT_LIST EVENT 0x0 /end DAQ_EVENT
 /end IF_DATA
/end MEASUREMENT
/begin GROUP joints_status.01.wrb ""
 /begin REF_MEASUREMENT wrb.01.pos_fb wrb.01.vel_fb wrb.01.torque_fb wrb.01.current_fb wrb.01.motor_temper wrb.01.min_soft_position_limit wrb.01.max_soft_position_limit wrb.01.max_profile_velocity wrb.01.voltage wrb.01.enabled wrb.01.error wrb.01.operation_mode_display /end REF_MEASUREMENT
/end GROUP
/begin COMPU_METHOD kr.02.pos_cmd_COMPU_METHOD "" LINEAR "%6.3" "" COEFFS_LINEAR 1 0 /end COMPU_METHOD
/begin MEASUREMENT kr.02.pos_cmd "pos_cmd" FLOAT64_IEEE kr.02.pos_cmd_COMPU_METHOD 0 0 -1E12 1E12 ECU_ADDRESS 0x70A30
 /begin IF_DATA XCP
  /begin DAQ_EVENT FIXED_EVENT_LIST EVENT 0x0 /end DAQ_EVENT
 /end IF_DATA
/end MEASUREMENT
/begin COMPU_METHOD kr.02.vel_cmd_COMPU_METHOD "" LINEAR "%6.3" "" COEFFS_LINEAR 1 0 /end COMPU_METHOD
/begin MEASUREMENT kr.02.vel_cmd "vel_cmd" FLOAT64_IEEE kr.02.vel_cmd_COMPU_METHOD 0 0 -1E12 1E12 ECU_ADDRESS 0x70A38
 /begin IF_DATA XCP
  /begin DAQ_EVENT FIXED_EVENT_LIST EVENT 0x0 /end DAQ_EVENT
 /end IF_DATA
/end MEASUREMENT
/begin COMPU_METHOD kr.02.torque_cmd_COMPU_METHOD "" LINEAR "%6.3" "" COEFFS_LINEAR 1 0 /end COMPU_METHOD
/begin MEASUREMENT kr.02.torque_cmd "torque_cmd" FLOAT64_IEEE kr.02.torque_cmd_COMPU_METHOD 0 0 -1E12 1E12 ECU_ADDRESS 0x70A40
 /begin IF_DATA XCP
  /begin DAQ_EVENT FIXED_EVENT_LIST EVENT 0x0 /end DAQ_EVENT
 /end IF_DATA
/end MEASUREMENT
/begin COMPU_METHOD kr.02.current_cmd_COMPU_METHOD "" LINEAR "%6.3" "" COEFFS_LINEAR 1 0 /end COMPU_METHOD
/begin MEASUREMENT kr.02.current_cmd "current_cmd" FLOAT64_IEEE kr.02.current_cmd_COMPU_METHOD 0 0 -1E12 1E12 ECU_ADDRESS 0x70A48
 /begin IF_DATA XCP
  /begin DAQ_EVENT FIXED_EVENT_LIST EVENT 0x0 /end DAQ_EVENT
 /end IF_DATA
/end MEASUREMENT
/begin COMPU_METHOD kr.02.velocity_COMPU_METHOD "" LINEAR "%6.3" "" COEFFS_LINEAR 1 0 /end COMPU_METHOD
/begin MEASUREMENT kr.02.velocity "velocity" FLOAT64_IEEE kr.02.velocity_COMPU_METHOD 0 0 -1E12 1E12 ECU_ADDRESS 0x70A50
 /begin IF_DATA XCP
  /begin DAQ_EVENT FIXED_EVENT_LIST EVENT 0x0 /end DAQ_EVENT
 /end IF_DATA
/end MEASUREMENT
/begin COMPU_METHOD kr.02.max_velocity_COMPU_METHOD "" LINEAR "%6.3" "" COEFFS_LINEAR 1 0 /end COMPU_METHOD
/begin MEASUREMENT kr.02.max_velocity "max_velocity" FLOAT64_IEEE kr.02.max_velocity_COMPU_METHOD 0 0 -1E12 1E12 ECU_ADDRESS 0x70A58
 /begin IF_DATA XCP
  /begin DAQ_EVENT FIXED_EVENT_LIST EVENT 0x0 /end DAQ_EVENT
 /end IF_DATA
/end MEASUREMENT
/begin COMPU_METHOD kr.02.acceleration_COMPU_METHOD "" LINEAR "%6.3" "" COEFFS_LINEAR 1 0 /end COMPU_METHOD
/begin MEASUREMENT kr.02.acceleration "acceleration" FLOAT64_IEEE kr.02.acceleration_COMPU_METHOD 0 0 -1E12 1E12 ECU_ADDRESS 0x70A60
 /begin IF_DATA XCP
  /begin DAQ_EVENT FIXED_EVENT_LIST EVENT 0x0 /end DAQ_EVENT
 /end IF_DATA
/end MEASUREMENT
/begin COMPU_METHOD kr.02.deceleration_COMPU_METHOD "" LINEAR "%6.3" "" COEFFS_LINEAR 1 0 /end COMPU_METHOD
/begin MEASUREMENT kr.02.deceleration "deceleration" FLOAT64_IEEE kr.02.deceleration_COMPU_METHOD 0 0 -1E12 1E12 ECU_ADDRESS 0x70A68
 /begin IF_DATA XCP
  /begin DAQ_EVENT FIXED_EVENT_LIST EVENT 0x0 /end DAQ_EVENT
 /end IF_DATA
/end MEASUREMENT
/begin COMPU_METHOD kr.02.KP_COMPU_METHOD "" LINEAR "%6.3" "" COEFFS_LINEAR 1 0 /end COMPU_METHOD
/begin MEASUREMENT kr.02.KP "KP" FLOAT64_IEEE kr.02.KP_COMPU_METHOD 0 0 -1E12 1E12 ECU_ADDRESS 0x70A70
 /begin IF_DATA XCP
  /begin DAQ_EVENT FIXED_EVENT_LIST EVENT 0x0 /end DAQ_EVENT
 /end IF_DATA
/end MEASUREMENT
/begin COMPU_METHOD kr.02.KD_COMPU_METHOD "" LINEAR "%6.3" "" COEFFS_LINEAR 1 0 /end COMPU_METHOD
/begin MEASUREMENT kr.02.KD "KD" FLOAT64_IEEE kr.02.KD_COMPU_METHOD 0 0 -1E12 1E12 ECU_ADDRESS 0x70A78
 /begin IF_DATA XCP
  /begin DAQ_EVENT FIXED_EVENT_LIST EVENT 0x0 /end DAQ_EVENT
 /end IF_DATA
/end MEASUREMENT
/begin COMPU_METHOD kr.02.enable_COMPU_METHOD "" LINEAR "%6.3" "" COEFFS_LINEAR 1 0 /end COMPU_METHOD
/begin MEASUREMENT kr.02.enable "enable" SBYTE kr.02.enable_COMPU_METHOD 0 0 -128 127 ECU_ADDRESS 0x70A80
 /begin IF_DATA XCP
  /begin DAQ_EVENT FIXED_EVENT_LIST EVENT 0x0 /end DAQ_EVENT
 /end IF_DATA
/end MEASUREMENT
/begin COMPU_METHOD kr.02.operation_mode_COMPU_METHOD "" LINEAR "%6.3" "" COEFFS_LINEAR 1 0 /end COMPU_METHOD
/begin MEASUREMENT kr.02.operation_mode "operation_mode" SBYTE kr.02.operation_mode_COMPU_METHOD 0 0 -128 127 ECU_ADDRESS 0x70A81
 /begin IF_DATA XCP
  /begin DAQ_EVENT FIXED_EVENT_LIST EVENT 0x0 /end DAQ_EVENT
 /end IF_DATA
/end MEASUREMENT
/begin COMPU_METHOD kr.02.polarity_COMPU_METHOD "" LINEAR "%6.3" "" COEFFS_LINEAR 1 0 /end COMPU_METHOD
/begin MEASUREMENT kr.02.polarity "polarity" UBYTE kr.02.polarity_COMPU_METHOD 0 0 0 255 ECU_ADDRESS 0x70A82
 /begin IF_DATA XCP
  /begin DAQ_EVENT FIXED_EVENT_LIST EVENT 0x0 /end DAQ_EVENT
 /end IF_DATA
/end MEASUREMENT
/begin GROUP joints_cmd.02.kr ""
 /begin REF_MEASUREMENT kr.02.pos_cmd kr.02.vel_cmd kr.02.torque_cmd kr.02.current_cmd kr.02.velocity kr.02.max_velocity kr.02.acceleration kr.02.deceleration kr.02.KP kr.02.KD kr.02.enable kr.02.operation_mode kr.02.polarity /end REF_MEASUREMENT
/end GROUP
/begin COMPU_METHOD kr.02.pos_fb_COMPU_METHOD "" LINEAR "%6.3" "" COEFFS_LINEAR 1 0 /end COMPU_METHOD
/begin MEASUREMENT kr.02.pos_fb "pos_fb" FLOAT64_IEEE kr.02.pos_fb_COMPU_METHOD 0 0 -1E12 1E12 ECU_ADDRESS 0x6FBB8
 /begin IF_DATA XCP
  /begin DAQ_EVENT FIXED_EVENT_LIST EVENT 0x0 /end DAQ_EVENT
 /end IF_DATA
/end MEASUREMENT
/begin COMPU_METHOD kr.02.vel_fb_COMPU_METHOD "" LINEAR "%6.3" "" COEFFS_LINEAR 1 0 /end COMPU_METHOD
/begin MEASUREMENT kr.02.vel_fb "vel_fb" FLOAT64_IEEE kr.02.vel_fb_COMPU_METHOD 0 0 -1E12 1E12 ECU_ADDRESS 0x6FBC0
 /begin IF_DATA XCP
  /begin DAQ_EVENT FIXED_EVENT_LIST EVENT 0x0 /end DAQ_EVENT
 /end IF_DATA
/end MEASUREMENT
/begin COMPU_METHOD kr.02.torque_fb_COMPU_METHOD "" LINEAR "%6.3" "" COEFFS_LINEAR 1 0 /end COMPU_METHOD
/begin MEASUREMENT kr.02.torque_fb "torque_fb" FLOAT64_IEEE kr.02.torque_fb_COMPU_METHOD 0 0 -1E12 1E12 ECU_ADDRESS 0x6FBC8
 /begin IF_DATA XCP
  /begin DAQ_EVENT FIXED_EVENT_LIST EVENT 0x0 /end DAQ_EVENT
 /end IF_DATA
/end MEASUREMENT
/begin COMPU_METHOD kr.02.current_fb_COMPU_METHOD "" LINEAR "%6.3" "" COEFFS_LINEAR 1 0 /end COMPU_METHOD
/begin MEASUREMENT kr.02.current_fb "current_fb" FLOAT64_IEEE kr.02.current_fb_COMPU_METHOD 0 0 -1E12 1E12 ECU_ADDRESS 0x6FBD0
 /begin IF_DATA XCP
  /begin DAQ_EVENT FIXED_EVENT_LIST EVENT 0x0 /end DAQ_EVENT
 /end IF_DATA
/end MEASUREMENT
/begin COMPU_METHOD kr.02.motor_temper_COMPU_METHOD "" LINEAR "%6.3" "" COEFFS_LINEAR 1 0 /end COMPU_METHOD
/begin MEASUREMENT kr.02.motor_temper "motor_temper" FLOAT64_IEEE kr.02.motor_temper_COMPU_METHOD 0 0 -1E12 1E12 ECU_ADDRESS 0x6FBD8
 /begin IF_DATA XCP
  /begin DAQ_EVENT FIXED_EVENT_LIST EVENT 0x0 /end DAQ_EVENT
 /end IF_DATA
/end MEASUREMENT
/begin COMPU_METHOD kr.02.min_soft_position_limit_COMPU_METHOD "" LINEAR "%6.3" "" COEFFS_LINEAR 1 0 /end COMPU_METHOD
/begin MEASUREMENT kr.02.min_soft_position_limit "min_soft_position_limit" FLOAT64_IEEE kr.02.min_soft_position_limit_COMPU_METHOD 0 0 -1E12 1E12 ECU_ADDRESS 0x6FBE0
 /begin IF_DATA XCP
  /begin DAQ_EVENT FIXED_EVENT_LIST EVENT 0x0 /end DAQ_EVENT
 /end IF_DATA
/end MEASUREMENT
/begin COMPU_METHOD kr.02.max_soft_position_limit_COMPU_METHOD "" LINEAR "%6.3" "" COEFFS_LINEAR 1 0 /end COMPU_METHOD
/begin MEASUREMENT kr.02.max_soft_position_limit "max_soft_position_limit" FLOAT64_IEEE kr.02.max_soft_position_limit_COMPU_METHOD 0 0 -1E12 1E12 ECU_ADDRESS 0x6FBE8
 /begin IF_DATA XCP
  /begin DAQ_EVENT FIXED_EVENT_LIST EVENT 0x0 /end DAQ_EVENT
 /end IF_DATA
/end MEASUREMENT
/begin COMPU_METHOD kr.02.max_profile_velocity_COMPU_METHOD "" LINEAR "%6.3" "" COEFFS_LINEAR 1 0 /end COMPU_METHOD
/begin MEASUREMENT kr.02.max_profile_velocity "max_profile_velocity" FLOAT64_IEEE kr.02.max_profile_velocity_COMPU_METHOD 0 0 -1E12 1E12 ECU_ADDRESS 0x6FBF0
 /begin IF_DATA XCP
  /begin DAQ_EVENT FIXED_EVENT_LIST EVENT 0x0 /end DAQ_EVENT
 /end IF_DATA
/end MEASUREMENT
/begin COMPU_METHOD kr.02.voltage_COMPU_METHOD "" LINEAR "%6.3" "" COEFFS_LINEAR 1 0 /end COMPU_METHOD
/begin MEASUREMENT kr.02.voltage "voltage" FLOAT64_IEEE kr.02.voltage_COMPU_METHOD 0 0 -1E12 1E12 ECU_ADDRESS 0x6FC00
 /begin IF_DATA XCP
  /begin DAQ_EVENT FIXED_EVENT_LIST EVENT 0x0 /end DAQ_EVENT
 /end IF_DATA
/end MEASUREMENT
/begin COMPU_METHOD kr.02.enabled_COMPU_METHOD "" LINEAR "%6.3" "" COEFFS_LINEAR 1 0 /end COMPU_METHOD
/begin MEASUREMENT kr.02.enabled "enabled" SBYTE kr.02.enabled_COMPU_METHOD 0 0 -128 127 ECU_ADDRESS 0x6FBF8
 /begin IF_DATA XCP
  /begin DAQ_EVENT FIXED_EVENT_LIST EVENT 0x0 /end DAQ_EVENT
 /end IF_DATA
/end MEASUREMENT
/begin COMPU_METHOD kr.02.error_COMPU_METHOD "" LINEAR "%6.3" "" COEFFS_LINEAR 1 0 /end COMPU_METHOD
/begin MEASUREMENT kr.02.error "error" SBYTE kr.02.error_COMPU_METHOD 0 0 -128 127 ECU_ADDRESS 0x6FBF9
 /begin IF_DATA XCP
  /begin DAQ_EVENT FIXED_EVENT_LIST EVENT 0x0 /end DAQ_EVENT
 /end IF_DATA
/end MEASUREMENT
/begin COMPU_METHOD kr.02.operation_mode_display_COMPU_METHOD "" LINEAR "%6.3" "" COEFFS_LINEAR 1 0 /end COMPU_METHOD
/begin MEASUREMENT kr.02.operation_mode_display "operation_mode_display" SBYTE kr.02.operation_mode_display_COMPU_METHOD 0 0 -128 127 ECU_ADDRESS 0x6FBFA
 /begin IF_DATA XCP
  /begin DAQ_EVENT FIXED_EVENT_LIST EVENT 0x0 /end DAQ_EVENT
 /end IF_DATA
/end MEASUREMENT
/begin GROUP joints_status.02.kr ""
 /begin REF_MEASUREMENT kr.02.pos_fb kr.02.vel_fb kr.02.torque_fb kr.02.current_fb kr.02.motor_temper kr.02.min_soft_position_limit kr.02.max_soft_position_limit kr.02.max_profile_velocity kr.02.voltage kr.02.enabled kr.02.error kr.02.operation_mode_display /end REF_MEASUREMENT
/end GROUP
/begin COMPU_METHOD hr.03.pos_cmd_COMPU_METHOD "" LINEAR "%6.3" "" COEFFS_LINEAR 1 0 /end COMPU_METHOD
/begin MEASUREMENT hr.03.pos_cmd "pos_cmd" FLOAT64_IEEE hr.03.pos_cmd_COMPU_METHOD 0 0 -1E12 1E12 ECU_ADDRESS 0x70A88
 /begin IF_DATA XCP
  /begin DAQ_EVENT FIXED_EVENT_LIST EVENT 0x0 /end DAQ_EVENT
 /end IF_DATA
/end MEASUREMENT
/begin COMPU_METHOD hr.03.vel_cmd_COMPU_METHOD "" LINEAR "%6.3" "" COEFFS_LINEAR 1 0 /end COMPU_METHOD
/begin MEASUREMENT hr.03.vel_cmd "vel_cmd" FLOAT64_IEEE hr.03.vel_cmd_COMPU_METHOD 0 0 -1E12 1E12 ECU_ADDRESS 0x70A90
 /begin IF_DATA XCP
  /begin DAQ_EVENT FIXED_EVENT_LIST EVENT 0x0 /end DAQ_EVENT
 /end IF_DATA
/end MEASUREMENT
/begin COMPU_METHOD hr.03.torque_cmd_COMPU_METHOD "" LINEAR "%6.3" "" COEFFS_LINEAR 1 0 /end COMPU_METHOD
/begin MEASUREMENT hr.03.torque_cmd "torque_cmd" FLOAT64_IEEE hr.03.torque_cmd_COMPU_METHOD 0 0 -1E12 1E12 ECU_ADDRESS 0x70A98
 /begin IF_DATA XCP
  /begin DAQ_EVENT FIXED_EVENT_LIST EVENT 0x0 /end DAQ_EVENT
 /end IF_DATA
/end MEASUREMENT
/begin COMPU_METHOD hr.03.current_cmd_COMPU_METHOD "" LINEAR "%6.3" "" COEFFS_LINEAR 1 0 /end COMPU_METHOD
/begin MEASUREMENT hr.03.current_cmd "current_cmd" FLOAT64_IEEE hr.03.current_cmd_COMPU_METHOD 0 0 -1E12 1E12 ECU_ADDRESS 0x70AA0
 /begin IF_DATA XCP
  /begin DAQ_EVENT FIXED_EVENT_LIST EVENT 0x0 /end DAQ_EVENT
 /end IF_DATA
/end MEASUREMENT
/begin COMPU_METHOD hr.03.velocity_COMPU_METHOD "" LINEAR "%6.3" "" COEFFS_LINEAR 1 0 /end COMPU_METHOD
/begin MEASUREMENT hr.03.velocity "velocity" FLOAT64_IEEE hr.03.velocity_COMPU_METHOD 0 0 -1E12 1E12 ECU_ADDRESS 0x70AA8
 /begin IF_DATA XCP
  /begin DAQ_EVENT FIXED_EVENT_LIST EVENT 0x0 /end DAQ_EVENT
 /end IF_DATA
/end MEASUREMENT
/begin COMPU_METHOD hr.03.max_velocity_COMPU_METHOD "" LINEAR "%6.3" "" COEFFS_LINEAR 1 0 /end COMPU_METHOD
/begin MEASUREMENT hr.03.max_velocity "max_velocity" FLOAT64_IEEE hr.03.max_velocity_COMPU_METHOD 0 0 -1E12 1E12 ECU_ADDRESS 0x70AB0
 /begin IF_DATA XCP
  /begin DAQ_EVENT FIXED_EVENT_LIST EVENT 0x0 /end DAQ_EVENT
 /end IF_DATA
/end MEASUREMENT
/begin COMPU_METHOD hr.03.acceleration_COMPU_METHOD "" LINEAR "%6.3" "" COEFFS_LINEAR 1 0 /end COMPU_METHOD
/begin MEASUREMENT hr.03.acceleration "acceleration" FLOAT64_IEEE hr.03.acceleration_COMPU_METHOD 0 0 -1E12 1E12 ECU_ADDRESS 0x70AB8
 /begin IF_DATA XCP
  /begin DAQ_EVENT FIXED_EVENT_LIST EVENT 0x0 /end DAQ_EVENT
 /end IF_DATA
/end MEASUREMENT
/begin COMPU_METHOD hr.03.deceleration_COMPU_METHOD "" LINEAR "%6.3" "" COEFFS_LINEAR 1 0 /end COMPU_METHOD
/begin MEASUREMENT hr.03.deceleration "deceleration" FLOAT64_IEEE hr.03.deceleration_COMPU_METHOD 0 0 -1E12 1E12 ECU_ADDRESS 0x70AC0
 /begin IF_DATA XCP
  /begin DAQ_EVENT FIXED_EVENT_LIST EVENT 0x0 /end DAQ_EVENT
 /end IF_DATA
/end MEASUREMENT
/begin COMPU_METHOD hr.03.KP_COMPU_METHOD "" LINEAR "%6.3" "" COEFFS_LINEAR 1 0 /end COMPU_METHOD
/begin MEASUREMENT hr.03.KP "KP" FLOAT64_IEEE hr.03.KP_COMPU_METHOD 0 0 -1E12 1E12 ECU_ADDRESS 0x70AC8
 /begin IF_DATA XCP
  /begin DAQ_EVENT FIXED_EVENT_LIST EVENT 0x0 /end DAQ_EVENT
 /end IF_DATA
/end MEASUREMENT
/begin COMPU_METHOD hr.03.KD_COMPU_METHOD "" LINEAR "%6.3" "" COEFFS_LINEAR 1 0 /end COMPU_METHOD
/begin MEASUREMENT hr.03.KD "KD" FLOAT64_IEEE hr.03.KD_COMPU_METHOD 0 0 -1E12 1E12 ECU_ADDRESS 0x70AD0
 /begin IF_DATA XCP
  /begin DAQ_EVENT FIXED_EVENT_LIST EVENT 0x0 /end DAQ_EVENT
 /end IF_DATA
/end MEASUREMENT
/begin COMPU_METHOD hr.03.enable_COMPU_METHOD "" LINEAR "%6.3" "" COEFFS_LINEAR 1 0 /end COMPU_METHOD
/begin MEASUREMENT hr.03.enable "enable" SBYTE hr.03.enable_COMPU_METHOD 0 0 -128 127 ECU_ADDRESS 0x70AD8
 /begin IF_DATA XCP
  /begin DAQ_EVENT FIXED_EVENT_LIST EVENT 0x0 /end DAQ_EVENT
 /end IF_DATA
/end MEASUREMENT
/begin COMPU_METHOD hr.03.operation_mode_COMPU_METHOD "" LINEAR "%6.3" "" COEFFS_LINEAR 1 0 /end COMPU_METHOD
/begin MEASUREMENT hr.03.operation_mode "operation_mode" SBYTE hr.03.operation_mode_COMPU_METHOD 0 0 -128 127 ECU_ADDRESS 0x70AD9
 /begin IF_DATA XCP
  /begin DAQ_EVENT FIXED_EVENT_LIST EVENT 0x0 /end DAQ_EVENT
 /end IF_DATA
/end MEASUREMENT
/begin COMPU_METHOD hr.03.polarity_COMPU_METHOD "" LINEAR "%6.3" "" COEFFS_LINEAR 1 0 /end COMPU_METHOD
/begin MEASUREMENT hr.03.polarity "polarity" UBYTE hr.03.polarity_COMPU_METHOD 0 0 0 255 ECU_ADDRESS 0x70ADA
 /begin IF_DATA XCP
  /begin DAQ_EVENT FIXED_EVENT_LIST EVENT 0x0 /end DAQ_EVENT
 /end IF_DATA
/end MEASUREMENT
/begin GROUP joints_cmd.03.hr ""
 /begin REF_MEASUREMENT hr.03.pos_cmd hr.03.vel_cmd hr.03.torque_cmd hr.03.current_cmd hr.03.velocity hr.03.max_velocity hr.03.acceleration hr.03.deceleration hr.03.KP hr.03.KD hr.03.enable hr.03.operation_mode hr.03.polarity /end REF_MEASUREMENT
/end GROUP
/begin COMPU_METHOD hr.03.pos_fb_COMPU_METHOD "" LINEAR "%6.3" "" COEFFS_LINEAR 1 0 /end COMPU_METHOD
/begin MEASUREMENT hr.03.pos_fb "pos_fb" FLOAT64_IEEE hr.03.pos_fb_COMPU_METHOD 0 0 -1E12 1E12 ECU_ADDRESS 0x6FC08
 /begin IF_DATA XCP
  /begin DAQ_EVENT FIXED_EVENT_LIST EVENT 0x0 /end DAQ_EVENT
 /end IF_DATA
/end MEASUREMENT
/begin COMPU_METHOD hr.03.vel_fb_COMPU_METHOD "" LINEAR "%6.3" "" COEFFS_LINEAR 1 0 /end COMPU_METHOD
/begin MEASUREMENT hr.03.vel_fb "vel_fb" FLOAT64_IEEE hr.03.vel_fb_COMPU_METHOD 0 0 -1E12 1E12 ECU_ADDRESS 0x6FC10
 /begin IF_DATA XCP
  /begin DAQ_EVENT FIXED_EVENT_LIST EVENT 0x0 /end DAQ_EVENT
 /end IF_DATA
/end MEASUREMENT
/begin COMPU_METHOD hr.03.torque_fb_COMPU_METHOD "" LINEAR "%6.3" "" COEFFS_LINEAR 1 0 /end COMPU_METHOD
/begin MEASUREMENT hr.03.torque_fb "torque_fb" FLOAT64_IEEE hr.03.torque_fb_COMPU_METHOD 0 0 -1E12 1E12 ECU_ADDRESS 0x6FC18
 /begin IF_DATA XCP
  /begin DAQ_EVENT FIXED_EVENT_LIST EVENT 0x0 /end DAQ_EVENT
 /end IF_DATA
/end MEASUREMENT
/begin COMPU_METHOD hr.03.current_fb_COMPU_METHOD "" LINEAR "%6.3" "" COEFFS_LINEAR 1 0 /end COMPU_METHOD
/begin MEASUREMENT hr.03.current_fb "current_fb" FLOAT64_IEEE hr.03.current_fb_COMPU_METHOD 0 0 -1E12 1E12 ECU_ADDRESS 0x6FC20
 /begin IF_DATA XCP
  /begin DAQ_EVENT FIXED_EVENT_LIST EVENT 0x0 /end DAQ_EVENT
 /end IF_DATA
/end MEASUREMENT
/begin COMPU_METHOD hr.03.motor_temper_COMPU_METHOD "" LINEAR "%6.3" "" COEFFS_LINEAR 1 0 /end COMPU_METHOD
/begin MEASUREMENT hr.03.motor_temper "motor_temper" FLOAT64_IEEE hr.03.motor_temper_COMPU_METHOD 0 0 -1E12 1E12 ECU_ADDRESS 0x6FC28
 /begin IF_DATA XCP
  /begin DAQ_EVENT FIXED_EVENT_LIST EVENT 0x0 /end DAQ_EVENT
 /end IF_DATA
/end MEASUREMENT
/begin COMPU_METHOD hr.03.min_soft_position_limit_COMPU_METHOD "" LINEAR "%6.3" "" COEFFS_LINEAR 1 0 /end COMPU_METHOD
/begin MEASUREMENT hr.03.min_soft_position_limit "min_soft_position_limit" FLOAT64_IEEE hr.03.min_soft_position_limit_COMPU_METHOD 0 0 -1E12 1E12 ECU_ADDRESS 0x6FC30
 /begin IF_DATA XCP
  /begin DAQ_EVENT FIXED_EVENT_LIST EVENT 0x0 /end DAQ_EVENT
 /end IF_DATA
/end MEASUREMENT
/begin COMPU_METHOD hr.03.max_soft_position_limit_COMPU_METHOD "" LINEAR "%6.3" "" COEFFS_LINEAR 1 0 /end COMPU_METHOD
/begin MEASUREMENT hr.03.max_soft_position_limit "max_soft_position_limit" FLOAT64_IEEE hr.03.max_soft_position_limit_COMPU_METHOD 0 0 -1E12 1E12 ECU_ADDRESS 0x6FC38
 /begin IF_DATA XCP
  /begin DAQ_EVENT FIXED_EVENT_LIST EVENT 0x0 /end DAQ_EVENT
 /end IF_DATA
/end MEASUREMENT
/begin COMPU_METHOD hr.03.max_profile_velocity_COMPU_METHOD "" LINEAR "%6.3" "" COEFFS_LINEAR 1 0 /end COMPU_METHOD
/begin MEASUREMENT hr.03.max_profile_velocity "max_profile_velocity" FLOAT64_IEEE hr.03.max_profile_velocity_COMPU_METHOD 0 0 -1E12 1E12 ECU_ADDRESS 0x6FC40
 /begin IF_DATA XCP
  /begin DAQ_EVENT FIXED_EVENT_LIST EVENT 0x0 /end DAQ_EVENT
 /end IF_DATA
/end MEASUREMENT
/begin COMPU_METHOD hr.03.voltage_COMPU_METHOD "" LINEAR "%6.3" "" COEFFS_LINEAR 1 0 /end COMPU_METHOD
/begin MEASUREMENT hr.03.voltage "voltage" FLOAT64_IEEE hr.03.voltage_COMPU_METHOD 0 0 -1E12 1E12 ECU_ADDRESS 0x6FC50
 /begin IF_DATA XCP
  /begin DAQ_EVENT FIXED_EVENT_LIST EVENT 0x0 /end DAQ_EVENT
 /end IF_DATA
/end MEASUREMENT
/begin COMPU_METHOD hr.03.enabled_COMPU_METHOD "" LINEAR "%6.3" "" COEFFS_LINEAR 1 0 /end COMPU_METHOD
/begin MEASUREMENT hr.03.enabled "enabled" SBYTE hr.03.enabled_COMPU_METHOD 0 0 -128 127 ECU_ADDRESS 0x6FC48
 /begin IF_DATA XCP
  /begin DAQ_EVENT FIXED_EVENT_LIST EVENT 0x0 /end DAQ_EVENT
 /end IF_DATA
/end MEASUREMENT
/begin COMPU_METHOD hr.03.error_COMPU_METHOD "" LINEAR "%6.3" "" COEFFS_LINEAR 1 0 /end COMPU_METHOD
/begin MEASUREMENT hr.03.error "error" SBYTE hr.03.error_COMPU_METHOD 0 0 -128 127 ECU_ADDRESS 0x6FC49
 /begin IF_DATA XCP
  /begin DAQ_EVENT FIXED_EVENT_LIST EVENT 0x0 /end DAQ_EVENT
 /end IF_DATA
/end MEASUREMENT
/begin COMPU_METHOD hr.03.operation_mode_display_COMPU_METHOD "" LINEAR "%6.3" "" COEFFS_LINEAR 1 0 /end COMPU_METHOD
/begin MEASUREMENT hr.03.operation_mode_display "operation_mode_display" SBYTE hr.03.operation_mode_display_COMPU_METHOD 0 0 -128 127 ECU_ADDRESS 0x6FC4A
 /begin IF_DATA XCP
  /begin DAQ_EVENT FIXED_EVENT_LIST EVENT 0x0 /end DAQ_EVENT
 /end IF_DATA
/end MEASUREMENT
/begin GROUP joints_status.03.hr ""
 /begin REF_MEASUREMENT hr.03.pos_fb hr.03.vel_fb hr.03.torque_fb hr.03.current_fb hr.03.motor_temper hr.03.min_soft_position_limit hr.03.max_soft_position_limit hr.03.max_profile_velocity hr.03.voltage hr.03.enabled hr.03.error hr.03.operation_mode_display /end REF_MEASUREMENT
/end GROUP
/begin COMPU_METHOD hl.04.pos_cmd_COMPU_METHOD "" LINEAR "%6.3" "" COEFFS_LINEAR 1 0 /end COMPU_METHOD
/begin MEASUREMENT hl.04.pos_cmd "pos_cmd" FLOAT64_IEEE hl.04.pos_cmd_COMPU_METHOD 0 0 -1E12 1E12 ECU_ADDRESS 0x70AE0
 /begin IF_DATA XCP
  /begin DAQ_EVENT FIXED_EVENT_LIST EVENT 0x0 /end DAQ_EVENT
 /end IF_DATA
/end MEASUREMENT
/begin COMPU_METHOD hl.04.vel_cmd_COMPU_METHOD "" LINEAR "%6.3" "" COEFFS_LINEAR 1 0 /end COMPU_METHOD
/begin MEASUREMENT hl.04.vel_cmd "vel_cmd" FLOAT64_IEEE hl.04.vel_cmd_COMPU_METHOD 0 0 -1E12 1E12 ECU_ADDRESS 0x70AE8
 /begin IF_DATA XCP
  /begin DAQ_EVENT FIXED_EVENT_LIST EVENT 0x0 /end DAQ_EVENT
 /end IF_DATA
/end MEASUREMENT
/begin COMPU_METHOD hl.04.torque_cmd_COMPU_METHOD "" LINEAR "%6.3" "" COEFFS_LINEAR 1 0 /end COMPU_METHOD
/begin MEASUREMENT hl.04.torque_cmd "torque_cmd" FLOAT64_IEEE hl.04.torque_cmd_COMPU_METHOD 0 0 -1E12 1E12 ECU_ADDRESS 0x70AF0
 /begin IF_DATA XCP
  /begin DAQ_EVENT FIXED_EVENT_LIST EVENT 0x0 /end DAQ_EVENT
 /end IF_DATA
/end MEASUREMENT
/begin COMPU_METHOD hl.04.current_cmd_COMPU_METHOD "" LINEAR "%6.3" "" COEFFS_LINEAR 1 0 /end COMPU_METHOD
/begin MEASUREMENT hl.04.current_cmd "current_cmd" FLOAT64_IEEE hl.04.current_cmd_COMPU_METHOD 0 0 -1E12 1E12 ECU_ADDRESS 0x70AF8
 /begin IF_DATA XCP
  /begin DAQ_EVENT FIXED_EVENT_LIST EVENT 0x0 /end DAQ_EVENT
 /end IF_DATA
/end MEASUREMENT
/begin COMPU_METHOD hl.04.velocity_COMPU_METHOD "" LINEAR "%6.3" "" COEFFS_LINEAR 1 0 /end COMPU_METHOD
/begin MEASUREMENT hl.04.velocity "velocity" FLOAT64_IEEE hl.04.velocity_COMPU_METHOD 0 0 -1E12 1E12 ECU_ADDRESS 0x70B00
 /begin IF_DATA XCP
  /begin DAQ_EVENT FIXED_EVENT_LIST EVENT 0x0 /end DAQ_EVENT
 /end IF_DATA
/end MEASUREMENT
/begin COMPU_METHOD hl.04.max_velocity_COMPU_METHOD "" LINEAR "%6.3" "" COEFFS_LINEAR 1 0 /end COMPU_METHOD
/begin MEASUREMENT hl.04.max_velocity "max_velocity" FLOAT64_IEEE hl.04.max_velocity_COMPU_METHOD 0 0 -1E12 1E12 ECU_ADDRESS 0x70B08
 /begin IF_DATA XCP
  /begin DAQ_EVENT FIXED_EVENT_LIST EVENT 0x0 /end DAQ_EVENT
 /end IF_DATA
/end MEASUREMENT
/begin COMPU_METHOD hl.04.acceleration_COMPU_METHOD "" LINEAR "%6.3" "" COEFFS_LINEAR 1 0 /end COMPU_METHOD
/begin MEASUREMENT hl.04.acceleration "acceleration" FLOAT64_IEEE hl.04.acceleration_COMPU_METHOD 0 0 -1E12 1E12 ECU_ADDRESS 0x70B10
 /begin IF_DATA XCP
  /begin DAQ_EVENT FIXED_EVENT_LIST EVENT 0x0 /end DAQ_EVENT
 /end IF_DATA
/end MEASUREMENT
/begin COMPU_METHOD hl.04.deceleration_COMPU_METHOD "" LINEAR "%6.3" "" COEFFS_LINEAR 1 0 /end COMPU_METHOD
/begin MEASUREMENT hl.04.deceleration "deceleration" FLOAT64_IEEE hl.04.deceleration_COMPU_METHOD 0 0 -1E12 1E12 ECU_ADDRESS 0x70B18
 /begin IF_DATA XCP
  /begin DAQ_EVENT FIXED_EVENT_LIST EVENT 0x0 /end DAQ_EVENT
 /end IF_DATA
/end MEASUREMENT
/begin COMPU_METHOD hl.04.KP_COMPU_METHOD "" LINEAR "%6.3" "" COEFFS_LINEAR 1 0 /end COMPU_METHOD
/begin MEASUREMENT hl.04.KP "KP" FLOAT64_IEEE hl.04.KP_COMPU_METHOD 0 0 -1E12 1E12 ECU_ADDRESS 0x70B20
 /begin IF_DATA XCP
  /begin DAQ_EVENT FIXED_EVENT_LIST EVENT 0x0 /end DAQ_EVENT
 /end IF_DATA
/end MEASUREMENT
/begin COMPU_METHOD hl.04.KD_COMPU_METHOD "" LINEAR "%6.3" "" COEFFS_LINEAR 1 0 /end COMPU_METHOD
/begin MEASUREMENT hl.04.KD "KD" FLOAT64_IEEE hl.04.KD_COMPU_METHOD 0 0 -1E12 1E12 ECU_ADDRESS 0x70B28
 /begin IF_DATA XCP
  /begin DAQ_EVENT FIXED_EVENT_LIST EVENT 0x0 /end DAQ_EVENT
 /end IF_DATA
/end MEASUREMENT
/begin COMPU_METHOD hl.04.enable_COMPU_METHOD "" LINEAR "%6.3" "" COEFFS_LINEAR 1 0 /end COMPU_METHOD
/begin MEASUREMENT hl.04.enable "enable" SBYTE hl.04.enable_COMPU_METHOD 0 0 -128 127 ECU_ADDRESS 0x70B30
 /begin IF_DATA XCP
  /begin DAQ_EVENT FIXED_EVENT_LIST EVENT 0x0 /end DAQ_EVENT
 /end IF_DATA
/end MEASUREMENT
/begin COMPU_METHOD hl.04.operation_mode_COMPU_METHOD "" LINEAR "%6.3" "" COEFFS_LINEAR 1 0 /end COMPU_METHOD
/begin MEASUREMENT hl.04.operation_mode "operation_mode" SBYTE hl.04.operation_mode_COMPU_METHOD 0 0 -128 127 ECU_ADDRESS 0x70B31
 /begin IF_DATA XCP
  /begin DAQ_EVENT FIXED_EVENT_LIST EVENT 0x0 /end DAQ_EVENT
 /end IF_DATA
/end MEASUREMENT
/begin COMPU_METHOD hl.04.polarity_COMPU_METHOD "" LINEAR "%6.3" "" COEFFS_LINEAR 1 0 /end COMPU_METHOD
/begin MEASUREMENT hl.04.polarity "polarity" UBYTE hl.04.polarity_COMPU_METHOD 0 0 0 255 ECU_ADDRESS 0x70B32
 /begin IF_DATA XCP
  /begin DAQ_EVENT FIXED_EVENT_LIST EVENT 0x0 /end DAQ_EVENT
 /end IF_DATA
/end MEASUREMENT
/begin GROUP joints_cmd.04.hl ""
 /begin REF_MEASUREMENT hl.04.pos_cmd hl.04.vel_cmd hl.04.torque_cmd hl.04.current_cmd hl.04.velocity hl.04.max_velocity hl.04.acceleration hl.04.deceleration hl.04.KP hl.04.KD hl.04.enable hl.04.operation_mode hl.04.polarity /end REF_MEASUREMENT
/end GROUP
/begin COMPU_METHOD hl.04.pos_fb_COMPU_METHOD "" LINEAR "%6.3" "" COEFFS_LINEAR 1 0 /end COMPU_METHOD
/begin MEASUREMENT hl.04.pos_fb "pos_fb" FLOAT64_IEEE hl.04.pos_fb_COMPU_METHOD 0 0 -1E12 1E12 ECU_ADDRESS 0x6FC58
 /begin IF_DATA XCP
  /begin DAQ_EVENT FIXED_EVENT_LIST EVENT 0x0 /end DAQ_EVENT
 /end IF_DATA
/end MEASUREMENT
/begin COMPU_METHOD hl.04.vel_fb_COMPU_METHOD "" LINEAR "%6.3" "" COEFFS_LINEAR 1 0 /end COMPU_METHOD
/begin MEASUREMENT hl.04.vel_fb "vel_fb" FLOAT64_IEEE hl.04.vel_fb_COMPU_METHOD 0 0 -1E12 1E12 ECU_ADDRESS 0x6FC60
 /begin IF_DATA XCP
  /begin DAQ_EVENT FIXED_EVENT_LIST EVENT 0x0 /end DAQ_EVENT
 /end IF_DATA
/end MEASUREMENT
/begin COMPU_METHOD hl.04.torque_fb_COMPU_METHOD "" LINEAR "%6.3" "" COEFFS_LINEAR 1 0 /end COMPU_METHOD
/begin MEASUREMENT hl.04.torque_fb "torque_fb" FLOAT64_IEEE hl.04.torque_fb_COMPU_METHOD 0 0 -1E12 1E12 ECU_ADDRESS 0x6FC68
 /begin IF_DATA XCP
  /begin DAQ_EVENT FIXED_EVENT_LIST EVENT 0x0 /end DAQ_EVENT
 /end IF_DATA
/end MEASUREMENT
/begin COMPU_METHOD hl.04.current_fb_COMPU_METHOD "" LINEAR "%6.3" "" COEFFS_LINEAR 1 0 /end COMPU_METHOD
/begin MEASUREMENT hl.04.current_fb "current_fb" FLOAT64_IEEE hl.04.current_fb_COMPU_METHOD 0 0 -1E12 1E12 ECU_ADDRESS 0x6FC70
 /begin IF_DATA XCP
  /begin DAQ_EVENT FIXED_EVENT_LIST EVENT 0x0 /end DAQ_EVENT
 /end IF_DATA
/end MEASUREMENT
/begin COMPU_METHOD hl.04.motor_temper_COMPU_METHOD "" LINEAR "%6.3" "" COEFFS_LINEAR 1 0 /end COMPU_METHOD
/begin MEASUREMENT hl.04.motor_temper "motor_temper" FLOAT64_IEEE hl.04.motor_temper_COMPU_METHOD 0 0 -1E12 1E12 ECU_ADDRESS 0x6FC78
 /begin IF_DATA XCP
  /begin DAQ_EVENT FIXED_EVENT_LIST EVENT 0x0 /end DAQ_EVENT
 /end IF_DATA
/end MEASUREMENT
/begin COMPU_METHOD hl.04.min_soft_position_limit_COMPU_METHOD "" LINEAR "%6.3" "" COEFFS_LINEAR 1 0 /end COMPU_METHOD
/begin MEASUREMENT hl.04.min_soft_position_limit "min_soft_position_limit" FLOAT64_IEEE hl.04.min_soft_position_limit_COMPU_METHOD 0 0 -1E12 1E12 ECU_ADDRESS 0x6FC80
 /begin IF_DATA XCP
  /begin DAQ_EVENT FIXED_EVENT_LIST EVENT 0x0 /end DAQ_EVENT
 /end IF_DATA
/end MEASUREMENT
/begin COMPU_METHOD hl.04.max_soft_position_limit_COMPU_METHOD "" LINEAR "%6.3" "" COEFFS_LINEAR 1 0 /end COMPU_METHOD
/begin MEASUREMENT hl.04.max_soft_position_limit "max_soft_position_limit" FLOAT64_IEEE hl.04.max_soft_position_limit_COMPU_METHOD 0 0 -1E12 1E12 ECU_ADDRESS 0x6FC88
 /begin IF_DATA XCP
  /begin DAQ_EVENT FIXED_EVENT_LIST EVENT 0x0 /end DAQ_EVENT
 /end IF_DATA
/end MEASUREMENT
/begin COMPU_METHOD hl.04.max_profile_velocity_COMPU_METHOD "" LINEAR "%6.3" "" COEFFS_LINEAR 1 0 /end COMPU_METHOD
/begin MEASUREMENT hl.04.max_profile_velocity "max_profile_velocity" FLOAT64_IEEE hl.04.max_profile_velocity_COMPU_METHOD 0 0 -1E12 1E12 ECU_ADDRESS 0x6FC90
 /begin IF_DATA XCP
  /begin DAQ_EVENT FIXED_EVENT_LIST EVENT 0x0 /end DAQ_EVENT
 /end IF_DATA
/end MEASUREMENT
/begin COMPU_METHOD hl.04.voltage_COMPU_METHOD "" LINEAR "%6.3" "" COEFFS_LINEAR 1 0 /end COMPU_METHOD
/begin MEASUREMENT hl.04.voltage "voltage" FLOAT64_IEEE hl.04.voltage_COMPU_METHOD 0 0 -1E12 1E12 ECU_ADDRESS 0x6FCA0
 /begin IF_DATA XCP
  /begin DAQ_EVENT FIXED_EVENT_LIST EVENT 0x0 /end DAQ_EVENT
 /end IF_DATA
/end MEASUREMENT
/begin COMPU_METHOD hl.04.enabled_COMPU_METHOD "" LINEAR "%6.3" "" COEFFS_LINEAR 1 0 /end COMPU_METHOD
/begin MEASUREMENT hl.04.enabled "enabled" SBYTE hl.04.enabled_COMPU_METHOD 0 0 -128 127 ECU_ADDRESS 0x6FC98
 /begin IF_DATA XCP
  /begin DAQ_EVENT FIXED_EVENT_LIST EVENT 0x0 /end DAQ_EVENT
 /end IF_DATA
/end MEASUREMENT
/begin COMPU_METHOD hl.04.error_COMPU_METHOD "" LINEAR "%6.3" "" COEFFS_LINEAR 1 0 /end COMPU_METHOD
/begin MEASUREMENT hl.04.error "error" SBYTE hl.04.error_COMPU_METHOD 0 0 -128 127 ECU_ADDRESS 0x6FC99
 /begin IF_DATA XCP
  /begin DAQ_EVENT FIXED_EVENT_LIST EVENT 0x0 /end DAQ_EVENT
 /end IF_DATA
/end MEASUREMENT
/begin COMPU_METHOD hl.04.operation_mode_display_COMPU_METHOD "" LINEAR "%6.3" "" COEFFS_LINEAR 1 0 /end COMPU_METHOD
/begin MEASUREMENT hl.04.operation_mode_display "operation_mode_display" SBYTE hl.04.operation_mode_display_COMPU_METHOD 0 0 -128 127 ECU_ADDRESS 0x6FC9A
 /begin IF_DATA XCP
  /begin DAQ_EVENT FIXED_EVENT_LIST EVENT 0x0 /end DAQ_EVENT
 /end IF_DATA
/end MEASUREMENT
/begin GROUP joints_status.04.hl ""
 /begin REF_MEASUREMENT hl.04.pos_fb hl.04.vel_fb hl.04.torque_fb hl.04.current_fb hl.04.motor_temper hl.04.min_soft_position_limit hl.04.max_soft_position_limit hl.04.max_profile_velocity hl.04.voltage hl.04.enabled hl.04.error hl.04.operation_mode_display /end REF_MEASUREMENT
/end GROUP
/begin COMPU_METHOD kl.05.pos_cmd_COMPU_METHOD "" LINEAR "%6.3" "" COEFFS_LINEAR 1 0 /end COMPU_METHOD
/begin MEASUREMENT kl.05.pos_cmd "pos_cmd" FLOAT64_IEEE kl.05.pos_cmd_COMPU_METHOD 0 0 -1E12 1E12 ECU_ADDRESS 0x70B38
 /begin IF_DATA XCP
  /begin DAQ_EVENT FIXED_EVENT_LIST EVENT 0x0 /end DAQ_EVENT
 /end IF_DATA
/end MEASUREMENT
/begin COMPU_METHOD kl.05.vel_cmd_COMPU_METHOD "" LINEAR "%6.3" "" COEFFS_LINEAR 1 0 /end COMPU_METHOD
/begin MEASUREMENT kl.05.vel_cmd "vel_cmd" FLOAT64_IEEE kl.05.vel_cmd_COMPU_METHOD 0 0 -1E12 1E12 ECU_ADDRESS 0x70B40
 /begin IF_DATA XCP
  /begin DAQ_EVENT FIXED_EVENT_LIST EVENT 0x0 /end DAQ_EVENT
 /end IF_DATA
/end MEASUREMENT
/begin COMPU_METHOD kl.05.torque_cmd_COMPU_METHOD "" LINEAR "%6.3" "" COEFFS_LINEAR 1 0 /end COMPU_METHOD
/begin MEASUREMENT kl.05.torque_cmd "torque_cmd" FLOAT64_IEEE kl.05.torque_cmd_COMPU_METHOD 0 0 -1E12 1E12 ECU_ADDRESS 0x70B48
 /begin IF_DATA XCP
  /begin DAQ_EVENT FIXED_EVENT_LIST EVENT 0x0 /end DAQ_EVENT
 /end IF_DATA
/end MEASUREMENT
/begin COMPU_METHOD kl.05.current_cmd_COMPU_METHOD "" LINEAR "%6.3" "" COEFFS_LINEAR 1 0 /end COMPU_METHOD
/begin MEASUREMENT kl.05.current_cmd "current_cmd" FLOAT64_IEEE kl.05.current_cmd_COMPU_METHOD 0 0 -1E12 1E12 ECU_ADDRESS 0x70B50
 /begin IF_DATA XCP
  /begin DAQ_EVENT FIXED_EVENT_LIST EVENT 0x0 /end DAQ_EVENT
 /end IF_DATA
/end MEASUREMENT
/begin COMPU_METHOD kl.05.velocity_COMPU_METHOD "" LINEAR "%6.3" "" COEFFS_LINEAR 1 0 /end COMPU_METHOD
/begin MEASUREMENT kl.05.velocity "velocity" FLOAT64_IEEE kl.05.velocity_COMPU_METHOD 0 0 -1E12 1E12 ECU_ADDRESS 0x70B58
 /begin IF_DATA XCP
  /begin DAQ_EVENT FIXED_EVENT_LIST EVENT 0x0 /end DAQ_EVENT
 /end IF_DATA
/end MEASUREMENT
/begin COMPU_METHOD kl.05.max_velocity_COMPU_METHOD "" LINEAR "%6.3" "" COEFFS_LINEAR 1 0 /end COMPU_METHOD
/begin MEASUREMENT kl.05.max_velocity "max_velocity" FLOAT64_IEEE kl.05.max_velocity_COMPU_METHOD 0 0 -1E12 1E12 ECU_ADDRESS 0x70B60
 /begin IF_DATA XCP
  /begin DAQ_EVENT FIXED_EVENT_LIST EVENT 0x0 /end DAQ_EVENT
 /end IF_DATA
/end MEASUREMENT
/begin COMPU_METHOD kl.05.acceleration_COMPU_METHOD "" LINEAR "%6.3" "" COEFFS_LINEAR 1 0 /end COMPU_METHOD
/begin MEASUREMENT kl.05.acceleration "acceleration" FLOAT64_IEEE kl.05.acceleration_COMPU_METHOD 0 0 -1E12 1E12 ECU_ADDRESS 0x70B68
 /begin IF_DATA XCP
  /begin DAQ_EVENT FIXED_EVENT_LIST EVENT 0x0 /end DAQ_EVENT
 /end IF_DATA
/end MEASUREMENT
/begin COMPU_METHOD kl.05.deceleration_COMPU_METHOD "" LINEAR "%6.3" "" COEFFS_LINEAR 1 0 /end COMPU_METHOD
/begin MEASUREMENT kl.05.deceleration "deceleration" FLOAT64_IEEE kl.05.deceleration_COMPU_METHOD 0 0 -1E12 1E12 ECU_ADDRESS 0x70B70
 /begin IF_DATA XCP
  /begin DAQ_EVENT FIXED_EVENT_LIST EVENT 0x0 /end DAQ_EVENT
 /end IF_DATA
/end MEASUREMENT
/begin COMPU_METHOD kl.05.KP_COMPU_METHOD "" LINEAR "%6.3" "" COEFFS_LINEAR 1 0 /end COMPU_METHOD
/begin MEASUREMENT kl.05.KP "KP" FLOAT64_IEEE kl.05.KP_COMPU_METHOD 0 0 -1E12 1E12 ECU_ADDRESS 0x70B78
 /begin IF_DATA XCP
  /begin DAQ_EVENT FIXED_EVENT_LIST EVENT 0x0 /end DAQ_EVENT
 /end IF_DATA
/end MEASUREMENT
/begin COMPU_METHOD kl.05.KD_COMPU_METHOD "" LINEAR "%6.3" "" COEFFS_LINEAR 1 0 /end COMPU_METHOD
/begin MEASUREMENT kl.05.KD "KD" FLOAT64_IEEE kl.05.KD_COMPU_METHOD 0 0 -1E12 1E12 ECU_ADDRESS 0x70B80
 /begin IF_DATA XCP
  /begin DAQ_EVENT FIXED_EVENT_LIST EVENT 0x0 /end DAQ_EVENT
 /end IF_DATA
/end MEASUREMENT
/begin COMPU_METHOD kl.05.enable_COMPU_METHOD "" LINEAR "%6.3" "" COEFFS_LINEAR 1 0 /end COMPU_METHOD
/begin MEASUREMENT kl.05.enable "enable" SBYTE kl.05.enable_COMPU_METHOD 0 0 -128 127 ECU_ADDRESS 0x70B88
 /begin IF_DATA XCP
  /begin DAQ_EVENT FIXED_EVENT_LIST EVENT 0x0 /end DAQ_EVENT
 /end IF_DATA
/end MEASUREMENT
/begin COMPU_METHOD kl.05.operation_mode_COMPU_METHOD "" LINEAR "%6.3" "" COEFFS_LINEAR 1 0 /end COMPU_METHOD
/begin MEASUREMENT kl.05.operation_mode "operation_mode" SBYTE kl.05.operation_mode_COMPU_METHOD 0 0 -128 127 ECU_ADDRESS 0x70B89
 /begin IF_DATA XCP
  /begin DAQ_EVENT FIXED_EVENT_LIST EVENT 0x0 /end DAQ_EVENT
 /end IF_DATA
/end MEASUREMENT
/begin COMPU_METHOD kl.05.polarity_COMPU_METHOD "" LINEAR "%6.3" "" COEFFS_LINEAR 1 0 /end COMPU_METHOD
/begin MEASUREMENT kl.05.polarity "polarity" UBYTE kl.05.polarity_COMPU_METHOD 0 0 0 255 ECU_ADDRESS 0x70B8A
 /begin IF_DATA XCP
  /begin DAQ_EVENT FIXED_EVENT_LIST EVENT 0x0 /end DAQ_EVENT
 /end IF_DATA
/end MEASUREMENT
/begin GROUP joints_cmd.05.kl ""
 /begin REF_MEASUREMENT kl.05.pos_cmd kl.05.vel_cmd kl.05.torque_cmd kl.05.current_cmd kl.05.velocity kl.05.max_velocity kl.05.acceleration kl.05.deceleration kl.05.KP kl.05.KD kl.05.enable kl.05.operation_mode kl.05.polarity /end REF_MEASUREMENT
/end GROUP
/begin COMPU_METHOD kl.05.pos_fb_COMPU_METHOD "" LINEAR "%6.3" "" COEFFS_LINEAR 1 0 /end COMPU_METHOD
/begin MEASUREMENT kl.05.pos_fb "pos_fb" FLOAT64_IEEE kl.05.pos_fb_COMPU_METHOD 0 0 -1E12 1E12 ECU_ADDRESS 0x6FCA8
 /begin IF_DATA XCP
  /begin DAQ_EVENT FIXED_EVENT_LIST EVENT 0x0 /end DAQ_EVENT
 /end IF_DATA
/end MEASUREMENT
/begin COMPU_METHOD kl.05.vel_fb_COMPU_METHOD "" LINEAR "%6.3" "" COEFFS_LINEAR 1 0 /end COMPU_METHOD
/begin MEASUREMENT kl.05.vel_fb "vel_fb" FLOAT64_IEEE kl.05.vel_fb_COMPU_METHOD 0 0 -1E12 1E12 ECU_ADDRESS 0x6FCB0
 /begin IF_DATA XCP
  /begin DAQ_EVENT FIXED_EVENT_LIST EVENT 0x0 /end DAQ_EVENT
 /end IF_DATA
/end MEASUREMENT
/begin COMPU_METHOD kl.05.torque_fb_COMPU_METHOD "" LINEAR "%6.3" "" COEFFS_LINEAR 1 0 /end COMPU_METHOD
/begin MEASUREMENT kl.05.torque_fb "torque_fb" FLOAT64_IEEE kl.05.torque_fb_COMPU_METHOD 0 0 -1E12 1E12 ECU_ADDRESS 0x6FCB8
 /begin IF_DATA XCP
  /begin DAQ_EVENT FIXED_EVENT_LIST EVENT 0x0 /end DAQ_EVENT
 /end IF_DATA
/end MEASUREMENT
/begin COMPU_METHOD kl.05.current_fb_COMPU_METHOD "" LINEAR "%6.3" "" COEFFS_LINEAR 1 0 /end COMPU_METHOD
/begin MEASUREMENT kl.05.current_fb "current_fb" FLOAT64_IEEE kl.05.current_fb_COMPU_METHOD 0 0 -1E12 1E12 ECU_ADDRESS 0x6FCC0
 /begin IF_DATA XCP
  /begin DAQ_EVENT FIXED_EVENT_LIST EVENT 0x0 /end DAQ_EVENT
 /end IF_DATA
/end MEASUREMENT
/begin COMPU_METHOD kl.05.motor_temper_COMPU_METHOD "" LINEAR "%6.3" "" COEFFS_LINEAR 1 0 /end COMPU_METHOD
/begin MEASUREMENT kl.05.motor_temper "motor_temper" FLOAT64_IEEE kl.05.motor_temper_COMPU_METHOD 0 0 -1E12 1E12 ECU_ADDRESS 0x6FCC8
 /begin IF_DATA XCP
  /begin DAQ_EVENT FIXED_EVENT_LIST EVENT 0x0 /end DAQ_EVENT
 /end IF_DATA
/end MEASUREMENT
/begin COMPU_METHOD kl.05.min_soft_position_limit_COMPU_METHOD "" LINEAR "%6.3" "" COEFFS_LINEAR 1 0 /end COMPU_METHOD
/begin MEASUREMENT kl.05.min_soft_position_limit "min_soft_position_limit" FLOAT64_IEEE kl.05.min_soft_position_limit_COMPU_METHOD 0 0 -1E12 1E12 ECU_ADDRESS 0x6FCD0
 /begin IF_DATA XCP
  /begin DAQ_EVENT FIXED_EVENT_LIST EVENT 0x0 /end DAQ_EVENT
 /end IF_DATA
/end MEASUREMENT
/begin COMPU_METHOD kl.05.max_soft_position_limit_COMPU_METHOD "" LINEAR "%6.3" "" COEFFS_LINEAR 1 0 /end COMPU_METHOD
/begin MEASUREMENT kl.05.max_soft_position_limit "max_soft_position_limit" FLOAT64_IEEE kl.05.max_soft_position_limit_COMPU_METHOD 0 0 -1E12 1E12 ECU_ADDRESS 0x6FCD8
 /begin IF_DATA XCP
  /begin DAQ_EVENT FIXED_EVENT_LIST EVENT 0x0 /end DAQ_EVENT
 /end IF_DATA
/end MEASUREMENT
/begin COMPU_METHOD kl.05.max_profile_velocity_COMPU_METHOD "" LINEAR "%6.3" "" COEFFS_LINEAR 1 0 /end COMPU_METHOD
/begin MEASUREMENT kl.05.max_profile_velocity "max_profile_velocity" FLOAT64_IEEE kl.05.max_profile_velocity_COMPU_METHOD 0 0 -1E12 1E12 ECU_ADDRESS 0x6FCE0
 /begin IF_DATA XCP
  /begin DAQ_EVENT FIXED_EVENT_LIST EVENT 0x0 /end DAQ_EVENT
 /end IF_DATA
/end MEASUREMENT
/begin COMPU_METHOD kl.05.voltage_COMPU_METHOD "" LINEAR "%6.3" "" COEFFS_LINEAR 1 0 /end COMPU_METHOD
/begin MEASUREMENT kl.05.voltage "voltage" FLOAT64_IEEE kl.05.voltage_COMPU_METHOD 0 0 -1E12 1E12 ECU_ADDRESS 0x6FCF0
 /begin IF_DATA XCP
  /begin DAQ_EVENT FIXED_EVENT_LIST EVENT 0x0 /end DAQ_EVENT
 /end IF_DATA
/end MEASUREMENT
/begin COMPU_METHOD kl.05.enabled_COMPU_METHOD "" LINEAR "%6.3" "" COEFFS_LINEAR 1 0 /end COMPU_METHOD
/begin MEASUREMENT kl.05.enabled "enabled" SBYTE kl.05.enabled_COMPU_METHOD 0 0 -128 127 ECU_ADDRESS 0x6FCE8
 /begin IF_DATA XCP
  /begin DAQ_EVENT FIXED_EVENT_LIST EVENT 0x0 /end DAQ_EVENT
 /end IF_DATA
/end MEASUREMENT
/begin COMPU_METHOD kl.05.error_COMPU_METHOD "" LINEAR "%6.3" "" COEFFS_LINEAR 1 0 /end COMPU_METHOD
/begin MEASUREMENT kl.05.error "error" SBYTE kl.05.error_COMPU_METHOD 0 0 -128 127 ECU_ADDRESS 0x6FCE9
 /begin IF_DATA XCP
  /begin DAQ_EVENT FIXED_EVENT_LIST EVENT 0x0 /end DAQ_EVENT
 /end IF_DATA
/end MEASUREMENT
/begin COMPU_METHOD kl.05.operation_mode_display_COMPU_METHOD "" LINEAR "%6.3" "" COEFFS_LINEAR 1 0 /end COMPU_METHOD
/begin MEASUREMENT kl.05.operation_mode_display "operation_mode_display" SBYTE kl.05.operation_mode_display_COMPU_METHOD 0 0 -128 127 ECU_ADDRESS 0x6FCEA
 /begin IF_DATA XCP
  /begin DAQ_EVENT FIXED_EVENT_LIST EVENT 0x0 /end DAQ_EVENT
 /end IF_DATA
/end MEASUREMENT
/begin GROUP joints_status.05.kl ""
 /begin REF_MEASUREMENT kl.05.pos_fb kl.05.vel_fb kl.05.torque_fb kl.05.current_fb kl.05.motor_temper kl.05.min_soft_position_limit kl.05.max_soft_position_limit kl.05.max_profile_velocity kl.05.voltage kl.05.enabled kl.05.error kl.05.operation_mode_display /end REF_MEASUREMENT
/end GROUP
/begin COMPU_METHOD wlb.06.pos_cmd_COMPU_METHOD "" LINEAR "%6.3" "" COEFFS_LINEAR 1 0 /end COMPU_METHOD
/begin MEASUREMENT wlb.06.pos_cmd "pos_cmd" FLOAT64_IEEE wlb.06.pos_cmd_COMPU_METHOD 0 0 -1E12 1E12 ECU_ADDRESS 0x70B90
 /begin IF_DATA XCP
  /begin DAQ_EVENT FIXED_EVENT_LIST EVENT 0x0 /end DAQ_EVENT
 /end IF_DATA
/end MEASUREMENT
/begin COMPU_METHOD wlb.06.vel_cmd_COMPU_METHOD "" LINEAR "%6.3" "" COEFFS_LINEAR 1 0 /end COMPU_METHOD
/begin MEASUREMENT wlb.06.vel_cmd "vel_cmd" FLOAT64_IEEE wlb.06.vel_cmd_COMPU_METHOD 0 0 -1E12 1E12 ECU_ADDRESS 0x70B98
 /begin IF_DATA XCP
  /begin DAQ_EVENT FIXED_EVENT_LIST EVENT 0x0 /end DAQ_EVENT
 /end IF_DATA
/end MEASUREMENT
/begin COMPU_METHOD wlb.06.torque_cmd_COMPU_METHOD "" LINEAR "%6.3" "" COEFFS_LINEAR 1 0 /end COMPU_METHOD
/begin MEASUREMENT wlb.06.torque_cmd "torque_cmd" FLOAT64_IEEE wlb.06.torque_cmd_COMPU_METHOD 0 0 -1E12 1E12 ECU_ADDRESS 0x70BA0
 /begin IF_DATA XCP
  /begin DAQ_EVENT FIXED_EVENT_LIST EVENT 0x0 /end DAQ_EVENT
 /end IF_DATA
/end MEASUREMENT
/begin COMPU_METHOD wlb.06.current_cmd_COMPU_METHOD "" LINEAR "%6.3" "" COEFFS_LINEAR 1 0 /end COMPU_METHOD
/begin MEASUREMENT wlb.06.current_cmd "current_cmd" FLOAT64_IEEE wlb.06.current_cmd_COMPU_METHOD 0 0 -1E12 1E12 ECU_ADDRESS 0x70BA8
 /begin IF_DATA XCP
  /begin DAQ_EVENT FIXED_EVENT_LIST EVENT 0x0 /end DAQ_EVENT
 /end IF_DATA
/end MEASUREMENT
/begin COMPU_METHOD wlb.06.velocity_COMPU_METHOD "" LINEAR "%6.3" "" COEFFS_LINEAR 1 0 /end COMPU_METHOD
/begin MEASUREMENT wlb.06.velocity "velocity" FLOAT64_IEEE wlb.06.velocity_COMPU_METHOD 0 0 -1E12 1E12 ECU_ADDRESS 0x70BB0
 /begin IF_DATA XCP
  /begin DAQ_EVENT FIXED_EVENT_LIST EVENT 0x0 /end DAQ_EVENT
 /end IF_DATA
/end MEASUREMENT
/begin COMPU_METHOD wlb.06.max_velocity_COMPU_METHOD "" LINEAR "%6.3" "" COEFFS_LINEAR 1 0 /end COMPU_METHOD
/begin MEASUREMENT wlb.06.max_velocity "max_velocity" FLOAT64_IEEE wlb.06.max_velocity_COMPU_METHOD 0 0 -1E12 1E12 ECU_ADDRESS 0x70BB8
 /begin IF_DATA XCP
  /begin DAQ_EVENT FIXED_EVENT_LIST EVENT 0x0 /end DAQ_EVENT
 /end IF_DATA
/end MEASUREMENT
/begin COMPU_METHOD wlb.06.acceleration_COMPU_METHOD "" LINEAR "%6.3" "" COEFFS_LINEAR 1 0 /end COMPU_METHOD
/begin MEASUREMENT wlb.06.acceleration "acceleration" FLOAT64_IEEE wlb.06.acceleration_COMPU_METHOD 0 0 -1E12 1E12 ECU_ADDRESS 0x70BC0
 /begin IF_DATA XCP
  /begin DAQ_EVENT FIXED_EVENT_LIST EVENT 0x0 /end DAQ_EVENT
 /end IF_DATA
/end MEASUREMENT
/begin COMPU_METHOD wlb.06.deceleration_COMPU_METHOD "" LINEAR "%6.3" "" COEFFS_LINEAR 1 0 /end COMPU_METHOD
/begin MEASUREMENT wlb.06.deceleration "deceleration" FLOAT64_IEEE wlb.06.deceleration_COMPU_METHOD 0 0 -1E12 1E12 ECU_ADDRESS 0x70BC8
 /begin IF_DATA XCP
  /begin DAQ_EVENT FIXED_EVENT_LIST EVENT 0x0 /end DAQ_EVENT
 /end IF_DATA
/end MEASUREMENT
/begin COMPU_METHOD wlb.06.KP_COMPU_METHOD "" LINEAR "%6.3" "" COEFFS_LINEAR 1 0 /end COMPU_METHOD
/begin MEASUREMENT wlb.06.KP "KP" FLOAT64_IEEE wlb.06.KP_COMPU_METHOD 0 0 -1E12 1E12 ECU_ADDRESS 0x70BD0
 /begin IF_DATA XCP
  /begin DAQ_EVENT FIXED_EVENT_LIST EVENT 0x0 /end DAQ_EVENT
 /end IF_DATA
/end MEASUREMENT
/begin COMPU_METHOD wlb.06.KD_COMPU_METHOD "" LINEAR "%6.3" "" COEFFS_LINEAR 1 0 /end COMPU_METHOD
/begin MEASUREMENT wlb.06.KD "KD" FLOAT64_IEEE wlb.06.KD_COMPU_METHOD 0 0 -1E12 1E12 ECU_ADDRESS 0x70BD8
 /begin IF_DATA XCP
  /begin DAQ_EVENT FIXED_EVENT_LIST EVENT 0x0 /end DAQ_EVENT
 /end IF_DATA
/end MEASUREMENT
/begin COMPU_METHOD wlb.06.enable_COMPU_METHOD "" LINEAR "%6.3" "" COEFFS_LINEAR 1 0 /end COMPU_METHOD
/begin MEASUREMENT wlb.06.enable "enable" SBYTE wlb.06.enable_COMPU_METHOD 0 0 -128 127 ECU_ADDRESS 0x70BE0
 /begin IF_DATA XCP
  /begin DAQ_EVENT FIXED_EVENT_LIST EVENT 0x0 /end DAQ_EVENT
 /end IF_DATA
/end MEASUREMENT
/begin COMPU_METHOD wlb.06.operation_mode_COMPU_METHOD "" LINEAR "%6.3" "" COEFFS_LINEAR 1 0 /end COMPU_METHOD
/begin MEASUREMENT wlb.06.operation_mode "operation_mode" SBYTE wlb.06.operation_mode_COMPU_METHOD 0 0 -128 127 ECU_ADDRESS 0x70BE1
 /begin IF_DATA XCP
  /begin DAQ_EVENT FIXED_EVENT_LIST EVENT 0x0 /end DAQ_EVENT
 /end IF_DATA
/end MEASUREMENT
/begin COMPU_METHOD wlb.06.polarity_COMPU_METHOD "" LINEAR "%6.3" "" COEFFS_LINEAR 1 0 /end COMPU_METHOD
/begin MEASUREMENT wlb.06.polarity "polarity" UBYTE wlb.06.polarity_COMPU_METHOD 0 0 0 255 ECU_ADDRESS 0x70BE2
 /begin IF_DATA XCP
  /begin DAQ_EVENT FIXED_EVENT_LIST EVENT 0x0 /end DAQ_EVENT
 /end IF_DATA
/end MEASUREMENT
/begin GROUP joints_cmd.06.wlb ""
 /begin REF_MEASUREMENT wlb.06.pos_cmd wlb.06.vel_cmd wlb.06.torque_cmd wlb.06.current_cmd wlb.06.velocity wlb.06.max_velocity wlb.06.acceleration wlb.06.deceleration wlb.06.KP wlb.06.KD wlb.06.enable wlb.06.operation_mode wlb.06.polarity /end REF_MEASUREMENT
/end GROUP
/begin COMPU_METHOD wlb.06.pos_fb_COMPU_METHOD "" LINEAR "%6.3" "" COEFFS_LINEAR 1 0 /end COMPU_METHOD
/begin MEASUREMENT wlb.06.pos_fb "pos_fb" FLOAT64_IEEE wlb.06.pos_fb_COMPU_METHOD 0 0 -1E12 1E12 ECU_ADDRESS 0x6FCF8
 /begin IF_DATA XCP
  /begin DAQ_EVENT FIXED_EVENT_LIST EVENT 0x0 /end DAQ_EVENT
 /end IF_DATA
/end MEASUREMENT
/begin COMPU_METHOD wlb.06.vel_fb_COMPU_METHOD "" LINEAR "%6.3" "" COEFFS_LINEAR 1 0 /end COMPU_METHOD
/begin MEASUREMENT wlb.06.vel_fb "vel_fb" FLOAT64_IEEE wlb.06.vel_fb_COMPU_METHOD 0 0 -1E12 1E12 ECU_ADDRESS 0x6FD00
 /begin IF_DATA XCP
  /begin DAQ_EVENT FIXED_EVENT_LIST EVENT 0x0 /end DAQ_EVENT
 /end IF_DATA
/end MEASUREMENT
/begin COMPU_METHOD wlb.06.torque_fb_COMPU_METHOD "" LINEAR "%6.3" "" COEFFS_LINEAR 1 0 /end COMPU_METHOD
/begin MEASUREMENT wlb.06.torque_fb "torque_fb" FLOAT64_IEEE wlb.06.torque_fb_COMPU_METHOD 0 0 -1E12 1E12 ECU_ADDRESS 0x6FD08
 /begin IF_DATA XCP
  /begin DAQ_EVENT FIXED_EVENT_LIST EVENT 0x0 /end DAQ_EVENT
 /end IF_DATA
/end MEASUREMENT
/begin COMPU_METHOD wlb.06.current_fb_COMPU_METHOD "" LINEAR "%6.3" "" COEFFS_LINEAR 1 0 /end COMPU_METHOD
/begin MEASUREMENT wlb.06.current_fb "current_fb" FLOAT64_IEEE wlb.06.current_fb_COMPU_METHOD 0 0 -1E12 1E12 ECU_ADDRESS 0x6FD10
 /begin IF_DATA XCP
  /begin DAQ_EVENT FIXED_EVENT_LIST EVENT 0x0 /end DAQ_EVENT
 /end IF_DATA
/end MEASUREMENT
/begin COMPU_METHOD wlb.06.motor_temper_COMPU_METHOD "" LINEAR "%6.3" "" COEFFS_LINEAR 1 0 /end COMPU_METHOD
/begin MEASUREMENT wlb.06.motor_temper "motor_temper" FLOAT64_IEEE wlb.06.motor_temper_COMPU_METHOD 0 0 -1E12 1E12 ECU_ADDRESS 0x6FD18
 /begin IF_DATA XCP
  /begin DAQ_EVENT FIXED_EVENT_LIST EVENT 0x0 /end DAQ_EVENT
 /end IF_DATA
/end MEASUREMENT
/begin COMPU_METHOD wlb.06.min_soft_position_limit_COMPU_METHOD "" LINEAR "%6.3" "" COEFFS_LINEAR 1 0 /end COMPU_METHOD
/begin MEASUREMENT wlb.06.min_soft_position_limit "min_soft_position_limit" FLOAT64_IEEE wlb.06.min_soft_position_limit_COMPU_METHOD 0 0 -1E12 1E12 ECU_ADDRESS 0x6FD20
 /begin IF_DATA XCP
  /begin DAQ_EVENT FIXED_EVENT_LIST EVENT 0x0 /end DAQ_EVENT
 /end IF_DATA
/end MEASUREMENT
/begin COMPU_METHOD wlb.06.max_soft_position_limit_COMPU_METHOD "" LINEAR "%6.3" "" COEFFS_LINEAR 1 0 /end COMPU_METHOD
/begin MEASUREMENT wlb.06.max_soft_position_limit "max_soft_position_limit" FLOAT64_IEEE wlb.06.max_soft_position_limit_COMPU_METHOD 0 0 -1E12 1E12 ECU_ADDRESS 0x6FD28
 /begin IF_DATA XCP
  /begin DAQ_EVENT FIXED_EVENT_LIST EVENT 0x0 /end DAQ_EVENT
 /end IF_DATA
/end MEASUREMENT
/begin COMPU_METHOD wlb.06.max_profile_velocity_COMPU_METHOD "" LINEAR "%6.3" "" COEFFS_LINEAR 1 0 /end COMPU_METHOD
/begin MEASUREMENT wlb.06.max_profile_velocity "max_profile_velocity" FLOAT64_IEEE wlb.06.max_profile_velocity_COMPU_METHOD 0 0 -1E12 1E12 ECU_ADDRESS 0x6FD30
 /begin IF_DATA XCP
  /begin DAQ_EVENT FIXED_EVENT_LIST EVENT 0x0 /end DAQ_EVENT
 /end IF_DATA
/end MEASUREMENT
/begin COMPU_METHOD wlb.06.voltage_COMPU_METHOD "" LINEAR "%6.3" "" COEFFS_LINEAR 1 0 /end COMPU_METHOD
/begin MEASUREMENT wlb.06.voltage "voltage" FLOAT64_IEEE wlb.06.voltage_COMPU_METHOD 0 0 -1E12 1E12 ECU_ADDRESS 0x6FD40
 /begin IF_DATA XCP
  /begin DAQ_EVENT FIXED_EVENT_LIST EVENT 0x0 /end DAQ_EVENT
 /end IF_DATA
/end MEASUREMENT
/begin COMPU_METHOD wlb.06.enabled_COMPU_METHOD "" LINEAR "%6.3" "" COEFFS_LINEAR 1 0 /end COMPU_METHOD
/begin MEASUREMENT wlb.06.enabled "enabled" SBYTE wlb.06.enabled_COMPU_METHOD 0 0 -128 127 ECU_ADDRESS 0x6FD38
 /begin IF_DATA XCP
  /begin DAQ_EVENT FIXED_EVENT_LIST EVENT 0x0 /end DAQ_EVENT
 /end IF_DATA
/end MEASUREMENT
/begin COMPU_METHOD wlb.06.error_COMPU_METHOD "" LINEAR "%6.3" "" COEFFS_LINEAR 1 0 /end COMPU_METHOD
/begin MEASUREMENT wlb.06.error "error" SBYTE wlb.06.error_COMPU_METHOD 0 0 -128 127 ECU_ADDRESS 0x6FD39
 /begin IF_DATA XCP
  /begin DAQ_EVENT FIXED_EVENT_LIST EVENT 0x0 /end DAQ_EVENT
 /end IF_DATA
/end MEASUREMENT
/begin COMPU_METHOD wlb.06.operation_mode_display_COMPU_METHOD "" LINEAR "%6.3" "" COEFFS_LINEAR 1 0 /end COMPU_METHOD
/begin MEASUREMENT wlb.06.operation_mode_display "operation_mode_display" SBYTE wlb.06.operation_mode_display_COMPU_METHOD 0 0 -128 127 ECU_ADDRESS 0x6FD3A
 /begin IF_DATA XCP
  /begin DAQ_EVENT FIXED_EVENT_LIST EVENT 0x0 /end DAQ_EVENT
 /end IF_DATA
/end MEASUREMENT
/begin GROUP joints_status.06.wlb ""
 /begin REF_MEASUREMENT wlb.06.pos_fb wlb.06.vel_fb wlb.06.torque_fb wlb.06.current_fb wlb.06.motor_temper wlb.06.min_soft_position_limit wlb.06.max_soft_position_limit wlb.06.max_profile_velocity wlb.06.voltage wlb.06.enabled wlb.06.error wlb.06.operation_mode_display /end REF_MEASUREMENT
/end GROUP
/begin COMPU_METHOD wl.07.pos_cmd_COMPU_METHOD "" LINEAR "%6.3" "" COEFFS_LINEAR 1 0 /end COMPU_METHOD
/begin MEASUREMENT wl.07.pos_cmd "pos_cmd" FLOAT64_IEEE wl.07.pos_cmd_COMPU_METHOD 0 0 -1E12 1E12 ECU_ADDRESS 0x70BE8
 /begin IF_DATA XCP
  /begin DAQ_EVENT FIXED_EVENT_LIST EVENT 0x0 /end DAQ_EVENT
 /end IF_DATA
/end MEASUREMENT
/begin COMPU_METHOD wl.07.vel_cmd_COMPU_METHOD "" LINEAR "%6.3" "" COEFFS_LINEAR 1 0 /end COMPU_METHOD
/begin MEASUREMENT wl.07.vel_cmd "vel_cmd" FLOAT64_IEEE wl.07.vel_cmd_COMPU_METHOD 0 0 -1E12 1E12 ECU_ADDRESS 0x70BF0
 /begin IF_DATA XCP
  /begin DAQ_EVENT FIXED_EVENT_LIST EVENT 0x0 /end DAQ_EVENT
 /end IF_DATA
/end MEASUREMENT
/begin COMPU_METHOD wl.07.torque_cmd_COMPU_METHOD "" LINEAR "%6.3" "" COEFFS_LINEAR 1 0 /end COMPU_METHOD
/begin MEASUREMENT wl.07.torque_cmd "torque_cmd" FLOAT64_IEEE wl.07.torque_cmd_COMPU_METHOD 0 0 -1E12 1E12 ECU_ADDRESS 0x70BF8
 /begin IF_DATA XCP
  /begin DAQ_EVENT FIXED_EVENT_LIST EVENT 0x0 /end DAQ_EVENT
 /end IF_DATA
/end MEASUREMENT
/begin COMPU_METHOD wl.07.current_cmd_COMPU_METHOD "" LINEAR "%6.3" "" COEFFS_LINEAR 1 0 /end COMPU_METHOD
/begin MEASUREMENT wl.07.current_cmd "current_cmd" FLOAT64_IEEE wl.07.current_cmd_COMPU_METHOD 0 0 -1E12 1E12 ECU_ADDRESS 0x70C00
 /begin IF_DATA XCP
  /begin DAQ_EVENT FIXED_EVENT_LIST EVENT 0x0 /end DAQ_EVENT
 /end IF_DATA
/end MEASUREMENT
/begin COMPU_METHOD wl.07.velocity_COMPU_METHOD "" LINEAR "%6.3" "" COEFFS_LINEAR 1 0 /end COMPU_METHOD
/begin MEASUREMENT wl.07.velocity "velocity" FLOAT64_IEEE wl.07.velocity_COMPU_METHOD 0 0 -1E12 1E12 ECU_ADDRESS 0x70C08
 /begin IF_DATA XCP
  /begin DAQ_EVENT FIXED_EVENT_LIST EVENT 0x0 /end DAQ_EVENT
 /end IF_DATA
/end MEASUREMENT
/begin COMPU_METHOD wl.07.max_velocity_COMPU_METHOD "" LINEAR "%6.3" "" COEFFS_LINEAR 1 0 /end COMPU_METHOD
/begin MEASUREMENT wl.07.max_velocity "max_velocity" FLOAT64_IEEE wl.07.max_velocity_COMPU_METHOD 0 0 -1E12 1E12 ECU_ADDRESS 0x70C10
 /begin IF_DATA XCP
  /begin DAQ_EVENT FIXED_EVENT_LIST EVENT 0x0 /end DAQ_EVENT
 /end IF_DATA
/end MEASUREMENT
/begin COMPU_METHOD wl.07.acceleration_COMPU_METHOD "" LINEAR "%6.3" "" COEFFS_LINEAR 1 0 /end COMPU_METHOD
/begin MEASUREMENT wl.07.acceleration "acceleration" FLOAT64_IEEE wl.07.acceleration_COMPU_METHOD 0 0 -1E12 1E12 ECU_ADDRESS 0x70C18
 /begin IF_DATA XCP
  /begin DAQ_EVENT FIXED_EVENT_LIST EVENT 0x0 /end DAQ_EVENT
 /end IF_DATA
/end MEASUREMENT
/begin COMPU_METHOD wl.07.deceleration_COMPU_METHOD "" LINEAR "%6.3" "" COEFFS_LINEAR 1 0 /end COMPU_METHOD
/begin MEASUREMENT wl.07.deceleration "deceleration" FLOAT64_IEEE wl.07.deceleration_COMPU_METHOD 0 0 -1E12 1E12 ECU_ADDRESS 0x70C20
 /begin IF_DATA XCP
  /begin DAQ_EVENT FIXED_EVENT_LIST EVENT 0x0 /end DAQ_EVENT
 /end IF_DATA
/end MEASUREMENT
/begin COMPU_METHOD wl.07.KP_COMPU_METHOD "" LINEAR "%6.3" "" COEFFS_LINEAR 1 0 /end COMPU_METHOD
/begin MEASUREMENT wl.07.KP "KP" FLOAT64_IEEE wl.07.KP_COMPU_METHOD 0 0 -1E12 1E12 ECU_ADDRESS 0x70C28
 /begin IF_DATA XCP
  /begin DAQ_EVENT FIXED_EVENT_LIST EVENT 0x0 /end DAQ_EVENT
 /end IF_DATA
/end MEASUREMENT
/begin COMPU_METHOD wl.07.KD_COMPU_METHOD "" LINEAR "%6.3" "" COEFFS_LINEAR 1 0 /end COMPU_METHOD
/begin MEASUREMENT wl.07.KD "KD" FLOAT64_IEEE wl.07.KD_COMPU_METHOD 0 0 -1E12 1E12 ECU_ADDRESS 0x70C30
 /begin IF_DATA XCP
  /begin DAQ_EVENT FIXED_EVENT_LIST EVENT 0x0 /end DAQ_EVENT
 /end IF_DATA
/end MEASUREMENT
/begin COMPU_METHOD wl.07.enable_COMPU_METHOD "" LINEAR "%6.3" "" COEFFS_LINEAR 1 0 /end COMPU_METHOD
/begin MEASUREMENT wl.07.enable "enable" SBYTE wl.07.enable_COMPU_METHOD 0 0 -128 127 ECU_ADDRESS 0x70C38
 /begin IF_DATA XCP
  /begin DAQ_EVENT FIXED_EVENT_LIST EVENT 0x0 /end DAQ_EVENT
 /end IF_DATA
/end MEASUREMENT
/begin COMPU_METHOD wl.07.operation_mode_COMPU_METHOD "" LINEAR "%6.3" "" COEFFS_LINEAR 1 0 /end COMPU_METHOD
/begin MEASUREMENT wl.07.operation_mode "operation_mode" SBYTE wl.07.operation_mode_COMPU_METHOD 0 0 -128 127 ECU_ADDRESS 0x70C39
 /begin IF_DATA XCP
  /begin DAQ_EVENT FIXED_EVENT_LIST EVENT 0x0 /end DAQ_EVENT
 /end IF_DATA
/end MEASUREMENT
/begin COMPU_METHOD wl.07.polarity_COMPU_METHOD "" LINEAR "%6.3" "" COEFFS_LINEAR 1 0 /end COMPU_METHOD
/begin MEASUREMENT wl.07.polarity "polarity" UBYTE wl.07.polarity_COMPU_METHOD 0 0 0 255 ECU_ADDRESS 0x70C3A
 /begin IF_DATA XCP
  /begin DAQ_EVENT FIXED_EVENT_LIST EVENT 0x0 /end DAQ_EVENT
 /end IF_DATA
/end MEASUREMENT
/begin GROUP joints_cmd.07.wl ""
 /begin REF_MEASUREMENT wl.07.pos_cmd wl.07.vel_cmd wl.07.torque_cmd wl.07.current_cmd wl.07.velocity wl.07.max_velocity wl.07.acceleration wl.07.deceleration wl.07.KP wl.07.KD wl.07.enable wl.07.operation_mode wl.07.polarity /end REF_MEASUREMENT
/end GROUP
/begin COMPU_METHOD wl.07.pos_fb_COMPU_METHOD "" LINEAR "%6.3" "" COEFFS_LINEAR 1 0 /end COMPU_METHOD
/begin MEASUREMENT wl.07.pos_fb "pos_fb" FLOAT64_IEEE wl.07.pos_fb_COMPU_METHOD 0 0 -1E12 1E12 ECU_ADDRESS 0x6FD48
 /begin IF_DATA XCP
  /begin DAQ_EVENT FIXED_EVENT_LIST EVENT 0x0 /end DAQ_EVENT
 /end IF_DATA
/end MEASUREMENT
/begin COMPU_METHOD wl.07.vel_fb_COMPU_METHOD "" LINEAR "%6.3" "" COEFFS_LINEAR 1 0 /end COMPU_METHOD
/begin MEASUREMENT wl.07.vel_fb "vel_fb" FLOAT64_IEEE wl.07.vel_fb_COMPU_METHOD 0 0 -1E12 1E12 ECU_ADDRESS 0x6FD50
 /begin IF_DATA XCP
  /begin DAQ_EVENT FIXED_EVENT_LIST EVENT 0x0 /end DAQ_EVENT
 /end IF_DATA
/end MEASUREMENT
/begin COMPU_METHOD wl.07.torque_fb_COMPU_METHOD "" LINEAR "%6.3" "" COEFFS_LINEAR 1 0 /end COMPU_METHOD
/begin MEASUREMENT wl.07.torque_fb "torque_fb" FLOAT64_IEEE wl.07.torque_fb_COMPU_METHOD 0 0 -1E12 1E12 ECU_ADDRESS 0x6FD58
 /begin IF_DATA XCP
  /begin DAQ_EVENT FIXED_EVENT_LIST EVENT 0x0 /end DAQ_EVENT
 /end IF_DATA
/end MEASUREMENT
/begin COMPU_METHOD wl.07.current_fb_COMPU_METHOD "" LINEAR "%6.3" "" COEFFS_LINEAR 1 0 /end COMPU_METHOD
/begin MEASUREMENT wl.07.current_fb "current_fb" FLOAT64_IEEE wl.07.current_fb_COMPU_METHOD 0 0 -1E12 1E12 ECU_ADDRESS 0x6FD60
 /begin IF_DATA XCP
  /begin DAQ_EVENT FIXED_EVENT_LIST EVENT 0x0 /end DAQ_EVENT
 /end IF_DATA
/end MEASUREMENT
/begin COMPU_METHOD wl.07.motor_temper_COMPU_METHOD "" LINEAR "%6.3" "" COEFFS_LINEAR 1 0 /end COMPU_METHOD
/begin MEASUREMENT wl.07.motor_temper "motor_temper" FLOAT64_IEEE wl.07.motor_temper_COMPU_METHOD 0 0 -1E12 1E12 ECU_ADDRESS 0x6FD68
 /begin IF_DATA XCP
  /begin DAQ_EVENT FIXED_EVENT_LIST EVENT 0x0 /end DAQ_EVENT
 /end IF_DATA
/end MEASUREMENT
/begin COMPU_METHOD wl.07.min_soft_position_limit_COMPU_METHOD "" LINEAR "%6.3" "" COEFFS_LINEAR 1 0 /end COMPU_METHOD
/begin MEASUREMENT wl.07.min_soft_position_limit "min_soft_position_limit" FLOAT64_IEEE wl.07.min_soft_position_limit_COMPU_METHOD 0 0 -1E12 1E12 ECU_ADDRESS 0x6FD70
 /begin IF_DATA XCP
  /begin DAQ_EVENT FIXED_EVENT_LIST EVENT 0x0 /end DAQ_EVENT
 /end IF_DATA
/end MEASUREMENT
/begin COMPU_METHOD wl.07.max_soft_position_limit_COMPU_METHOD "" LINEAR "%6.3" "" COEFFS_LINEAR 1 0 /end COMPU_METHOD
/begin MEASUREMENT wl.07.max_soft_position_limit "max_soft_position_limit" FLOAT64_IEEE wl.07.max_soft_position_limit_COMPU_METHOD 0 0 -1E12 1E12 ECU_ADDRESS 0x6FD78
 /begin IF_DATA XCP
  /begin DAQ_EVENT FIXED_EVENT_LIST EVENT 0x0 /end DAQ_EVENT
 /end IF_DATA
/end MEASUREMENT
/begin COMPU_METHOD wl.07.max_profile_velocity_COMPU_METHOD "" LINEAR "%6.3" "" COEFFS_LINEAR 1 0 /end COMPU_METHOD
/begin MEASUREMENT wl.07.max_profile_velocity "max_profile_velocity" FLOAT64_IEEE wl.07.max_profile_velocity_COMPU_METHOD 0 0 -1E12 1E12 ECU_ADDRESS 0x6FD80
 /begin IF_DATA XCP
  /begin DAQ_EVENT FIXED_EVENT_LIST EVENT 0x0 /end DAQ_EVENT
 /end IF_DATA
/end MEASUREMENT
/begin COMPU_METHOD wl.07.voltage_COMPU_METHOD "" LINEAR "%6.3" "" COEFFS_LINEAR 1 0 /end COMPU_METHOD
/begin MEASUREMENT wl.07.voltage "voltage" FLOAT64_IEEE wl.07.voltage_COMPU_METHOD 0 0 -1E12 1E12 ECU_ADDRESS 0x6FD90
 /begin IF_DATA XCP
  /begin DAQ_EVENT FIXED_EVENT_LIST EVENT 0x0 /end DAQ_EVENT
 /end IF_DATA
/end MEASUREMENT
/begin COMPU_METHOD wl.07.enabled_COMPU_METHOD "" LINEAR "%6.3" "" COEFFS_LINEAR 1 0 /end COMPU_METHOD
/begin MEASUREMENT wl.07.enabled "enabled" SBYTE wl.07.enabled_COMPU_METHOD 0 0 -128 127 ECU_ADDRESS 0x6FD88
 /begin IF_DATA XCP
  /begin DAQ_EVENT FIXED_EVENT_LIST EVENT 0x0 /end DAQ_EVENT
 /end IF_DATA
/end MEASUREMENT
/begin COMPU_METHOD wl.07.error_COMPU_METHOD "" LINEAR "%6.3" "" COEFFS_LINEAR 1 0 /end COMPU_METHOD
/begin MEASUREMENT wl.07.error "error" SBYTE wl.07.error_COMPU_METHOD 0 0 -128 127 ECU_ADDRESS 0x6FD89
 /begin IF_DATA XCP
  /begin DAQ_EVENT FIXED_EVENT_LIST EVENT 0x0 /end DAQ_EVENT
 /end IF_DATA
/end MEASUREMENT
/begin COMPU_METHOD wl.07.operation_mode_display_COMPU_METHOD "" LINEAR "%6.3" "" COEFFS_LINEAR 1 0 /end COMPU_METHOD
/begin MEASUREMENT wl.07.operation_mode_display "operation_mode_display" SBYTE wl.07.operation_mode_display_COMPU_METHOD 0 0 -128 127 ECU_ADDRESS 0x6FD8A
 /begin IF_DATA XCP
  /begin DAQ_EVENT FIXED_EVENT_LIST EVENT 0x0 /end DAQ_EVENT
 /end IF_DATA
/end MEASUREMENT
/begin GROUP joints_status.07.wl ""
 /begin REF_MEASUREMENT wl.07.pos_fb wl.07.vel_fb wl.07.torque_fb wl.07.current_fb wl.07.motor_temper wl.07.min_soft_position_limit wl.07.max_soft_position_limit wl.07.max_profile_velocity wl.07.voltage wl.07.enabled wl.07.error wl.07.operation_mode_display /end REF_MEASUREMENT
/end GROUP
/begin COMPU_METHOD swl.08.pos_cmd_COMPU_METHOD "" LINEAR "%6.3" "" COEFFS_LINEAR 1 0 /end COMPU_METHOD
/begin MEASUREMENT swl.08.pos_cmd "pos_cmd" FLOAT64_IEEE swl.08.pos_cmd_COMPU_METHOD 0 0 -1E12 1E12 ECU_ADDRESS 0x70C40
 /begin IF_DATA XCP
  /begin DAQ_EVENT FIXED_EVENT_LIST EVENT 0x0 /end DAQ_EVENT
 /end IF_DATA
/end MEASUREMENT
/begin COMPU_METHOD swl.08.vel_cmd_COMPU_METHOD "" LINEAR "%6.3" "" COEFFS_LINEAR 1 0 /end COMPU_METHOD
/begin MEASUREMENT swl.08.vel_cmd "vel_cmd" FLOAT64_IEEE swl.08.vel_cmd_COMPU_METHOD 0 0 -1E12 1E12 ECU_ADDRESS 0x70C48
 /begin IF_DATA XCP
  /begin DAQ_EVENT FIXED_EVENT_LIST EVENT 0x0 /end DAQ_EVENT
 /end IF_DATA
/end MEASUREMENT
/begin COMPU_METHOD swl.08.torque_cmd_COMPU_METHOD "" LINEAR "%6.3" "" COEFFS_LINEAR 1 0 /end COMPU_METHOD
/begin MEASUREMENT swl.08.torque_cmd "torque_cmd" FLOAT64_IEEE swl.08.torque_cmd_COMPU_METHOD 0 0 -1E12 1E12 ECU_ADDRESS 0x70C50
 /begin IF_DATA XCP
  /begin DAQ_EVENT FIXED_EVENT_LIST EVENT 0x0 /end DAQ_EVENT
 /end IF_DATA
/end MEASUREMENT
/begin COMPU_METHOD swl.08.current_cmd_COMPU_METHOD "" LINEAR "%6.3" "" COEFFS_LINEAR 1 0 /end COMPU_METHOD
/begin MEASUREMENT swl.08.current_cmd "current_cmd" FLOAT64_IEEE swl.08.current_cmd_COMPU_METHOD 0 0 -1E12 1E12 ECU_ADDRESS 0x70C58
 /begin IF_DATA XCP
  /begin DAQ_EVENT FIXED_EVENT_LIST EVENT 0x0 /end DAQ_EVENT
 /end IF_DATA
/end MEASUREMENT
/begin COMPU_METHOD swl.08.velocity_COMPU_METHOD "" LINEAR "%6.3" "" COEFFS_LINEAR 1 0 /end COMPU_METHOD
/begin MEASUREMENT swl.08.velocity "velocity" FLOAT64_IEEE swl.08.velocity_COMPU_METHOD 0 0 -1E12 1E12 ECU_ADDRESS 0x70C60
 /begin IF_DATA XCP
  /begin DAQ_EVENT FIXED_EVENT_LIST EVENT 0x0 /end DAQ_EVENT
 /end IF_DATA
/end MEASUREMENT
/begin COMPU_METHOD swl.08.max_velocity_COMPU_METHOD "" LINEAR "%6.3" "" COEFFS_LINEAR 1 0 /end COMPU_METHOD
/begin MEASUREMENT swl.08.max_velocity "max_velocity" FLOAT64_IEEE swl.08.max_velocity_COMPU_METHOD 0 0 -1E12 1E12 ECU_ADDRESS 0x70C68
 /begin IF_DATA XCP
  /begin DAQ_EVENT FIXED_EVENT_LIST EVENT 0x0 /end DAQ_EVENT
 /end IF_DATA
/end MEASUREMENT
/begin COMPU_METHOD swl.08.acceleration_COMPU_METHOD "" LINEAR "%6.3" "" COEFFS_LINEAR 1 0 /end COMPU_METHOD
/begin MEASUREMENT swl.08.acceleration "acceleration" FLOAT64_IEEE swl.08.acceleration_COMPU_METHOD 0 0 -1E12 1E12 ECU_ADDRESS 0x70C70
 /begin IF_DATA XCP
  /begin DAQ_EVENT FIXED_EVENT_LIST EVENT 0x0 /end DAQ_EVENT
 /end IF_DATA
/end MEASUREMENT
/begin COMPU_METHOD swl.08.deceleration_COMPU_METHOD "" LINEAR "%6.3" "" COEFFS_LINEAR 1 0 /end COMPU_METHOD
/begin MEASUREMENT swl.08.deceleration "deceleration" FLOAT64_IEEE swl.08.deceleration_COMPU_METHOD 0 0 -1E12 1E12 ECU_ADDRESS 0x70C78
 /begin IF_DATA XCP
  /begin DAQ_EVENT FIXED_EVENT_LIST EVENT 0x0 /end DAQ_EVENT
 /end IF_DATA
/end MEASUREMENT
/begin COMPU_METHOD swl.08.KP_COMPU_METHOD "" LINEAR "%6.3" "" COEFFS_LINEAR 1 0 /end COMPU_METHOD
/begin MEASUREMENT swl.08.KP "KP" FLOAT64_IEEE swl.08.KP_COMPU_METHOD 0 0 -1E12 1E12 ECU_ADDRESS 0x70C80
 /begin IF_DATA XCP
  /begin DAQ_EVENT FIXED_EVENT_LIST EVENT 0x0 /end DAQ_EVENT
 /end IF_DATA
/end MEASUREMENT
/begin COMPU_METHOD swl.08.KD_COMPU_METHOD "" LINEAR "%6.3" "" COEFFS_LINEAR 1 0 /end COMPU_METHOD
/begin MEASUREMENT swl.08.KD "KD" FLOAT64_IEEE swl.08.KD_COMPU_METHOD 0 0 -1E12 1E12 ECU_ADDRESS 0x70C88
 /begin IF_DATA XCP
  /begin DAQ_EVENT FIXED_EVENT_LIST EVENT 0x0 /end DAQ_EVENT
 /end IF_DATA
/end MEASUREMENT
/begin COMPU_METHOD swl.08.enable_COMPU_METHOD "" LINEAR "%6.3" "" COEFFS_LINEAR 1 0 /end COMPU_METHOD
/begin MEASUREMENT swl.08.enable "enable" SBYTE swl.08.enable_COMPU_METHOD 0 0 -128 127 ECU_ADDRESS 0x70C90
 /begin IF_DATA XCP
  /begin DAQ_EVENT FIXED_EVENT_LIST EVENT 0x0 /end DAQ_EVENT
 /end IF_DATA
/end MEASUREMENT
/begin COMPU_METHOD swl.08.operation_mode_COMPU_METHOD "" LINEAR "%6.3" "" COEFFS_LINEAR 1 0 /end COMPU_METHOD
/begin MEASUREMENT swl.08.operation_mode "operation_mode" SBYTE swl.08.operation_mode_COMPU_METHOD 0 0 -128 127 ECU_ADDRESS 0x70C91
 /begin IF_DATA XCP
  /begin DAQ_EVENT FIXED_EVENT_LIST EVENT 0x0 /end DAQ_EVENT
 /end IF_DATA
/end MEASUREMENT
/begin COMPU_METHOD swl.08.polarity_COMPU_METHOD "" LINEAR "%6.3" "" COEFFS_LINEAR 1 0 /end COMPU_METHOD
/begin MEASUREMENT swl.08.polarity "polarity" UBYTE swl.08.polarity_COMPU_METHOD 0 0 0 255 ECU_ADDRESS 0x70C92
 /begin IF_DATA XCP
  /begin DAQ_EVENT FIXED_EVENT_LIST EVENT 0x0 /end DAQ_EVENT
 /end IF_DATA
/end MEASUREMENT
/begin GROUP joints_cmd.08.swl ""
 /begin REF_MEASUREMENT swl.08.pos_cmd swl.08.vel_cmd swl.08.torque_cmd swl.08.current_cmd swl.08.velocity swl.08.max_velocity swl.08.acceleration swl.08.deceleration swl.08.KP swl.08.KD swl.08.enable swl.08.operation_mode swl.08.polarity /end REF_MEASUREMENT
/end GROUP
/begin COMPU_METHOD swl.08.pos_fb_COMPU_METHOD "" LINEAR "%6.3" "" COEFFS_LINEAR 1 0 /end COMPU_METHOD
/begin MEASUREMENT swl.08.pos_fb "pos_fb" FLOAT64_IEEE swl.08.pos_fb_COMPU_METHOD 0 0 -1E12 1E12 ECU_ADDRESS 0x6FD98
 /begin IF_DATA XCP
  /begin DAQ_EVENT FIXED_EVENT_LIST EVENT 0x0 /end DAQ_EVENT
 /end IF_DATA
/end MEASUREMENT
/begin COMPU_METHOD swl.08.vel_fb_COMPU_METHOD "" LINEAR "%6.3" "" COEFFS_LINEAR 1 0 /end COMPU_METHOD
/begin MEASUREMENT swl.08.vel_fb "vel_fb" FLOAT64_IEEE swl.08.vel_fb_COMPU_METHOD 0 0 -1E12 1E12 ECU_ADDRESS 0x6FDA0
 /begin IF_DATA XCP
  /begin DAQ_EVENT FIXED_EVENT_LIST EVENT 0x0 /end DAQ_EVENT
 /end IF_DATA
/end MEASUREMENT
/begin COMPU_METHOD swl.08.torque_fb_COMPU_METHOD "" LINEAR "%6.3" "" COEFFS_LINEAR 1 0 /end COMPU_METHOD
/begin MEASUREMENT swl.08.torque_fb "torque_fb" FLOAT64_IEEE swl.08.torque_fb_COMPU_METHOD 0 0 -1E12 1E12 ECU_ADDRESS 0x6FDA8
 /begin IF_DATA XCP
  /begin DAQ_EVENT FIXED_EVENT_LIST EVENT 0x0 /end DAQ_EVENT
 /end IF_DATA
/end MEASUREMENT
/begin COMPU_METHOD swl.08.current_fb_COMPU_METHOD "" LINEAR "%6.3" "" COEFFS_LINEAR 1 0 /end COMPU_METHOD
/begin MEASUREMENT swl.08.current_fb "current_fb" FLOAT64_IEEE swl.08.current_fb_COMPU_METHOD 0 0 -1E12 1E12 ECU_ADDRESS 0x6FDB0
 /begin IF_DATA XCP
  /begin DAQ_EVENT FIXED_EVENT_LIST EVENT 0x0 /end DAQ_EVENT
 /end IF_DATA
/end MEASUREMENT
/begin COMPU_METHOD swl.08.motor_temper_COMPU_METHOD "" LINEAR "%6.3" "" COEFFS_LINEAR 1 0 /end COMPU_METHOD
/begin MEASUREMENT swl.08.motor_temper "motor_temper" FLOAT64_IEEE swl.08.motor_temper_COMPU_METHOD 0 0 -1E12 1E12 ECU_ADDRESS 0x6FDB8
 /begin IF_DATA XCP
  /begin DAQ_EVENT FIXED_EVENT_LIST EVENT 0x0 /end DAQ_EVENT
 /end IF_DATA
/end MEASUREMENT
/begin COMPU_METHOD swl.08.min_soft_position_limit_COMPU_METHOD "" LINEAR "%6.3" "" COEFFS_LINEAR 1 0 /end COMPU_METHOD
/begin MEASUREMENT swl.08.min_soft_position_limit "min_soft_position_limit" FLOAT64_IEEE swl.08.min_soft_position_limit_COMPU_METHOD 0 0 -1E12 1E12 ECU_ADDRESS 0x6FDC0
 /begin IF_DATA XCP
  /begin DAQ_EVENT FIXED_EVENT_LIST EVENT 0x0 /end DAQ_EVENT
 /end IF_DATA
/end MEASUREMENT
/begin COMPU_METHOD swl.08.max_soft_position_limit_COMPU_METHOD "" LINEAR "%6.3" "" COEFFS_LINEAR 1 0 /end COMPU_METHOD
/begin MEASUREMENT swl.08.max_soft_position_limit "max_soft_position_limit" FLOAT64_IEEE swl.08.max_soft_position_limit_COMPU_METHOD 0 0 -1E12 1E12 ECU_ADDRESS 0x6FDC8
 /begin IF_DATA XCP
  /begin DAQ_EVENT FIXED_EVENT_LIST EVENT 0x0 /end DAQ_EVENT
 /end IF_DATA
/end MEASUREMENT
/begin COMPU_METHOD swl.08.max_profile_velocity_COMPU_METHOD "" LINEAR "%6.3" "" COEFFS_LINEAR 1 0 /end COMPU_METHOD
/begin MEASUREMENT swl.08.max_profile_velocity "max_profile_velocity" FLOAT64_IEEE swl.08.max_profile_velocity_COMPU_METHOD 0 0 -1E12 1E12 ECU_ADDRESS 0x6FDD0
 /begin IF_DATA XCP
  /begin DAQ_EVENT FIXED_EVENT_LIST EVENT 0x0 /end DAQ_EVENT
 /end IF_DATA
/end MEASUREMENT
/begin COMPU_METHOD swl.08.voltage_COMPU_METHOD "" LINEAR "%6.3" "" COEFFS_LINEAR 1 0 /end COMPU_METHOD
/begin MEASUREMENT swl.08.voltage "voltage" FLOAT64_IEEE swl.08.voltage_COMPU_METHOD 0 0 -1E12 1E12 ECU_ADDRESS 0x6FDE0
 /begin IF_DATA XCP
  /begin DAQ_EVENT FIXED_EVENT_LIST EVENT 0x0 /end DAQ_EVENT
 /end IF_DATA
/end MEASUREMENT
/begin COMPU_METHOD swl.08.enabled_COMPU_METHOD "" LINEAR "%6.3" "" COEFFS_LINEAR 1 0 /end COMPU_METHOD
/begin MEASUREMENT swl.08.enabled "enabled" SBYTE swl.08.enabled_COMPU_METHOD 0 0 -128 127 ECU_ADDRESS 0x6FDD8
 /begin IF_DATA XCP
  /begin DAQ_EVENT FIXED_EVENT_LIST EVENT 0x0 /end DAQ_EVENT
 /end IF_DATA
/end MEASUREMENT
/begin COMPU_METHOD swl.08.error_COMPU_METHOD "" LINEAR "%6.3" "" COEFFS_LINEAR 1 0 /end COMPU_METHOD
/begin MEASUREMENT swl.08.error "error" SBYTE swl.08.error_COMPU_METHOD 0 0 -128 127 ECU_ADDRESS 0x6FDD9
 /begin IF_DATA XCP
  /begin DAQ_EVENT FIXED_EVENT_LIST EVENT 0x0 /end DAQ_EVENT
 /end IF_DATA
/end MEASUREMENT
/begin COMPU_METHOD swl.08.operation_mode_display_COMPU_METHOD "" LINEAR "%6.3" "" COEFFS_LINEAR 1 0 /end COMPU_METHOD
/begin MEASUREMENT swl.08.operation_mode_display "operation_mode_display" SBYTE swl.08.operation_mode_display_COMPU_METHOD 0 0 -128 127 ECU_ADDRESS 0x6FDDA
 /begin IF_DATA XCP
  /begin DAQ_EVENT FIXED_EVENT_LIST EVENT 0x0 /end DAQ_EVENT
 /end IF_DATA
/end MEASUREMENT
/begin GROUP joints_status.08.swl ""
 /begin REF_MEASUREMENT swl.08.pos_fb swl.08.vel_fb swl.08.torque_fb swl.08.current_fb swl.08.motor_temper swl.08.min_soft_position_limit swl.08.max_soft_position_limit swl.08.max_profile_velocity swl.08.voltage swl.08.enabled swl.08.error swl.08.operation_mode_display /end REF_MEASUREMENT
/end GROUP
/begin COMPU_METHOD swr.09.pos_cmd_COMPU_METHOD "" LINEAR "%6.3" "" COEFFS_LINEAR 1 0 /end COMPU_METHOD
/begin MEASUREMENT swr.09.pos_cmd "pos_cmd" FLOAT64_IEEE swr.09.pos_cmd_COMPU_METHOD 0 0 -1E12 1E12 ECU_ADDRESS 0x70C98
 /begin IF_DATA XCP
  /begin DAQ_EVENT FIXED_EVENT_LIST EVENT 0x0 /end DAQ_EVENT
 /end IF_DATA
/end MEASUREMENT
/begin COMPU_METHOD swr.09.vel_cmd_COMPU_METHOD "" LINEAR "%6.3" "" COEFFS_LINEAR 1 0 /end COMPU_METHOD
/begin MEASUREMENT swr.09.vel_cmd "vel_cmd" FLOAT64_IEEE swr.09.vel_cmd_COMPU_METHOD 0 0 -1E12 1E12 ECU_ADDRESS 0x70CA0
 /begin IF_DATA XCP
  /begin DAQ_EVENT FIXED_EVENT_LIST EVENT 0x0 /end DAQ_EVENT
 /end IF_DATA
/end MEASUREMENT
/begin COMPU_METHOD swr.09.torque_cmd_COMPU_METHOD "" LINEAR "%6.3" "" COEFFS_LINEAR 1 0 /end COMPU_METHOD
/begin MEASUREMENT swr.09.torque_cmd "torque_cmd" FLOAT64_IEEE swr.09.torque_cmd_COMPU_METHOD 0 0 -1E12 1E12 ECU_ADDRESS 0x70CA8
 /begin IF_DATA XCP
  /begin DAQ_EVENT FIXED_EVENT_LIST EVENT 0x0 /end DAQ_EVENT
 /end IF_DATA
/end MEASUREMENT
/begin COMPU_METHOD swr.09.current_cmd_COMPU_METHOD "" LINEAR "%6.3" "" COEFFS_LINEAR 1 0 /end COMPU_METHOD
/begin MEASUREMENT swr.09.current_cmd "current_cmd" FLOAT64_IEEE swr.09.current_cmd_COMPU_METHOD 0 0 -1E12 1E12 ECU_ADDRESS 0x70CB0
 /begin IF_DATA XCP
  /begin DAQ_EVENT FIXED_EVENT_LIST EVENT 0x0 /end DAQ_EVENT
 /end IF_DATA
/end MEASUREMENT
/begin COMPU_METHOD swr.09.velocity_COMPU_METHOD "" LINEAR "%6.3" "" COEFFS_LINEAR 1 0 /end COMPU_METHOD
/begin MEASUREMENT swr.09.velocity "velocity" FLOAT64_IEEE swr.09.velocity_COMPU_METHOD 0 0 -1E12 1E12 ECU_ADDRESS 0x70CB8
 /begin IF_DATA XCP
  /begin DAQ_EVENT FIXED_EVENT_LIST EVENT 0x0 /end DAQ_EVENT
 /end IF_DATA
/end MEASUREMENT
/begin COMPU_METHOD swr.09.max_velocity_COMPU_METHOD "" LINEAR "%6.3" "" COEFFS_LINEAR 1 0 /end COMPU_METHOD
/begin MEASUREMENT swr.09.max_velocity "max_velocity" FLOAT64_IEEE swr.09.max_velocity_COMPU_METHOD 0 0 -1E12 1E12 ECU_ADDRESS 0x70CC0
 /begin IF_DATA XCP
  /begin DAQ_EVENT FIXED_EVENT_LIST EVENT 0x0 /end DAQ_EVENT
 /end IF_DATA
/end MEASUREMENT
/begin COMPU_METHOD swr.09.acceleration_COMPU_METHOD "" LINEAR "%6.3" "" COEFFS_LINEAR 1 0 /end COMPU_METHOD
/begin MEASUREMENT swr.09.acceleration "acceleration" FLOAT64_IEEE swr.09.acceleration_COMPU_METHOD 0 0 -1E12 1E12 ECU_ADDRESS 0x70CC8
 /begin IF_DATA XCP
  /begin DAQ_EVENT FIXED_EVENT_LIST EVENT 0x0 /end DAQ_EVENT
 /end IF_DATA
/end MEASUREMENT
/begin COMPU_METHOD swr.09.deceleration_COMPU_METHOD "" LINEAR "%6.3" "" COEFFS_LINEAR 1 0 /end COMPU_METHOD
/begin MEASUREMENT swr.09.deceleration "deceleration" FLOAT64_IEEE swr.09.deceleration_COMPU_METHOD 0 0 -1E12 1E12 ECU_ADDRESS 0x70CD0
 /begin IF_DATA XCP
  /begin DAQ_EVENT FIXED_EVENT_LIST EVENT 0x0 /end DAQ_EVENT
 /end IF_DATA
/end MEASUREMENT
/begin COMPU_METHOD swr.09.KP_COMPU_METHOD "" LINEAR "%6.3" "" COEFFS_LINEAR 1 0 /end COMPU_METHOD
/begin MEASUREMENT swr.09.KP "KP" FLOAT64_IEEE swr.09.KP_COMPU_METHOD 0 0 -1E12 1E12 ECU_ADDRESS 0x70CD8
 /begin IF_DATA XCP
  /begin DAQ_EVENT FIXED_EVENT_LIST EVENT 0x0 /end DAQ_EVENT
 /end IF_DATA
/end MEASUREMENT
/begin COMPU_METHOD swr.09.KD_COMPU_METHOD "" LINEAR "%6.3" "" COEFFS_LINEAR 1 0 /end COMPU_METHOD
/begin MEASUREMENT swr.09.KD "KD" FLOAT64_IEEE swr.09.KD_COMPU_METHOD 0 0 -1E12 1E12 ECU_ADDRESS 0x70CE0
 /begin IF_DATA XCP
  /begin DAQ_EVENT FIXED_EVENT_LIST EVENT 0x0 /end DAQ_EVENT
 /end IF_DATA
/end MEASUREMENT
/begin COMPU_METHOD swr.09.enable_COMPU_METHOD "" LINEAR "%6.3" "" COEFFS_LINEAR 1 0 /end COMPU_METHOD
/begin MEASUREMENT swr.09.enable "enable" SBYTE swr.09.enable_COMPU_METHOD 0 0 -128 127 ECU_ADDRESS 0x70CE8
 /begin IF_DATA XCP
  /begin DAQ_EVENT FIXED_EVENT_LIST EVENT 0x0 /end DAQ_EVENT
 /end IF_DATA
/end MEASUREMENT
/begin COMPU_METHOD swr.09.operation_mode_COMPU_METHOD "" LINEAR "%6.3" "" COEFFS_LINEAR 1 0 /end COMPU_METHOD
/begin MEASUREMENT swr.09.operation_mode "operation_mode" SBYTE swr.09.operation_mode_COMPU_METHOD 0 0 -128 127 ECU_ADDRESS 0x70CE9
 /begin IF_DATA XCP
  /begin DAQ_EVENT FIXED_EVENT_LIST EVENT 0x0 /end DAQ_EVENT
 /end IF_DATA
/end MEASUREMENT
/begin COMPU_METHOD swr.09.polarity_COMPU_METHOD "" LINEAR "%6.3" "" COEFFS_LINEAR 1 0 /end COMPU_METHOD
/begin MEASUREMENT swr.09.polarity "polarity" UBYTE swr.09.polarity_COMPU_METHOD 0 0 0 255 ECU_ADDRESS 0x70CEA
 /begin IF_DATA XCP
  /begin DAQ_EVENT FIXED_EVENT_LIST EVENT 0x0 /end DAQ_EVENT
 /end IF_DATA
/end MEASUREMENT
/begin GROUP joints_cmd.09.swr ""
 /begin REF_MEASUREMENT swr.09.pos_cmd swr.09.vel_cmd swr.09.torque_cmd swr.09.current_cmd swr.09.velocity swr.09.max_velocity swr.09.acceleration swr.09.deceleration swr.09.KP swr.09.KD swr.09.enable swr.09.operation_mode swr.09.polarity /end REF_MEASUREMENT
/end GROUP
/begin COMPU_METHOD channel2_COMPU_METHOD "" LINEAR "%6.3" "" COEFFS_LINEAR 1 0 /end COMPU_METHOD
/begin MEASUREMENT channel2 "Sinus signal 2" FLOAT64_IEEE channel2_COMPU_METHOD 0 0 -1E12 1E12 ECU_ADDRESS 0x726B0
 /begin IF_DATA XCP
  /begin DAQ_EVENT FIXED_EVENT_LIST EVENT 0x1 /end DAQ_EVENT
 /end IF_DATA
/end MEASUREMENT
/begin COMPU_METHOD channel3_COMPU_METHOD "" LINEAR "%6.3" "" COEFFS_LINEAR 1 0 /end COMPU_METHOD
/begin MEASUREMENT channel3 "Sinus signal 3" FLOAT64_IEEE channel3_COMPU_METHOD 0 0 -1E12 1E12 ECU_ADDRESS 0x726A8
 /begin IF_DATA XCP
  /begin DAQ_EVENT FIXED_EVENT_LIST EVENT 0x2 /end DAQ_EVENT
 /end IF_DATA
/end MEASUREMENT
/begin IF_DATA XCP
 /begin PROTOCOL_LAYER 0x0104 1000 2000 0 0 0 0 0 252 1016 BYTE_ORDER_MSB_LAST ADDRESS_GRANULARITY_BYTE OPTIONAL_CMD GET_COMM_MODE_INFO OPTIONAL_CMD GET_ID OPTIONAL_CMD SET_MTA OPTIONAL_CMD UPLOAD OPTIONAL_CMD SHORT_UPLOAD OPTIONAL_CMD DOWNLOAD OPTIONAL_CMD SHORT_DOWNLOAD OPTIONAL_CMD GET_CAL_PAGE OPTIONAL_CMD SET_CAL_PAGE OPTIONAL_CMD BUILD_CHECKSUM OPTIONAL_CMD GET_DAQ_RESOLUTION_INFO OPTIONAL_CMD GET_DAQ_PROCESSOR_INFO OPTIONAL_CMD FREE_DAQ OPTIONAL_CMD ALLOC_DAQ OPTIONAL_CMD ALLOC_ODT OPTIONAL_CMD ALLOC_ODT_ENTRY OPTIONAL_CMD SET_DAQ_PTR OPTIONAL_CMD WRITE_DAQ OPTIONAL_CMD GET_DAQ_LIST_MODE OPTIONAL_CMD SET_DAQ_LIST_MODE OPTIONAL_CMD START_STOP_SYNCH OPTIONAL_CMD START_STOP_DAQ_LIST OPTIONAL_CMD GET_DAQ_CLOCK OPTIONAL_CMD WRITE_DAQ_MULTIPLE OPTIONAL_CMD TIME_CORRELATION_PROPERTIES OPTIONAL_LEVEL1_CMD GET_VERSION /end PROTOCOL_LAYER
 /begin DAQ DYNAMIC 0 4 0 OPTIMISATION_TYPE_DEFAULT ADDRESS_EXTENSION_FREE IDENTIFICATION_FIELD_TYPE_RELATIVE_BYTE GRANULARITY_ODT_ENTRY_SIZE_DAQ_BYTE 0xF8 OVERLOAD_INDICATION_PID /begin TIMESTAMP_SUPPORTED 0x01 SIZE_DWORD UNIT_1NS TIMESTAMP_FIXED /end TIMESTAMP_SUPPORTED
  /begin EVENT "ecuTask1ms" "ecuTask1" 0x0 DAQ 0xFF 100 4 0 CONSISTENCY DAQ /end EVENT
  /begin EVENT "ecuTask2ms" "ecuTask2" 0x1 DAQ 0xFF 200 4 0 CONSISTENCY DAQ /end EVENT
  /begin EVENT "ecuTask5ms" "ecuTask5" 0x2 DAQ 0xFF 50 5 0 CONSISTENCY DAQ /end EVENT
  /begin EVENT "ecuTask10ms" "ecuTask1" 0x3 DAQ 0xFF 100 5 0 CONSISTENCY DAQ /end EVENT
 /end DAQ
 /begin XCP_ON_UDP_IP 0x0104 5555 ADDRESS "192.168.0.1" OPTIONAL_TL_SUBCMD GET_DAQ_CLOCK_MULTICAST /end XCP_ON_UDP_IP
/end IF_DATA
/end MODULE
/end PROJECT
