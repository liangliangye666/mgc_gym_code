ASAP2_VERSION 1 71
/begin PROJECT Demo ""
/begin HEADER "" VERSION "1.0" /end HEADER
/begin MODULE Demo ""
/begin MOD_COMMON "" BYTE_ORDER MSB_LAST ALIGNMENT_BYTE 1 ALIGNMENT_WORD 1 ALIGNMENT_LONG 1 ALIGNMENT_FLOAT16_IEEE 1 ALIGNMENT_FLOAT32_IEEE 1 ALIGNMENT_FLOAT64_IEEE 1 ALIGNMENT_INT64 1 /end MOD_COMMON
/begin TYPEDEF_MEASUREMENT M_FLOAT64_IEEE "" FLOAT64_IEEE NO_COMPU_METHOD 0 0 -1E12 1E12 /end TYPEDEF_MEASUREMENT
/begin TYPEDEF_MEASUREMENT M_FLOAT32_IEEE "" FLOAT32_IEEE NO_COMPU_METHOD 0 0 -1E12 1E12 /end TYPEDEF_MEASUREMENT
/begin TYPEDEF_MEASUREMENT M_A_INT64 "" A_INT64 NO_COMPU_METHOD 0 0 -1E12 1E12 /end TYPEDEF_MEASUREMENT
/begin RECORD_LAYOUT R_SLONG FNC_VALUES 1 SLONG ROW_DIR DIRECT /end RECORD_LAYOUT
/begin TYPEDEF_MEASUREMENT M_SLONG "" SLONG NO_COMPU_METHOD 0 0 -2147483648 2147483647 /end TYPEDEF_MEASUREMENT
/begin RECORD_LAYOUT R_SWORD FNC_VALUES 1 SWORD ROW_DIR DIRECT /end RECORD_LAYOUT
/begin TYPEDEF_MEASUREMENT M_SWORD "" SWORD NO_COMPU_METHOD 0 0 -32768 32767 /end TYPEDEF_MEASUREMENT
/begin RECORD_LAYOUT R_SBYTE FNC_VALUES 1 SBYTE ROW_DIR DIRECT /end RECORD_LAYOUT
/begin TYPEDEF_MEASUREMENT M_SBYTE "" SBYTE NO_COMPU_METHOD 0 0 -128 127 /end TYPEDEF_MEASUREMENT
/begin RECORD_LAYOUT R_UBYTE FNC_VALUES 1 UBYTE ROW_DIR DIRECT /end RECORD_LAYOUT
/begin TYPEDEF_MEASUREMENT M_UBYTE "" UBYTE NO_COMPU_METHOD 0 0 0 255 /end TYPEDEF_MEASUREMENT
/begin RECORD_LAYOUT R_UWORD FNC_VALUES 1 UWORD ROW_DIR DIRECT /end RECORD_LAYOUT
/begin TYPEDEF_MEASUREMENT M_UWORD "" UWORD NO_COMPU_METHOD 0 0 0 65535 /end TYPEDEF_MEASUREMENT
/begin RECORD_LAYOUT R_ULONG FNC_VALUES 1 ULONG ROW_DIR DIRECT /end RECORD_LAYOUT
/begin TYPEDEF_MEASUREMENT M_ULONG "" ULONG NO_COMPU_METHOD 0 0 0 4294967295 /end TYPEDEF_MEASUREMENT
/begin RECORD_LAYOUT R_A_UINT64 FNC_VALUES 1 A_UINT64 ROW_DIR DIRECT /end RECORD_LAYOUT
/begin TYPEDEF_MEASUREMENT M_A_UINT64 "" A_UINT64 NO_COMPU_METHOD 0 0 0 1E12 /end TYPEDEF_MEASUREMENT
/begin CHARACTERISTIC ecuPar.ledSwitch "ledSwitch" VALUE 0x6F828 R_SBYTE 0 NO_COMPU_METHOD 0 1 PHYS_UNIT "" /end CHARACTERISTIC
/begin CHARACTERISTIC save_file "save parameter to file" VALUE 0x726CB R_SBYTE 0 NO_COMPU_METHOD 0 1 PHYS_UNIT "" /end CHARACTERISTIC
/begin COMPU_METHOD save_file_status_COMPU_METHOD "" LINEAR "%6.3" "" COEFFS_LINEAR 1 0 /end COMPU_METHOD
/begin MEASUREMENT save_file_status "status of save parameter to file" SBYTE save_file_status_COMPU_METHOD 0 0 -128 127 ECU_ADDRESS 0x726CA /end MEASUREMENT
/begin COMPU_METHOD swr.09.pos_fb_COMPU_METHOD "" LINEAR "%6.3" "" COEFFS_LINEAR 1 0 /end COMPU_METHOD
/begin MEASUREMENT swr.09.pos_fb "pos_fb" FLOAT64_IEEE swr.09.pos_fb_COMPU_METHOD 0 0 -1E12 1E12 ECU_ADDRESS 0x6FDE8
 /begin IF_DATA XCP
  /begin DAQ_EVENT FIXED_EVENT_LIST EVENT 0x0 /end DAQ_EVENT
 /end IF_DATA
/end MEASUREMENT
/begin COMPU_METHOD swr.09.vel_fb_COMPU_METHOD "" LINEAR "%6.3" "" COEFFS_LINEAR 1 0 /end COMPU_METHOD
/begin MEASUREMENT swr.09.vel_fb "vel_fb" FLOAT64_IEEE swr.09.vel_fb_COMPU_METHOD 0 0 -1E12 1E12 ECU_ADDRESS 0x6FDF0
 /begin IF_DATA XCP
  /begin DAQ_EVENT FIXED_EVENT_LIST EVENT 0x0 /end DAQ_EVENT
 /end IF_DATA
/end MEASUREMENT
/begin COMPU_METHOD swr.09.torque_fb_COMPU_METHOD "" LINEAR "%6.3" "" COEFFS_LINEAR 1 0 /end COMPU_METHOD
/begin MEASUREMENT swr.09.torque_fb "torque_fb" FLOAT64_IEEE swr.09.torque_fb_COMPU_METHOD 0 0 -1E12 1E12 ECU_ADDRESS 0x6FDF8
 /begin IF_DATA XCP
  /begin DAQ_EVENT FIXED_EVENT_LIST EVENT 0x0 /end DAQ_EVENT
 /end IF_DATA
/end MEASUREMENT
/begin COMPU_METHOD swr.09.current_fb_COMPU_METHOD "" LINEAR "%6.3" "" COEFFS_LINEAR 1 0 /end COMPU_METHOD
/begin MEASUREMENT swr.09.current_fb "current_fb" FLOAT64_IEEE swr.09.current_fb_COMPU_METHOD 0 0 -1E12 1E12 ECU_ADDRESS 0x6FE00
 /begin IF_DATA XCP
  /begin DAQ_EVENT FIXED_EVENT_LIST EVENT 0x0 /end DAQ_EVENT
 /end IF_DATA
/end MEASUREMENT
/begin COMPU_METHOD swr.09.motor_temper_COMPU_METHOD "" LINEAR "%6.3" "" COEFFS_LINEAR 1 0 /end COMPU_METHOD
/begin MEASUREMENT swr.09.motor_temper "motor_temper" FLOAT64_IEEE swr.09.motor_temper_COMPU_METHOD 0 0 -1E12 1E12 ECU_ADDRESS 0x6FE08
 /begin IF_DATA XCP
  /begin DAQ_EVENT FIXED_EVENT_LIST EVENT 0x0 /end DAQ_EVENT
 /end IF_DATA
/end MEASUREMENT
/begin COMPU_METHOD swr.09.min_soft_position_limit_COMPU_METHOD "" LINEAR "%6.3" "" COEFFS_LINEAR 1 0 /end COMPU_METHOD
/begin MEASUREMENT swr.09.min_soft_position_limit "min_soft_position_limit" FLOAT64_IEEE swr.09.min_soft_position_limit_COMPU_METHOD 0 0 -1E12 1E12 ECU_ADDRESS 0x6FE10
 /begin IF_DATA XCP
  /begin DAQ_EVENT FIXED_EVENT_LIST EVENT 0x0 /end DAQ_EVENT
 /end IF_DATA
/end MEASUREMENT
/begin COMPU_METHOD swr.09.max_soft_position_limit_COMPU_METHOD "" LINEAR "%6.3" "" COEFFS_LINEAR 1 0 /end COMPU_METHOD
/begin MEASUREMENT swr.09.max_soft_position_limit "max_soft_position_limit" FLOAT64_IEEE swr.09.max_soft_position_limit_COMPU_METHOD 0 0 -1E12 1E12 ECU_ADDRESS 0x6FE18
 /begin IF_DATA XCP
  /begin DAQ_EVENT FIXED_EVENT_LIST EVENT 0x0 /end DAQ_EVENT
 /end IF_DATA
/end MEASUREMENT
/begin COMPU_METHOD swr.09.max_profile_velocity_COMPU_METHOD "" LINEAR "%6.3" "" COEFFS_LINEAR 1 0 /end COMPU_METHOD
/begin MEASUREMENT swr.09.max_profile_velocity "max_profile_velocity" FLOAT64_IEEE swr.09.max_profile_velocity_COMPU_METHOD 0 0 -1E12 1E12 ECU_ADDRESS 0x6FE20
 /begin IF_DATA XCP
  /begin DAQ_EVENT FIXED_EVENT_LIST EVENT 0x0 /end DAQ_EVENT
 /end IF_DATA
/end MEASUREMENT
/begin COMPU_METHOD swr.09.voltage_COMPU_METHOD "" LINEAR "%6.3" "" COEFFS_LINEAR 1 0 /end COMPU_METHOD
/begin MEASUREMENT swr.09.voltage "voltage" FLOAT64_IEEE swr.09.voltage_COMPU_METHOD 0 0 -1E12 1E12 ECU_ADDRESS 0x6FE30
 /begin IF_DATA XCP
  /begin DAQ_EVENT FIXED_EVENT_LIST EVENT 0x0 /end DAQ_EVENT
 /end IF_DATA
/end MEASUREMENT
/begin COMPU_METHOD swr.09.enabled_COMPU_METHOD "" LINEAR "%6.3" "" COEFFS_LINEAR 1 0 /end COMPU_METHOD
/begin MEASUREMENT swr.09.enabled "enabled" SBYTE swr.09.enabled_COMPU_METHOD 0 0 -128 127 ECU_ADDRESS 0x6FE28
 /begin IF_DATA XCP
  /begin DAQ_EVENT FIXED_EVENT_LIST EVENT 0x0 /end DAQ_EVENT
 /end IF_DATA
/end MEASUREMENT
/begin COMPU_METHOD swr.09.error_COMPU_METHOD "" LINEAR "%6.3" "" COEFFS_LINEAR 1 0 /end COMPU_METHOD
/begin MEASUREMENT swr.09.error "error" SBYTE swr.09.error_COMPU_METHOD 0 0 -128 127 ECU_ADDRESS 0x6FE29
 /begin IF_DATA XCP
  /begin DAQ_EVENT FIXED_EVENT_LIST EVENT 0x0 /end DAQ_EVENT
 /end IF_DATA
/end MEASUREMENT
/begin COMPU_METHOD swr.09.operation_mode_display_COMPU_METHOD "" LINEAR "%6.3" "" COEFFS_LINEAR 1 0 /end COMPU_METHOD
/begin MEASUREMENT swr.09.operation_mode_display "operation_mode_display" SBYTE swr.09.operation_mode_display_COMPU_METHOD 0 0 -128 127 ECU_ADDRESS 0x6FE2A
 /begin IF_DATA XCP
  /begin DAQ_EVENT FIXED_EVENT_LIST EVENT 0x0 /end DAQ_EVENT
 /end IF_DATA
/end MEASUREMENT
/begin GROUP joints_status.09.swr ""
 /begin REF_MEASUREMENT swr.09.pos_fb swr.09.vel_fb swr.09.torque_fb swr.09.current_fb swr.09.motor_temper swr.09.min_soft_position_limit swr.09.max_soft_position_limit swr.09.max_profile_velocity swr.09.voltage swr.09.enabled swr.09.error swr.09.operation_mode_display /end REF_MEASUREMENT
/end GROUP
/begin COMPU_METHOD wbc_arml1.10.pos_cmd_COMPU_METHOD "" LINEAR "%6.3" "" COEFFS_LINEAR 1 0 /end COMPU_METHOD
/begin MEASUREMENT wbc_arml1.10.pos_cmd "pos_cmd" FLOAT64_IEEE wbc_arml1.10.pos_cmd_COMPU_METHOD 0 0 -1E12 1E12 ECU_ADDRESS 0x70CF0
 /begin IF_DATA XCP
  /begin DAQ_EVENT FIXED_EVENT_LIST EVENT 0x0 /end DAQ_EVENT
 /end IF_DATA
/end MEASUREMENT
/begin COMPU_METHOD wbc_arml1.10.vel_cmd_COMPU_METHOD "" LINEAR "%6.3" "" COEFFS_LINEAR 1 0 /end COMPU_METHOD
/begin MEASUREMENT wbc_arml1.10.vel_cmd "vel_cmd" FLOAT64_IEEE wbc_arml1.10.vel_cmd_COMPU_METHOD 0 0 -1E12 1E12 ECU_ADDRESS 0x70CF8
 /begin IF_DATA XCP
  /begin DAQ_EVENT FIXED_EVENT_LIST EVENT 0x0 /end DAQ_EVENT
 /end IF_DATA
/end MEASUREMENT
/begin COMPU_METHOD wbc_arml1.10.torque_cmd_COMPU_METHOD "" LINEAR "%6.3" "" COEFFS_LINEAR 1 0 /end COMPU_METHOD
/begin MEASUREMENT wbc_arml1.10.torque_cmd "torque_cmd" FLOAT64_IEEE wbc_arml1.10.torque_cmd_COMPU_METHOD 0 0 -1E12 1E12 ECU_ADDRESS 0x70D00
 /begin IF_DATA XCP
  /begin DAQ_EVENT FIXED_EVENT_LIST EVENT 0x0 /end DAQ_EVENT
 /end IF_DATA
/end MEASUREMENT
/begin COMPU_METHOD wbc_arml1.10.current_cmd_COMPU_METHOD "" LINEAR "%6.3" "" COEFFS_LINEAR 1 0 /end COMPU_METHOD
/begin MEASUREMENT wbc_arml1.10.current_cmd "current_cmd" FLOAT64_IEEE wbc_arml1.10.current_cmd_COMPU_METHOD 0 0 -1E12 1E12 ECU_ADDRESS 0x70D08
 /begin IF_DATA XCP
  /begin DAQ_EVENT FIXED_EVENT_LIST EVENT 0x0 /end DAQ_EVENT
 /end IF_DATA
/end MEASUREMENT
/begin COMPU_METHOD wbc_arml1.10.velocity_COMPU_METHOD "" LINEAR "%6.3" "" COEFFS_LINEAR 1 0 /end COMPU_METHOD
/begin MEASUREMENT wbc_arml1.10.velocity "velocity" FLOAT64_IEEE wbc_arml1.10.velocity_COMPU_METHOD 0 0 -1E12 1E12 ECU_ADDRESS 0x70D10
 /begin IF_DATA XCP
  /begin DAQ_EVENT FIXED_EVENT_LIST EVENT 0x0 /end DAQ_EVENT
 /end IF_DATA
/end MEASUREMENT
/begin COMPU_METHOD wbc_arml1.10.max_velocity_COMPU_METHOD "" LINEAR "%6.3" "" COEFFS_LINEAR 1 0 /end COMPU_METHOD
/begin MEASUREMENT wbc_arml1.10.max_velocity "max_velocity" FLOAT64_IEEE wbc_arml1.10.max_velocity_COMPU_METHOD 0 0 -1E12 1E12 ECU_ADDRESS 0x70D18
 /begin IF_DATA XCP
  /begin DAQ_EVENT FIXED_EVENT_LIST EVENT 0x0 /end DAQ_EVENT
 /end IF_DATA
/end MEASUREMENT
/begin COMPU_METHOD wbc_arml1.10.acceleration_COMPU_METHOD "" LINEAR "%6.3" "" COEFFS_LINEAR 1 0 /end COMPU_METHOD
/begin MEASUREMENT wbc_arml1.10.acceleration "acceleration" FLOAT64_IEEE wbc_arml1.10.acceleration_COMPU_METHOD 0 0 -1E12 1E12 ECU_ADDRESS 0x70D20
 /begin IF_DATA XCP
  /begin DAQ_EVENT FIXED_EVENT_LIST EVENT 0x0 /end DAQ_EVENT
 /end IF_DATA
/end MEASUREMENT
/begin COMPU_METHOD wbc_arml1.10.deceleration_COMPU_METHOD "" LINEAR "%6.3" "" COEFFS_LINEAR 1 0 /end COMPU_METHOD
/begin MEASUREMENT wbc_arml1.10.deceleration "deceleration" FLOAT64_IEEE wbc_arml1.10.deceleration_COMPU_METHOD 0 0 -1E12 1E12 ECU_ADDRESS 0x70D28
 /begin IF_DATA XCP
  /begin DAQ_EVENT FIXED_EVENT_LIST EVENT 0x0 /end DAQ_EVENT
 /end IF_DATA
/end MEASUREMENT
/begin COMPU_METHOD wbc_arml1.10.KP_COMPU_METHOD "" LINEAR "%6.3" "" COEFFS_LINEAR 1 0 /end COMPU_METHOD
/begin MEASUREMENT wbc_arml1.10.KP "KP" FLOAT64_IEEE wbc_arml1.10.KP_COMPU_METHOD 0 0 -1E12 1E12 ECU_ADDRESS 0x70D30
 /begin IF_DATA XCP
  /begin DAQ_EVENT FIXED_EVENT_LIST EVENT 0x0 /end DAQ_EVENT
 /end IF_DATA
/end MEASUREMENT
/begin COMPU_METHOD wbc_arml1.10.KD_COMPU_METHOD "" LINEAR "%6.3" "" COEFFS_LINEAR 1 0 /end COMPU_METHOD
/begin MEASUREMENT wbc_arml1.10.KD "KD" FLOAT64_IEEE wbc_arml1.10.KD_COMPU_METHOD 0 0 -1E12 1E12 ECU_ADDRESS 0x70D38
 /begin IF_DATA XCP
  /begin DAQ_EVENT FIXED_EVENT_LIST EVENT 0x0 /end DAQ_EVENT
 /end IF_DATA
/end MEASUREMENT
/begin COMPU_METHOD wbc_arml1.10.enable_COMPU_METHOD "" LINEAR "%6.3" "" COEFFS_LINEAR 1 0 /end COMPU_METHOD
/begin MEASUREMENT wbc_arml1.10.enable "enable" SBYTE wbc_arml1.10.enable_COMPU_METHOD 0 0 -128 127 ECU_ADDRESS 0x70D40
 /begin IF_DATA XCP
  /begin DAQ_EVENT FIXED_EVENT_LIST EVENT 0x0 /end DAQ_EVENT
 /end IF_DATA
/end MEASUREMENT
/begin COMPU_METHOD wbc_arml1.10.operation_mode_COMPU_METHOD "" LINEAR "%6.3" "" COEFFS_LINEAR 1 0 /end COMPU_METHOD
/begin MEASUREMENT wbc_arml1.10.operation_mode "operation_mode" SBYTE wbc_arml1.10.operation_mode_COMPU_METHOD 0 0 -128 127 ECU_ADDRESS 0x70D41
 /begin IF_DATA XCP
  /begin DAQ_EVENT FIXED_EVENT_LIST EVENT 0x0 /end DAQ_EVENT
 /end IF_DATA
/end MEASUREMENT
/begin COMPU_METHOD wbc_arml1.10.polarity_COMPU_METHOD "" LINEAR "%6.3" "" COEFFS_LINEAR 1 0 /end COMPU_METHOD
/begin MEASUREMENT wbc_arml1.10.polarity "polarity" UBYTE wbc_arml1.10.polarity_COMPU_METHOD 0 0 0 255 ECU_ADDRESS 0x70D42
 /begin IF_DATA XCP
  /begin DAQ_EVENT FIXED_EVENT_LIST EVENT 0x0 /end DAQ_EVENT
 /end IF_DATA
/end MEASUREMENT
/begin GROUP joints_cmd.10.wbc_arml1 ""
 /begin REF_MEASUREMENT wbc_arml1.10.pos_cmd wbc_arml1.10.vel_cmd wbc_arml1.10.torque_cmd wbc_arml1.10.current_cmd wbc_arml1.10.velocity wbc_arml1.10.max_velocity wbc_arml1.10.acceleration wbc_arml1.10.deceleration wbc_arml1.10.KP wbc_arml1.10.KD wbc_arml1.10.enable wbc_arml1.10.operation_mode wbc_arml1.10.polarity /end REF_MEASUREMENT
/end GROUP
/begin COMPU_METHOD wbc_arml1.10.pos_fb_COMPU_METHOD "" LINEAR "%6.3" "" COEFFS_LINEAR 1 0 /end COMPU_METHOD
/begin MEASUREMENT wbc_arml1.10.pos_fb "pos_fb" FLOAT64_IEEE wbc_arml1.10.pos_fb_COMPU_METHOD 0 0 -1E12 1E12 ECU_ADDRESS 0x6FE38
 /begin IF_DATA XCP
  /begin DAQ_EVENT FIXED_EVENT_LIST EVENT 0x0 /end DAQ_EVENT
 /end IF_DATA
/end MEASUREMENT
/begin COMPU_METHOD wbc_arml1.10.vel_fb_COMPU_METHOD "" LINEAR "%6.3" "" COEFFS_LINEAR 1 0 /end COMPU_METHOD
/begin MEASUREMENT wbc_arml1.10.vel_fb "vel_fb" FLOAT64_IEEE wbc_arml1.10.vel_fb_COMPU_METHOD 0 0 -1E12 1E12 ECU_ADDRESS 0x6FE40
 /begin IF_DATA XCP
  /begin DAQ_EVENT FIXED_EVENT_LIST EVENT 0x0 /end DAQ_EVENT
 /end IF_DATA
/end MEASUREMENT
/begin COMPU_METHOD wbc_arml1.10.torque_fb_COMPU_METHOD "" LINEAR "%6.3" "" COEFFS_LINEAR 1 0 /end COMPU_METHOD
/begin MEASUREMENT wbc_arml1.10.torque_fb "torque_fb" FLOAT64_IEEE wbc_arml1.10.torque_fb_COMPU_METHOD 0 0 -1E12 1E12 ECU_ADDRESS 0x6FE48
 /begin IF_DATA XCP
  /begin DAQ_EVENT FIXED_EVENT_LIST EVENT 0x0 /end DAQ_EVENT
 /end IF_DATA
/end MEASUREMENT
/begin COMPU_METHOD wbc_arml1.10.current_fb_COMPU_METHOD "" LINEAR "%6.3" "" COEFFS_LINEAR 1 0 /end COMPU_METHOD
/begin MEASUREMENT wbc_arml1.10.current_fb "current_fb" FLOAT64_IEEE wbc_arml1.10.current_fb_COMPU_METHOD 0 0 -1E12 1E12 ECU_ADDRESS 0x6FE50
 /begin IF_DATA XCP
  /begin DAQ_EVENT FIXED_EVENT_LIST EVENT 0x0 /end DAQ_EVENT
 /end IF_DATA
/end MEASUREMENT
/begin COMPU_METHOD wbc_arml1.10.motor_temper_COMPU_METHOD "" LINEAR "%6.3" "" COEFFS_LINEAR 1 0 /end COMPU_METHOD
/begin MEASUREMENT wbc_arml1.10.motor_temper "motor_temper" FLOAT64_IEEE wbc_arml1.10.motor_temper_COMPU_METHOD 0 0 -1E12 1E12 ECU_ADDRESS 0x6FE58
 /begin IF_DATA XCP
  /begin DAQ_EVENT FIXED_EVENT_LIST EVENT 0x0 /end DAQ_EVENT
 /end IF_DATA
/end MEASUREMENT
/begin COMPU_METHOD wbc_arml1.10.min_soft_position_COMPU_METHOD "" LINEAR "%6.3" "" COEFFS_LINEAR 1 0 /end COMPU_METHOD
/begin MEASUREMENT wbc_arml1.10.min_soft_position "min_soft_position_limit" FLOAT64_IEEE wbc_arml1.10.min_soft_position_COMPU_METHOD 0 0 -1E12 1E12 ECU_ADDRESS 0x6FE60
 /begin IF_DATA XCP
  /begin DAQ_EVENT FIXED_EVENT_LIST EVENT 0x0 /end DAQ_EVENT
 /end IF_DATA
/end MEASUREMENT
/begin COMPU_METHOD wbc_arml1.10.max_soft_position_COMPU_METHOD "" LINEAR "%6.3" "" COEFFS_LINEAR 1 0 /end COMPU_METHOD
/begin MEASUREMENT wbc_arml1.10.max_soft_position "max_soft_position_limit" FLOAT64_IEEE wbc_arml1.10.max_soft_position_COMPU_METHOD 0 0 -1E12 1E12 ECU_ADDRESS 0x6FE68
 /begin IF_DATA XCP
  /begin DAQ_EVENT FIXED_EVENT_LIST EVENT 0x0 /end DAQ_EVENT
 /end IF_DATA
/end MEASUREMENT
/begin COMPU_METHOD wbc_arml1.10.max_profile_veloc_COMPU_METHOD "" LINEAR "%6.3" "" COEFFS_LINEAR 1 0 /end COMPU_METHOD
/begin MEASUREMENT wbc_arml1.10.max_profile_veloc "max_profile_velocity" FLOAT64_IEEE wbc_arml1.10.max_profile_veloc_COMPU_METHOD 0 0 -1E12 1E12 ECU_ADDRESS 0x6FE70
 /begin IF_DATA XCP
  /begin DAQ_EVENT FIXED_EVENT_LIST EVENT 0x0 /end DAQ_EVENT
 /end IF_DATA
/end MEASUREMENT
/begin COMPU_METHOD wbc_arml1.10.voltage_COMPU_METHOD "" LINEAR "%6.3" "" COEFFS_LINEAR 1 0 /end COMPU_METHOD
/begin MEASUREMENT wbc_arml1.10.voltage "voltage" FLOAT64_IEEE wbc_arml1.10.voltage_COMPU_METHOD 0 0 -1E12 1E12 ECU_ADDRESS 0x6FE80
 /begin IF_DATA XCP
  /begin DAQ_EVENT FIXED_EVENT_LIST EVENT 0x0 /end DAQ_EVENT
 /end IF_DATA
/end MEASUREMENT
/begin COMPU_METHOD wbc_arml1.10.enabled_COMPU_METHOD "" LINEAR "%6.3" "" COEFFS_LINEAR 1 0 /end COMPU_METHOD
/begin MEASUREMENT wbc_arml1.10.enabled "enabled" SBYTE wbc_arml1.10.enabled_COMPU_METHOD 0 0 -128 127 ECU_ADDRESS 0x6FE78
 /begin IF_DATA XCP
  /begin DAQ_EVENT FIXED_EVENT_LIST EVENT 0x0 /end DAQ_EVENT
 /end IF_DATA
/end MEASUREMENT
/begin COMPU_METHOD wbc_arml1.10.error_COMPU_METHOD "" LINEAR "%6.3" "" COEFFS_LINEAR 1 0 /end COMPU_METHOD
/begin MEASUREMENT wbc_arml1.10.error "error" SBYTE wbc_arml1.10.error_COMPU_METHOD 0 0 -128 127 ECU_ADDRESS 0x6FE79
 /begin IF_DATA XCP
  /begin DAQ_EVENT FIXED_EVENT_LIST EVENT 0x0 /end DAQ_EVENT
 /end IF_DATA
/end MEASUREMENT
/begin COMPU_METHOD wbc_arml1.10.operation_mode_di_COMPU_METHOD "" LINEAR "%6.3" "" COEFFS_LINEAR 1 0 /end COMPU_METHOD
/begin MEASUREMENT wbc_arml1.10.operation_mode_di "operation_mode_display" SBYTE wbc_arml1.10.operation_mode_di_COMPU_METHOD 0 0 -128 127 ECU_ADDRESS 0x6FE7A
 /begin IF_DATA XCP
  /begin DAQ_EVENT FIXED_EVENT_LIST EVENT 0x0 /end DAQ_EVENT
 /end IF_DATA
/end MEASUREMENT
/begin GROUP joints_status.10.wbc_arml1 ""
 /begin REF_MEASUREMENT wbc_arml1.10.pos_fb wbc_arml1.10.vel_fb wbc_arml1.10.torque_fb wbc_arml1.10.current_fb wbc_arml1.10.motor_temper wbc_arml1.10.min_soft_position wbc_arml1.10.max_soft_position wbc_arml1.10.max_profile_veloc wbc_arml1.10.voltage wbc_arml1.10.enabled wbc_arml1.10.error wbc_arml1.10.operation_mode_di /end REF_MEASUREMENT
/end GROUP
/begin COMPU_METHOD wbc_arml2.11.pos_cmd_COMPU_METHOD "" LINEAR "%6.3" "" COEFFS_LINEAR 1 0 /end COMPU_METHOD
/begin MEASUREMENT wbc_arml2.11.pos_cmd "pos_cmd" FLOAT64_IEEE wbc_arml2.11.pos_cmd_COMPU_METHOD 0 0 -1E12 1E12 ECU_ADDRESS 0x70D48
 /begin IF_DATA XCP
  /begin DAQ_EVENT FIXED_EVENT_LIST EVENT 0x0 /end DAQ_EVENT
 /end IF_DATA
/end MEASUREMENT
/begin COMPU_METHOD wbc_arml2.11.vel_cmd_COMPU_METHOD "" LINEAR "%6.3" "" COEFFS_LINEAR 1 0 /end COMPU_METHOD
/begin MEASUREMENT wbc_arml2.11.vel_cmd "vel_cmd" FLOAT64_IEEE wbc_arml2.11.vel_cmd_COMPU_METHOD 0 0 -1E12 1E12 ECU_ADDRESS 0x70D50
 /begin IF_DATA XCP
  /begin DAQ_EVENT FIXED_EVENT_LIST EVENT 0x0 /end DAQ_EVENT
 /end IF_DATA
/end MEASUREMENT
/begin COMPU_METHOD wbc_arml2.11.torque_cmd_COMPU_METHOD "" LINEAR "%6.3" "" COEFFS_LINEAR 1 0 /end COMPU_METHOD
/begin MEASUREMENT wbc_arml2.11.torque_cmd "torque_cmd" FLOAT64_IEEE wbc_arml2.11.torque_cmd_COMPU_METHOD 0 0 -1E12 1E12 ECU_ADDRESS 0x70D58
 /begin IF_DATA XCP
  /begin DAQ_EVENT FIXED_EVENT_LIST EVENT 0x0 /end DAQ_EVENT
 /end IF_DATA
/end MEASUREMENT
/begin COMPU_METHOD wbc_arml2.11.current_cmd_COMPU_METHOD "" LINEAR "%6.3" "" COEFFS_LINEAR 1 0 /end COMPU_METHOD
/begin MEASUREMENT wbc_arml2.11.current_cmd "current_cmd" FLOAT64_IEEE wbc_arml2.11.current_cmd_COMPU_METHOD 0 0 -1E12 1E12 ECU_ADDRESS 0x70D60
 /begin IF_DATA XCP
  /begin DAQ_EVENT FIXED_EVENT_LIST EVENT 0x0 /end DAQ_EVENT
 /end IF_DATA
/end MEASUREMENT
/begin COMPU_METHOD wbc_arml2.11.velocity_COMPU_METHOD "" LINEAR "%6.3" "" COEFFS_LINEAR 1 0 /end COMPU_METHOD
/begin MEASUREMENT wbc_arml2.11.velocity "velocity" FLOAT64_IEEE wbc_arml2.11.velocity_COMPU_METHOD 0 0 -1E12 1E12 ECU_ADDRESS 0x70D68
 /begin IF_DATA XCP
  /begin DAQ_EVENT FIXED_EVENT_LIST EVENT 0x0 /end DAQ_EVENT
 /end IF_DATA
/end MEASUREMENT
/begin COMPU_METHOD wbc_arml2.11.max_velocity_COMPU_METHOD "" LINEAR "%6.3" "" COEFFS_LINEAR 1 0 /end COMPU_METHOD
/begin MEASUREMENT wbc_arml2.11.max_velocity "max_velocity" FLOAT64_IEEE wbc_arml2.11.max_velocity_COMPU_METHOD 0 0 -1E12 1E12 ECU_ADDRESS 0x70D70
 /begin IF_DATA XCP
  /begin DAQ_EVENT FIXED_EVENT_LIST EVENT 0x0 /end DAQ_EVENT
 /end IF_DATA
/end MEASUREMENT
/begin COMPU_METHOD wbc_arml2.11.acceleration_COMPU_METHOD "" LINEAR "%6.3" "" COEFFS_LINEAR 1 0 /end COMPU_METHOD
/begin MEASUREMENT wbc_arml2.11.acceleration "acceleration" FLOAT64_IEEE wbc_arml2.11.acceleration_COMPU_METHOD 0 0 -1E12 1E12 ECU_ADDRESS 0x70D78
 /begin IF_DATA XCP
  /begin DAQ_EVENT FIXED_EVENT_LIST EVENT 0x0 /end DAQ_EVENT
 /end IF_DATA
/end MEASUREMENT
/begin COMPU_METHOD wbc_arml2.11.deceleration_COMPU_METHOD "" LINEAR "%6.3" "" COEFFS_LINEAR 1 0 /end COMPU_METHOD
/begin MEASUREMENT wbc_arml2.11.deceleration "deceleration" FLOAT64_IEEE wbc_arml2.11.deceleration_COMPU_METHOD 0 0 -1E12 1E12 ECU_ADDRESS 0x70D80
 /begin IF_DATA XCP
  /begin DAQ_EVENT FIXED_EVENT_LIST EVENT 0x0 /end DAQ_EVENT
 /end IF_DATA
/end MEASUREMENT
/begin COMPU_METHOD wbc_arml2.11.KP_COMPU_METHOD "" LINEAR "%6.3" "" COEFFS_LINEAR 1 0 /end COMPU_METHOD
/begin MEASUREMENT wbc_arml2.11.KP "KP" FLOAT64_IEEE wbc_arml2.11.KP_COMPU_METHOD 0 0 -1E12 1E12 ECU_ADDRESS 0x70D88
 /begin IF_DATA XCP
  /begin DAQ_EVENT FIXED_EVENT_LIST EVENT 0x0 /end DAQ_EVENT
 /end IF_DATA
/end MEASUREMENT
/begin COMPU_METHOD wbc_arml2.11.KD_COMPU_METHOD "" LINEAR "%6.3" "" COEFFS_LINEAR 1 0 /end COMPU_METHOD
/begin MEASUREMENT wbc_arml2.11.KD "KD" FLOAT64_IEEE wbc_arml2.11.KD_COMPU_METHOD 0 0 -1E12 1E12 ECU_ADDRESS 0x70D90
 /begin IF_DATA XCP
  /begin DAQ_EVENT FIXED_EVENT_LIST EVENT 0x0 /end DAQ_EVENT
 /end IF_DATA
/end MEASUREMENT
/begin COMPU_METHOD wbc_arml2.11.enable_COMPU_METHOD "" LINEAR "%6.3" "" COEFFS_LINEAR 1 0 /end COMPU_METHOD
/begin MEASUREMENT wbc_arml2.11.enable "enable" SBYTE wbc_arml2.11.enable_COMPU_METHOD 0 0 -128 127 ECU_ADDRESS 0x70D98
 /begin IF_DATA XCP
  /begin DAQ_EVENT FIXED_EVENT_LIST EVENT 0x0 /end DAQ_EVENT
 /end IF_DATA
/end MEASUREMENT
/begin COMPU_METHOD wbc_arml2.11.operation_mode_COMPU_METHOD "" LINEAR "%6.3" "" COEFFS_LINEAR 1 0 /end COMPU_METHOD
/begin MEASUREMENT wbc_arml2.11.operation_mode "operation_mode" SBYTE wbc_arml2.11.operation_mode_COMPU_METHOD 0 0 -128 127 ECU_ADDRESS 0x70D99
 /begin IF_DATA XCP
  /begin DAQ_EVENT FIXED_EVENT_LIST EVENT 0x0 /end DAQ_EVENT
 /end IF_DATA
/end MEASUREMENT
/begin COMPU_METHOD wbc_arml2.11.polarity_COMPU_METHOD "" LINEAR "%6.3" "" COEFFS_LINEAR 1 0 /end COMPU_METHOD
/begin MEASUREMENT wbc_arml2.11.polarity "polarity" UBYTE wbc_arml2.11.polarity_COMPU_METHOD 0 0 0 255 ECU_ADDRESS 0x70D9A
 /begin IF_DATA XCP
  /begin DAQ_EVENT FIXED_EVENT_LIST EVENT 0x0 /end DAQ_EVENT
 /end IF_DATA
/end MEASUREMENT
/begin GROUP joints_cmd.11.wbc_arml2 ""
 /begin REF_MEASUREMENT wbc_arml2.11.pos_cmd wbc_arml2.11.vel_cmd wbc_arml2.11.torque_cmd wbc_arml2.11.current_cmd wbc_arml2.11.velocity wbc_arml2.11.max_velocity wbc_arml2.11.acceleration wbc_arml2.11.deceleration wbc_arml2.11.KP wbc_arml2.11.KD wbc_arml2.11.enable wbc_arml2.11.operation_mode wbc_arml2.11.polarity /end REF_MEASUREMENT
/end GROUP
/begin COMPU_METHOD wbc_arml2.11.pos_fb_COMPU_METHOD "" LINEAR "%6.3" "" COEFFS_LINEAR 1 0 /end COMPU_METHOD
/begin MEASUREMENT wbc_arml2.11.pos_fb "pos_fb" FLOAT64_IEEE wbc_arml2.11.pos_fb_COMPU_METHOD 0 0 -1E12 1E12 ECU_ADDRESS 0x6FE88
 /begin IF_DATA XCP
  /begin DAQ_EVENT FIXED_EVENT_LIST EVENT 0x0 /end DAQ_EVENT
 /end IF_DATA
/end MEASUREMENT
/begin COMPU_METHOD wbc_arml2.11.vel_fb_COMPU_METHOD "" LINEAR "%6.3" "" COEFFS_LINEAR 1 0 /end COMPU_METHOD
/begin MEASUREMENT wbc_arml2.11.vel_fb "vel_fb" FLOAT64_IEEE wbc_arml2.11.vel_fb_COMPU_METHOD 0 0 -1E12 1E12 ECU_ADDRESS 0x6FE90
 /begin IF_DATA XCP
  /begin DAQ_EVENT FIXED_EVENT_LIST EVENT 0x0 /end DAQ_EVENT
 /end IF_DATA
/end MEASUREMENT
/begin COMPU_METHOD wbc_arml2.11.torque_fb_COMPU_METHOD "" LINEAR "%6.3" "" COEFFS_LINEAR 1 0 /end COMPU_METHOD
/begin MEASUREMENT wbc_arml2.11.torque_fb "torque_fb" FLOAT64_IEEE wbc_arml2.11.torque_fb_COMPU_METHOD 0 0 -1E12 1E12 ECU_ADDRESS 0x6FE98
 /begin IF_DATA XCP
  /begin DAQ_EVENT FIXED_EVENT_LIST EVENT 0x0 /end DAQ_EVENT
 /end IF_DATA
/end MEASUREMENT
/begin COMPU_METHOD wbc_arml2.11.current_fb_COMPU_METHOD "" LINEAR "%6.3" "" COEFFS_LINEAR 1 0 /end COMPU_METHOD
/begin MEASUREMENT wbc_arml2.11.current_fb "current_fb" FLOAT64_IEEE wbc_arml2.11.current_fb_COMPU_METHOD 0 0 -1E12 1E12 ECU_ADDRESS 0x6FEA0
 /begin IF_DATA XCP
  /begin DAQ_EVENT FIXED_EVENT_LIST EVENT 0x0 /end DAQ_EVENT
 /end IF_DATA
/end MEASUREMENT
/begin COMPU_METHOD wbc_arml2.11.motor_temper_COMPU_METHOD "" LINEAR "%6.3" "" COEFFS_LINEAR 1 0 /end COMPU_METHOD
/begin MEASUREMENT wbc_arml2.11.motor_temper "motor_temper" FLOAT64_IEEE wbc_arml2.11.motor_temper_COMPU_METHOD 0 0 -1E12 1E12 ECU_ADDRESS 0x6FEA8
 /begin IF_DATA XCP
  /begin DAQ_EVENT FIXED_EVENT_LIST EVENT 0x0 /end DAQ_EVENT
 /end IF_DATA
/end MEASUREMENT
/begin COMPU_METHOD wbc_arml2.11.min_soft_position_COMPU_METHOD "" LINEAR "%6.3" "" COEFFS_LINEAR 1 0 /end COMPU_METHOD
/begin MEASUREMENT wbc_arml2.11.min_soft_position "min_soft_position_limit" FLOAT64_IEEE wbc_arml2.11.min_soft_position_COMPU_METHOD 0 0 -1E12 1E12 ECU_ADDRESS 0x6FEB0
 /begin IF_DATA XCP
  /begin DAQ_EVENT FIXED_EVENT_LIST EVENT 0x0 /end DAQ_EVENT
 /end IF_DATA
/end MEASUREMENT
/begin COMPU_METHOD wbc_arml2.11.max_soft_position_COMPU_METHOD "" LINEAR "%6.3" "" COEFFS_LINEAR 1 0 /end COMPU_METHOD
/begin MEASUREMENT wbc_arml2.11.max_soft_position "max_soft_position_limit" FLOAT64_IEEE wbc_arml2.11.max_soft_position_COMPU_METHOD 0 0 -1E12 1E12 ECU_ADDRESS 0x6FEB8
 /begin IF_DATA XCP
  /begin DAQ_EVENT FIXED_EVENT_LIST EVENT 0x0 /end DAQ_EVENT
 /end IF_DATA
/end MEASUREMENT
/begin COMPU_METHOD wbc_arml2.11.max_profile_veloc_COMPU_METHOD "" LINEAR "%6.3" "" COEFFS_LINEAR 1 0 /end COMPU_METHOD
/begin MEASUREMENT wbc_arml2.11.max_profile_veloc "max_profile_velocity" FLOAT64_IEEE wbc_arml2.11.max_profile_veloc_COMPU_METHOD 0 0 -1E12 1E12 ECU_ADDRESS 0x6FEC0
 /begin IF_DATA XCP
  /begin DAQ_EVENT FIXED_EVENT_LIST EVENT 0x0 /end DAQ_EVENT
 /end IF_DATA
/end MEASUREMENT
/begin COMPU_METHOD wbc_arml2.11.voltage_COMPU_METHOD "" LINEAR "%6.3" "" COEFFS_LINEAR 1 0 /end COMPU_METHOD
/begin MEASUREMENT wbc_arml2.11.voltage "voltage" FLOAT64_IEEE wbc_arml2.11.voltage_COMPU_METHOD 0 0 -1E12 1E12 ECU_ADDRESS 0x6FED0
 /begin IF_DATA XCP
  /begin DAQ_EVENT FIXED_EVENT_LIST EVENT 0x0 /end DAQ_EVENT
 /end IF_DATA
/end MEASUREMENT
/begin COMPU_METHOD wbc_arml2.11.enabled_COMPU_METHOD "" LINEAR "%6.3" "" COEFFS_LINEAR 1 0 /end COMPU_METHOD
/begin MEASUREMENT wbc_arml2.11.enabled "enabled" SBYTE wbc_arml2.11.enabled_COMPU_METHOD 0 0 -128 127 ECU_ADDRESS 0x6FEC8
 /begin IF_DATA XCP
  /begin DAQ_EVENT FIXED_EVENT_LIST EVENT 0x0 /end DAQ_EVENT
 /end IF_DATA
/end MEASUREMENT
/begin COMPU_METHOD wbc_arml2.11.error_COMPU_METHOD "" LINEAR "%6.3" "" COEFFS_LINEAR 1 0 /end COMPU_METHOD
/begin MEASUREMENT wbc_arml2.11.error "error" SBYTE wbc_arml2.11.error_COMPU_METHOD 0 0 -128 127 ECU_ADDRESS 0x6FEC9
 /begin IF_DATA XCP
  /begin DAQ_EVENT FIXED_EVENT_LIST EVENT 0x0 /end DAQ_EVENT
 /end IF_DATA
/end MEASUREMENT
/begin COMPU_METHOD wbc_arml2.11.operation_mode_di_COMPU_METHOD "" LINEAR "%6.3" "" COEFFS_LINEAR 1 0 /end COMPU_METHOD
/begin MEASUREMENT wbc_arml2.11.operation_mode_di "operation_mode_display" SBYTE wbc_arml2.11.operation_mode_di_COMPU_METHOD 0 0 -128 127 ECU_ADDRESS 0x6FECA
 /begin IF_DATA XCP
  /begin DAQ_EVENT FIXED_EVENT_LIST EVENT 0x0 /end DAQ_EVENT
 /end IF_DATA
/end MEASUREMENT
/begin GROUP joints_status.11.wbc_arml2 ""
 /begin REF_MEASUREMENT wbc_arml2.11.pos_fb wbc_arml2.11.vel_fb wbc_arml2.11.torque_fb wbc_arml2.11.current_fb wbc_arml2.11.motor_temper wbc_arml2.11.min_soft_position wbc_arml2.11.max_soft_position wbc_arml2.11.max_profile_veloc wbc_arml2.11.voltage wbc_arml2.11.enabled wbc_arml2.11.error wbc_arml2.11.operation_mode_di /end REF_MEASUREMENT
/end GROUP
/begin COMPU_METHOD wbc_arml3.12.pos_cmd_COMPU_METHOD "" LINEAR "%6.3" "" COEFFS_LINEAR 1 0 /end COMPU_METHOD
/begin MEASUREMENT wbc_arml3.12.pos_cmd "pos_cmd" FLOAT64_IEEE wbc_arml3.12.pos_cmd_COMPU_METHOD 0 0 -1E12 1E12 ECU_ADDRESS 0x70DA0
 /begin IF_DATA XCP
  /begin DAQ_EVENT FIXED_EVENT_LIST EVENT 0x0 /end DAQ_EVENT
 /end IF_DATA
/end MEASUREMENT
/begin COMPU_METHOD wbc_arml3.12.vel_cmd_COMPU_METHOD "" LINEAR "%6.3" "" COEFFS_LINEAR 1 0 /end COMPU_METHOD
/begin MEASUREMENT wbc_arml3.12.vel_cmd "vel_cmd" FLOAT64_IEEE wbc_arml3.12.vel_cmd_COMPU_METHOD 0 0 -1E12 1E12 ECU_ADDRESS 0x70DA8
 /begin IF_DATA XCP
  /begin DAQ_EVENT FIXED_EVENT_LIST EVENT 0x0 /end DAQ_EVENT
 /end IF_DATA
/end MEASUREMENT
/begin COMPU_METHOD wbc_arml3.12.torque_cmd_COMPU_METHOD "" LINEAR "%6.3" "" COEFFS_LINEAR 1 0 /end COMPU_METHOD
/begin MEASUREMENT wbc_arml3.12.torque_cmd "torque_cmd" FLOAT64_IEEE wbc_arml3.12.torque_cmd_COMPU_METHOD 0 0 -1E12 1E12 ECU_ADDRESS 0x70DB0
 /begin IF_DATA XCP
  /begin DAQ_EVENT FIXED_EVENT_LIST EVENT 0x0 /end DAQ_EVENT
 /end IF_DATA
/end MEASUREMENT
/begin COMPU_METHOD wbc_arml3.12.current_cmd_COMPU_METHOD "" LINEAR "%6.3" "" COEFFS_LINEAR 1 0 /end COMPU_METHOD
/begin MEASUREMENT wbc_arml3.12.current_cmd "current_cmd" FLOAT64_IEEE wbc_arml3.12.current_cmd_COMPU_METHOD 0 0 -1E12 1E12 ECU_ADDRESS 0x70DB8
 /begin IF_DATA XCP
  /begin DAQ_EVENT FIXED_EVENT_LIST EVENT 0x0 /end DAQ_EVENT
 /end IF_DATA
/end MEASUREMENT
/begin COMPU_METHOD wbc_arml3.12.velocity_COMPU_METHOD "" LINEAR "%6.3" "" COEFFS_LINEAR 1 0 /end COMPU_METHOD
/begin MEASUREMENT wbc_arml3.12.velocity "velocity" FLOAT64_IEEE wbc_arml3.12.velocity_COMPU_METHOD 0 0 -1E12 1E12 ECU_ADDRESS 0x70DC0
 /begin IF_DATA XCP
  /begin DAQ_EVENT FIXED_EVENT_LIST EVENT 0x0 /end DAQ_EVENT
 /end IF_DATA
/end MEASUREMENT
/begin COMPU_METHOD wbc_arml3.12.max_velocity_COMPU_METHOD "" LINEAR "%6.3" "" COEFFS_LINEAR 1 0 /end COMPU_METHOD
/begin MEASUREMENT wbc_arml3.12.max_velocity "max_velocity" FLOAT64_IEEE wbc_arml3.12.max_velocity_COMPU_METHOD 0 0 -1E12 1E12 ECU_ADDRESS 0x70DC8
 /begin IF_DATA XCP
  /begin DAQ_EVENT FIXED_EVENT_LIST EVENT 0x0 /end DAQ_EVENT
 /end IF_DATA
/end MEASUREMENT
/begin COMPU_METHOD wbc_arml3.12.acceleration_COMPU_METHOD "" LINEAR "%6.3" "" COEFFS_LINEAR 1 0 /end COMPU_METHOD
/begin MEASUREMENT wbc_arml3.12.acceleration "acceleration" FLOAT64_IEEE wbc_arml3.12.acceleration_COMPU_METHOD 0 0 -1E12 1E12 ECU_ADDRESS 0x70DD0
 /begin IF_DATA XCP
  /begin DAQ_EVENT FIXED_EVENT_LIST EVENT 0x0 /end DAQ_EVENT
 /end IF_DATA
/end MEASUREMENT
/begin COMPU_METHOD wbc_arml3.12.deceleration_COMPU_METHOD "" LINEAR "%6.3" "" COEFFS_LINEAR 1 0 /end COMPU_METHOD
/begin MEASUREMENT wbc_arml3.12.deceleration "deceleration" FLOAT64_IEEE wbc_arml3.12.deceleration_COMPU_METHOD 0 0 -1E12 1E12 ECU_ADDRESS 0x70DD8
 /begin IF_DATA XCP
  /begin DAQ_EVENT FIXED_EVENT_LIST EVENT 0x0 /end DAQ_EVENT
 /end IF_DATA
/end MEASUREMENT
/begin COMPU_METHOD wbc_arml3.12.KP_COMPU_METHOD "" LINEAR "%6.3" "" COEFFS_LINEAR 1 0 /end COMPU_METHOD
/begin MEASUREMENT wbc_arml3.12.KP "KP" FLOAT64_IEEE wbc_arml3.12.KP_COMPU_METHOD 0 0 -1E12 1E12 ECU_ADDRESS 0x70DE0
 /begin IF_DATA XCP
  /begin DAQ_EVENT FIXED_EVENT_LIST EVENT 0x0 /end DAQ_EVENT
 /end IF_DATA
/end MEASUREMENT
/begin COMPU_METHOD wbc_arml3.12.KD_COMPU_METHOD "" LINEAR "%6.3" "" COEFFS_LINEAR 1 0 /end COMPU_METHOD
/begin MEASUREMENT wbc_arml3.12.KD "KD" FLOAT64_IEEE wbc_arml3.12.KD_COMPU_METHOD 0 0 -1E12 1E12 ECU_ADDRESS 0x70DE8
 /begin IF_DATA XCP
  /begin DAQ_EVENT FIXED_EVENT_LIST EVENT 0x0 /end DAQ_EVENT
 /end IF_DATA
/end MEASUREMENT
/begin COMPU_METHOD wbc_arml3.12.enable_COMPU_METHOD "" LINEAR "%6.3" "" COEFFS_LINEAR 1 0 /end COMPU_METHOD
/begin MEASUREMENT wbc_arml3.12.enable "enable" SBYTE wbc_arml3.12.enable_COMPU_METHOD 0 0 -128 127 ECU_ADDRESS 0x70DF0
 /begin IF_DATA XCP
  /begin DAQ_EVENT FIXED_EVENT_LIST EVENT 0x0 /end DAQ_EVENT
 /end IF_DATA
/end MEASUREMENT
/begin COMPU_METHOD wbc_arml3.12.operation_mode_COMPU_METHOD "" LINEAR "%6.3" "" COEFFS_LINEAR 1 0 /end COMPU_METHOD
/begin MEASUREMENT wbc_arml3.12.operation_mode "operation_mode" SBYTE wbc_arml3.12.operation_mode_COMPU_METHOD 0 0 -128 127 ECU_ADDRESS 0x70DF1
 /begin IF_DATA XCP
  /begin DAQ_EVENT FIXED_EVENT_LIST EVENT 0x0 /end DAQ_EVENT
 /end IF_DATA
/end MEASUREMENT
/begin COMPU_METHOD wbc_arml3.12.polarity_COMPU_METHOD "" LINEAR "%6.3" "" COEFFS_LINEAR 1 0 /end COMPU_METHOD
/begin MEASUREMENT wbc_arml3.12.polarity "polarity" UBYTE wbc_arml3.12.polarity_COMPU_METHOD 0 0 0 255 ECU_ADDRESS 0x70DF2
 /begin IF_DATA XCP
  /begin DAQ_EVENT FIXED_EVENT_LIST EVENT 0x0 /end DAQ_EVENT
 /end IF_DATA
/end MEASUREMENT
/begin GROUP joints_cmd.12.wbc_arml3 ""
 /begin REF_MEASUREMENT wbc_arml3.12.pos_cmd wbc_arml3.12.vel_cmd wbc_arml3.12.torque_cmd wbc_arml3.12.current_cmd wbc_arml3.12.velocity wbc_arml3.12.max_velocity wbc_arml3.12.acceleration wbc_arml3.12.deceleration wbc_arml3.12.KP wbc_arml3.12.KD wbc_arml3.12.enable wbc_arml3.12.operation_mode wbc_arml3.12.polarity /end REF_MEASUREMENT
/end GROUP
/begin COMPU_METHOD wbc_arml3.12.pos_fb_COMPU_METHOD "" LINEAR "%6.3" "" COEFFS_LINEAR 1 0 /end COMPU_METHOD
/begin MEASUREMENT wbc_arml3.12.pos_fb "pos_fb" FLOAT64_IEEE wbc_arml3.12.pos_fb_COMPU_METHOD 0 0 -1E12 1E12 ECU_ADDRESS 0x6FED8
 /begin IF_DATA XCP
  /begin DAQ_EVENT FIXED_EVENT_LIST EVENT 0x0 /end DAQ_EVENT
 /end IF_DATA
/end MEASUREMENT
/begin COMPU_METHOD wbc_arml3.12.vel_fb_COMPU_METHOD "" LINEAR "%6.3" "" COEFFS_LINEAR 1 0 /end COMPU_METHOD
/begin MEASUREMENT wbc_arml3.12.vel_fb "vel_fb" FLOAT64_IEEE wbc_arml3.12.vel_fb_COMPU_METHOD 0 0 -1E12 1E12 ECU_ADDRESS 0x6FEE0
 /begin IF_DATA XCP
  /begin DAQ_EVENT FIXED_EVENT_LIST EVENT 0x0 /end DAQ_EVENT
 /end IF_DATA
/end MEASUREMENT
/begin COMPU_METHOD wbc_arml3.12.torque_fb_COMPU_METHOD "" LINEAR "%6.3" "" COEFFS_LINEAR 1 0 /end COMPU_METHOD
/begin MEASUREMENT wbc_arml3.12.torque_fb "torque_fb" FLOAT64_IEEE wbc_arml3.12.torque_fb_COMPU_METHOD 0 0 -1E12 1E12 ECU_ADDRESS 0x6FEE8
 /begin IF_DATA XCP
  /begin DAQ_EVENT FIXED_EVENT_LIST EVENT 0x0 /end DAQ_EVENT
 /end IF_DATA
/end MEASUREMENT
/begin COMPU_METHOD wbc_arml3.12.current_fb_COMPU_METHOD "" LINEAR "%6.3" "" COEFFS_LINEAR 1 0 /end COMPU_METHOD
/begin MEASUREMENT wbc_arml3.12.current_fb "current_fb" FLOAT64_IEEE wbc_arml3.12.current_fb_COMPU_METHOD 0 0 -1E12 1E12 ECU_ADDRESS 0x6FEF0
 /begin IF_DATA XCP
  /begin DAQ_EVENT FIXED_EVENT_LIST EVENT 0x0 /end DAQ_EVENT
 /end IF_DATA
/end MEASUREMENT
/begin COMPU_METHOD wbc_arml3.12.motor_temper_COMPU_METHOD "" LINEAR "%6.3" "" COEFFS_LINEAR 1 0 /end COMPU_METHOD
/begin MEASUREMENT wbc_arml3.12.motor_temper "motor_temper" FLOAT64_IEEE wbc_arml3.12.motor_temper_COMPU_METHOD 0 0 -1E12 1E12 ECU_ADDRESS 0x6FEF8
 /begin IF_DATA XCP
  /begin DAQ_EVENT FIXED_EVENT_LIST EVENT 0x0 /end DAQ_EVENT
 /end IF_DATA
/end MEASUREMENT
/begin COMPU_METHOD wbc_arml3.12.min_soft_position_COMPU_METHOD "" LINEAR "%6.3" "" COEFFS_LINEAR 1 0 /end COMPU_METHOD
/begin MEASUREMENT wbc_arml3.12.min_soft_position "min_soft_position_limit" FLOAT64_IEEE wbc_arml3.12.min_soft_position_COMPU_METHOD 0 0 -1E12 1E12 ECU_ADDRESS 0x6FF00
 /begin IF_DATA XCP
  /begin DAQ_EVENT FIXED_EVENT_LIST EVENT 0x0 /end DAQ_EVENT
 /end IF_DATA
/end MEASUREMENT
/begin COMPU_METHOD wbc_arml3.12.max_soft_position_COMPU_METHOD "" LINEAR "%6.3" "" COEFFS_LINEAR 1 0 /end COMPU_METHOD
/begin MEASUREMENT wbc_arml3.12.max_soft_position "max_soft_position_limit" FLOAT64_IEEE wbc_arml3.12.max_soft_position_COMPU_METHOD 0 0 -1E12 1E12 ECU_ADDRESS 0x6FF08
 /begin IF_DATA XCP
  /begin DAQ_EVENT FIXED_EVENT_LIST EVENT 0x0 /end DAQ_EVENT
 /end IF_DATA
/end MEASUREMENT
/begin COMPU_METHOD wbc_arml3.12.max_profile_veloc_COMPU_METHOD "" LINEAR "%6.3" "" COEFFS_LINEAR 1 0 /end COMPU_METHOD
/begin MEASUREMENT wbc_arml3.12.max_profile_veloc "max_profile_velocity" FLOAT64_IEEE wbc_arml3.12.max_profile_veloc_COMPU_METHOD 0 0 -1E12 1E12 ECU_ADDRESS 0x6FF10
 /begin IF_DATA XCP
  /begin DAQ_EVENT FIXED_EVENT_LIST EVENT 0x0 /end DAQ_EVENT
 /end IF_DATA
/end MEASUREMENT
/begin COMPU_METHOD wbc_arml3.12.voltage_COMPU_METHOD "" LINEAR "%6.3" "" COEFFS_LINEAR 1 0 /end COMPU_METHOD
/begin MEASUREMENT wbc_arml3.12.voltage "voltage" FLOAT64_IEEE wbc_arml3.12.voltage_COMPU_METHOD 0 0 -1E12 1E12 ECU_ADDRESS 0x6FF20
 /begin IF_DATA XCP
  /begin DAQ_EVENT FIXED_EVENT_LIST EVENT 0x0 /end DAQ_EVENT
 /end IF_DATA
/end MEASUREMENT
/begin COMPU_METHOD wbc_arml3.12.enabled_COMPU_METHOD "" LINEAR "%6.3" "" COEFFS_LINEAR 1 0 /end COMPU_METHOD
/begin MEASUREMENT wbc_arml3.12.enabled "enabled" SBYTE wbc_arml3.12.enabled_COMPU_METHOD 0 0 -128 127 ECU_ADDRESS 0x6FF18
 /begin IF_DATA XCP
  /begin DAQ_EVENT FIXED_EVENT_LIST EVENT 0x0 /end DAQ_EVENT
 /end IF_DATA
/end MEASUREMENT
/begin COMPU_METHOD wbc_arml3.12.error_COMPU_METHOD "" LINEAR "%6.3" "" COEFFS_LINEAR 1 0 /end COMPU_METHOD
/begin MEASUREMENT wbc_arml3.12.error "error" SBYTE wbc_arml3.12.error_COMPU_METHOD 0 0 -128 127 ECU_ADDRESS 0x6FF19
 /begin IF_DATA XCP
  /begin DAQ_EVENT FIXED_EVENT_LIST EVENT 0x0 /end DAQ_EVENT
 /end IF_DATA
/end MEASUREMENT
/begin COMPU_METHOD wbc_arml3.12.operation_mode_di_COMPU_METHOD "" LINEAR "%6.3" "" COEFFS_LINEAR 1 0 /end COMPU_METHOD
/begin MEASUREMENT wbc_arml3.12.operation_mode_di "operation_mode_display" SBYTE wbc_arml3.12.operation_mode_di_COMPU_METHOD 0 0 -128 127 ECU_ADDRESS 0x6FF1A
 /begin IF_DATA XCP
  /begin DAQ_EVENT FIXED_EVENT_LIST EVENT 0x0 /end DAQ_EVENT
 /end IF_DATA
/end MEASUREMENT
/begin GROUP joints_status.12.wbc_arml3 ""
 /begin REF_MEASUREMENT wbc_arml3.12.pos_fb wbc_arml3.12.vel_fb wbc_arml3.12.torque_fb wbc_arml3.12.current_fb wbc_arml3.12.motor_temper wbc_arml3.12.min_soft_position wbc_arml3.12.max_soft_position wbc_arml3.12.max_profile_veloc wbc_arml3.12.voltage wbc_arml3.12.enabled wbc_arml3.12.error wbc_arml3.12.operation_mode_di /end REF_MEASUREMENT
/end GROUP
/begin COMPU_METHOD wbc_arml4.13.pos_cmd_COMPU_METHOD "" LINEAR "%6.3" "" COEFFS_LINEAR 1 0 /end COMPU_METHOD
/begin MEASUREMENT wbc_arml4.13.pos_cmd "pos_cmd" FLOAT64_IEEE wbc_arml4.13.pos_cmd_COMPU_METHOD 0 0 -1E12 1E12 ECU_ADDRESS 0x70DF8
 /begin IF_DATA XCP
  /begin DAQ_EVENT FIXED_EVENT_LIST EVENT 0x0 /end DAQ_EVENT
 /end IF_DATA
/end MEASUREMENT
/begin COMPU_METHOD wbc_arml4.13.vel_cmd_COMPU_METHOD "" LINEAR "%6.3" "" COEFFS_LINEAR 1 0 /end COMPU_METHOD
/begin MEASUREMENT wbc_arml4.13.vel_cmd "vel_cmd" FLOAT64_IEEE wbc_arml4.13.vel_cmd_COMPU_METHOD 0 0 -1E12 1E12 ECU_ADDRESS 0x70E00
 /begin IF_DATA XCP
  /begin DAQ_EVENT FIXED_EVENT_LIST EVENT 0x0 /end DAQ_EVENT
 /end IF_DATA
/end MEASUREMENT
/begin COMPU_METHOD wbc_arml4.13.torque_cmd_COMPU_METHOD "" LINEAR "%6.3" "" COEFFS_LINEAR 1 0 /end COMPU_METHOD
/begin MEASUREMENT wbc_arml4.13.torque_cmd "torque_cmd" FLOAT64_IEEE wbc_arml4.13.torque_cmd_COMPU_METHOD 0 0 -1E12 1E12 ECU_ADDRESS 0x70E08
 /begin IF_DATA XCP
  /begin DAQ_EVENT FIXED_EVENT_LIST EVENT 0x0 /end DAQ_EVENT
 /end IF_DATA
/end MEASUREMENT
/begin COMPU_METHOD wbc_arml4.13.current_cmd_COMPU_METHOD "" LINEAR "%6.3" "" COEFFS_LINEAR 1 0 /end COMPU_METHOD
/begin MEASUREMENT wbc_arml4.13.current_cmd "current_cmd" FLOAT64_IEEE wbc_arml4.13.current_cmd_COMPU_METHOD 0 0 -1E12 1E12 ECU_ADDRESS 0x70E10
 /begin IF_DATA XCP
  /begin DAQ_EVENT FIXED_EVENT_LIST EVENT 0x0 /end DAQ_EVENT
 /end IF_DATA
/end MEASUREMENT
/begin COMPU_METHOD wbc_arml4.13.velocity_COMPU_METHOD "" LINEAR "%6.3" "" COEFFS_LINEAR 1 0 /end COMPU_METHOD
/begin MEASUREMENT wbc_arml4.13.velocity "velocity" FLOAT64_IEEE wbc_arml4.13.velocity_COMPU_METHOD 0 0 -1E12 1E12 ECU_ADDRESS 0x70E18
 /begin IF_DATA XCP
  /begin DAQ_EVENT FIXED_EVENT_LIST EVENT 0x0 /end DAQ_EVENT
 /end IF_DATA
/end MEASUREMENT
/begin COMPU_METHOD wbc_arml4.13.max_velocity_COMPU_METHOD "" LINEAR "%6.3" "" COEFFS_LINEAR 1 0 /end COMPU_METHOD
/begin MEASUREMENT wbc_arml4.13.max_velocity "max_velocity" FLOAT64_IEEE wbc_arml4.13.max_velocity_COMPU_METHOD 0 0 -1E12 1E12 ECU_ADDRESS 0x70E20
 /begin IF_DATA XCP
  /begin DAQ_EVENT FIXED_EVENT_LIST EVENT 0x0 /end DAQ_EVENT
 /end IF_DATA
/end MEASUREMENT
/begin COMPU_METHOD wbc_arml4.13.acceleration_COMPU_METHOD "" LINEAR "%6.3" "" COEFFS_LINEAR 1 0 /end COMPU_METHOD
/begin MEASUREMENT wbc_arml4.13.acceleration "acceleration" FLOAT64_IEEE wbc_arml4.13.acceleration_COMPU_METHOD 0 0 -1E12 1E12 ECU_ADDRESS 0x70E28
 /begin IF_DATA XCP
  /begin DAQ_EVENT FIXED_EVENT_LIST EVENT 0x0 /end DAQ_EVENT
 /end IF_DATA
/end MEASUREMENT
/begin COMPU_METHOD wbc_arml4.13.deceleration_COMPU_METHOD "" LINEAR "%6.3" "" COEFFS_LINEAR 1 0 /end COMPU_METHOD
/begin MEASUREMENT wbc_arml4.13.deceleration "deceleration" FLOAT64_IEEE wbc_arml4.13.deceleration_COMPU_METHOD 0 0 -1E12 1E12 ECU_ADDRESS 0x70E30
 /begin IF_DATA XCP
  /begin DAQ_EVENT FIXED_EVENT_LIST EVENT 0x0 /end DAQ_EVENT
 /end IF_DATA
/end MEASUREMENT
/begin COMPU_METHOD wbc_arml4.13.KP_COMPU_METHOD "" LINEAR "%6.3" "" COEFFS_LINEAR 1 0 /end COMPU_METHOD
/begin MEASUREMENT wbc_arml4.13.KP "KP" FLOAT64_IEEE wbc_arml4.13.KP_COMPU_METHOD 0 0 -1E12 1E12 ECU_ADDRESS 0x70E38
 /begin IF_DATA XCP
  /begin DAQ_EVENT FIXED_EVENT_LIST EVENT 0x0 /end DAQ_EVENT
 /end IF_DATA
/end MEASUREMENT
/begin COMPU_METHOD wbc_arml4.13.KD_COMPU_METHOD "" LINEAR "%6.3" "" COEFFS_LINEAR 1 0 /end COMPU_METHOD
/begin MEASUREMENT wbc_arml4.13.KD "KD" FLOAT64_IEEE wbc_arml4.13.KD_COMPU_METHOD 0 0 -1E12 1E12 ECU_ADDRESS 0x70E40
 /begin IF_DATA XCP
  /begin DAQ_EVENT FIXED_EVENT_LIST EVENT 0x0 /end DAQ_EVENT
 /end IF_DATA
/end MEASUREMENT
/begin COMPU_METHOD wbc_arml4.13.enable_COMPU_METHOD "" LINEAR "%6.3" "" COEFFS_LINEAR 1 0 /end COMPU_METHOD
/begin MEASUREMENT wbc_arml4.13.enable "enable" SBYTE wbc_arml4.13.enable_COMPU_METHOD 0 0 -128 127 ECU_ADDRESS 0x70E48
 /begin IF_DATA XCP
  /begin DAQ_EVENT FIXED_EVENT_LIST EVENT 0x0 /end DAQ_EVENT
 /end IF_DATA
/end MEASUREMENT
/begin COMPU_METHOD wbc_arml4.13.operation_mode_COMPU_METHOD "" LINEAR "%6.3" "" COEFFS_LINEAR 1 0 /end COMPU_METHOD
/begin MEASUREMENT wbc_arml4.13.operation_mode "operation_mode" SBYTE wbc_arml4.13.operation_mode_COMPU_METHOD 0 0 -128 127 ECU_ADDRESS 0x70E49
 /begin IF_DATA XCP
  /begin DAQ_EVENT FIXED_EVENT_LIST EVENT 0x0 /end DAQ_EVENT
 /end IF_DATA
/end MEASUREMENT
/begin COMPU_METHOD wbc_arml4.13.polarity_COMPU_METHOD "" LINEAR "%6.3" "" COEFFS_LINEAR 1 0 /end COMPU_METHOD
/begin MEASUREMENT wbc_arml4.13.polarity "polarity" UBYTE wbc_arml4.13.polarity_COMPU_METHOD 0 0 0 255 ECU_ADDRESS 0x70E4A
 /begin IF_DATA XCP
  /begin DAQ_EVENT FIXED_EVENT_LIST EVENT 0x0 /end DAQ_EVENT
 /end IF_DATA
/end MEASUREMENT
/begin GROUP joints_cmd.13.wbc_arml4 ""
 /begin REF_MEASUREMENT wbc_arml4.13.pos_cmd wbc_arml4.13.vel_cmd wbc_arml4.13.torque_cmd wbc_arml4.13.current_cmd wbc_arml4.13.velocity wbc_arml4.13.max_velocity wbc_arml4.13.acceleration wbc_arml4.13.deceleration wbc_arml4.13.KP wbc_arml4.13.KD wbc_arml4.13.enable wbc_arml4.13.operation_mode wbc_arml4.13.polarity /end REF_MEASUREMENT
/end GROUP
/begin COMPU_METHOD wbc_arml4.13.pos_fb_COMPU_METHOD "" LINEAR "%6.3" "" COEFFS_LINEAR 1 0 /end COMPU_METHOD
/begin MEASUREMENT wbc_arml4.13.pos_fb "pos_fb" FLOAT64_IEEE wbc_arml4.13.pos_fb_COMPU_METHOD 0 0 -1E12 1E12 ECU_ADDRESS 0x6FF28
 /begin IF_DATA XCP
  /begin DAQ_EVENT FIXED_EVENT_LIST EVENT 0x0 /end DAQ_EVENT
 /end IF_DATA
/end MEASUREMENT
/begin COMPU_METHOD wbc_arml4.13.vel_fb_COMPU_METHOD "" LINEAR "%6.3" "" COEFFS_LINEAR 1 0 /end COMPU_METHOD
/begin MEASUREMENT wbc_arml4.13.vel_fb "vel_fb" FLOAT64_IEEE wbc_arml4.13.vel_fb_COMPU_METHOD 0 0 -1E12 1E12 ECU_ADDRESS 0x6FF30
 /begin IF_DATA XCP
  /begin DAQ_EVENT FIXED_EVENT_LIST EVENT 0x0 /end DAQ_EVENT
 /end IF_DATA
/end MEASUREMENT
/begin COMPU_METHOD wbc_arml4.13.torque_fb_COMPU_METHOD "" LINEAR "%6.3" "" COEFFS_LINEAR 1 0 /end COMPU_METHOD
/begin MEASUREMENT wbc_arml4.13.torque_fb "torque_fb" FLOAT64_IEEE wbc_arml4.13.torque_fb_COMPU_METHOD 0 0 -1E12 1E12 ECU_ADDRESS 0x6FF38
 /begin IF_DATA XCP
  /begin DAQ_EVENT FIXED_EVENT_LIST EVENT 0x0 /end DAQ_EVENT
 /end IF_DATA
/end MEASUREMENT
/begin COMPU_METHOD wbc_arml4.13.current_fb_COMPU_METHOD "" LINEAR "%6.3" "" COEFFS_LINEAR 1 0 /end COMPU_METHOD
/begin MEASUREMENT wbc_arml4.13.current_fb "current_fb" FLOAT64_IEEE wbc_arml4.13.current_fb_COMPU_METHOD 0 0 -1E12 1E12 ECU_ADDRESS 0x6FF40
 /begin IF_DATA XCP
  /begin DAQ_EVENT FIXED_EVENT_LIST EVENT 0x0 /end DAQ_EVENT
 /end IF_DATA
/end MEASUREMENT
/begin COMPU_METHOD wbc_arml4.13.motor_temper_COMPU_METHOD "" LINEAR "%6.3" "" COEFFS_LINEAR 1 0 /end COMPU_METHOD
/begin MEASUREMENT wbc_arml4.13.motor_temper "motor_temper" FLOAT64_IEEE wbc_arml4.13.motor_temper_COMPU_METHOD 0 0 -1E12 1E12 ECU_ADDRESS 0x6FF48
 /begin IF_DATA XCP
  /begin DAQ_EVENT FIXED_EVENT_LIST EVENT 0x0 /end DAQ_EVENT
 /end IF_DATA
/end MEASUREMENT
/begin COMPU_METHOD wbc_arml4.13.min_soft_position_COMPU_METHOD "" LINEAR "%6.3" "" COEFFS_LINEAR 1 0 /end COMPU_METHOD
/begin MEASUREMENT wbc_arml4.13.min_soft_position "min_soft_position_limit" FLOAT64_IEEE wbc_arml4.13.min_soft_position_COMPU_METHOD 0 0 -1E12 1E12 ECU_ADDRESS 0x6FF50
 /begin IF_DATA XCP
  /begin DAQ_EVENT FIXED_EVENT_LIST EVENT 0x0 /end DAQ_EVENT
 /end IF_DATA
/end MEASUREMENT
/begin COMPU_METHOD wbc_arml4.13.max_soft_position_COMPU_METHOD "" LINEAR "%6.3" "" COEFFS_LINEAR 1 0 /end COMPU_METHOD
/begin MEASUREMENT wbc_arml4.13.max_soft_position "max_soft_position_limit" FLOAT64_IEEE wbc_arml4.13.max_soft_position_COMPU_METHOD 0 0 -1E12 1E12 ECU_ADDRESS 0x6FF58
 /begin IF_DATA XCP
  /begin DAQ_EVENT FIXED_EVENT_LIST EVENT 0x0 /end DAQ_EVENT
 /end IF_DATA
/end MEASUREMENT
/begin COMPU_METHOD wbc_arml4.13.max_profile_veloc_COMPU_METHOD "" LINEAR "%6.3" "" COEFFS_LINEAR 1 0 /end COMPU_METHOD
/begin MEASUREMENT wbc_arml4.13.max_profile_veloc "max_profile_velocity" FLOAT64_IEEE wbc_arml4.13.max_profile_veloc_COMPU_METHOD 0 0 -1E12 1E12 ECU_ADDRESS 0x6FF60
 /begin IF_DATA XCP
  /begin DAQ_EVENT FIXED_EVENT_LIST EVENT 0x0 /end DAQ_EVENT
 /end IF_DATA
/end MEASUREMENT
/begin COMPU_METHOD wbc_arml4.13.voltage_COMPU_METHOD "" LINEAR "%6.3" "" COEFFS_LINEAR 1 0 /end COMPU_METHOD
/begin MEASUREMENT wbc_arml4.13.voltage "voltage" FLOAT64_IEEE wbc_arml4.13.voltage_COMPU_METHOD 0 0 -1E12 1E12 ECU_ADDRESS 0x6FF70
 /begin IF_DATA XCP
  /begin DAQ_EVENT FIXED_EVENT_LIST EVENT 0x0 /end DAQ_EVENT
 /end IF_DATA
/end MEASUREMENT
/begin COMPU_METHOD wbc_arml4.13.enabled_COMPU_METHOD "" LINEAR "%6.3" "" COEFFS_LINEAR 1 0 /end COMPU_METHOD
/begin MEASUREMENT wbc_arml4.13.enabled "enabled" SBYTE wbc_arml4.13.enabled_COMPU_METHOD 0 0 -128 127 ECU_ADDRESS 0x6FF68
 /begin IF_DATA XCP
  /begin DAQ_EVENT FIXED_EVENT_LIST EVENT 0x0 /end DAQ_EVENT
 /end IF_DATA
/end MEASUREMENT
/begin COMPU_METHOD wbc_arml4.13.error_COMPU_METHOD "" LINEAR "%6.3" "" COEFFS_LINEAR 1 0 /end COMPU_METHOD
/begin MEASUREMENT wbc_arml4.13.error "error" SBYTE wbc_arml4.13.error_COMPU_METHOD 0 0 -128 127 ECU_ADDRESS 0x6FF69
 /begin IF_DATA XCP
  /begin DAQ_EVENT FIXED_EVENT_LIST EVENT 0x0 /end DAQ_EVENT
 /end IF_DATA
/end MEASUREMENT
/begin COMPU_METHOD wbc_arml4.13.operation_mode_di_COMPU_METHOD "" LINEAR "%6.3" "" COEFFS_LINEAR 1 0 /end COMPU_METHOD
/begin MEASUREMENT wbc_arml4.13.operation_mode_di "operation_mode_display" SBYTE wbc_arml4.13.operation_mode_di_COMPU_METHOD 0 0 -128 127 ECU_ADDRESS 0x6FF6A
 /begin IF_DATA XCP
  /begin DAQ_EVENT FIXED_EVENT_LIST EVENT 0x0 /end DAQ_EVENT
 /end IF_DATA
/end MEASUREMENT
/begin GROUP joints_status.13.wbc_arml4 ""
 /begin REF_MEASUREMENT wbc_arml4.13.pos_fb wbc_arml4.13.vel_fb wbc_arml4.13.torque_fb wbc_arml4.13.current_fb wbc_arml4.13.motor_temper wbc_arml4.13.min_soft_position wbc_arml4.13.max_soft_position wbc_arml4.13.max_profile_veloc wbc_arml4.13.voltage wbc_arml4.13.enabled wbc_arml4.13.error wbc_arml4.13.operation_mode_di /end REF_MEASUREMENT
/end GROUP
/begin COMPU_METHOD wbc_arml5.14.pos_cmd_COMPU_METHOD "" LINEAR "%6.3" "" COEFFS_LINEAR 1 0 /end COMPU_METHOD
/begin MEASUREMENT wbc_arml5.14.pos_cmd "pos_cmd" FLOAT64_IEEE wbc_arml5.14.pos_cmd_COMPU_METHOD 0 0 -1E12 1E12 ECU_ADDRESS 0x70E50
 /begin IF_DATA XCP
  /begin DAQ_EVENT FIXED_EVENT_LIST EVENT 0x0 /end DAQ_EVENT
 /end IF_DATA
/end MEASUREMENT
/begin COMPU_METHOD wbc_arml5.14.vel_cmd_COMPU_METHOD "" LINEAR "%6.3" "" COEFFS_LINEAR 1 0 /end COMPU_METHOD
/begin MEASUREMENT wbc_arml5.14.vel_cmd "vel_cmd" FLOAT64_IEEE wbc_arml5.14.vel_cmd_COMPU_METHOD 0 0 -1E12 1E12 ECU_ADDRESS 0x70E58
 /begin IF_DATA XCP
  /begin DAQ_EVENT FIXED_EVENT_LIST EVENT 0x0 /end DAQ_EVENT
 /end IF_DATA
/end MEASUREMENT
/begin COMPU_METHOD wbc_arml5.14.torque_cmd_COMPU_METHOD "" LINEAR "%6.3" "" COEFFS_LINEAR 1 0 /end COMPU_METHOD
/begin MEASUREMENT wbc_arml5.14.torque_cmd "torque_cmd" FLOAT64_IEEE wbc_arml5.14.torque_cmd_COMPU_METHOD 0 0 -1E12 1E12 ECU_ADDRESS 0x70E60
 /begin IF_DATA XCP
  /begin DAQ_EVENT FIXED_EVENT_LIST EVENT 0x0 /end DAQ_EVENT
 /end IF_DATA
/end MEASUREMENT
/begin COMPU_METHOD wbc_arml5.14.current_cmd_COMPU_METHOD "" LINEAR "%6.3" "" COEFFS_LINEAR 1 0 /end COMPU_METHOD
/begin MEASUREMENT wbc_arml5.14.current_cmd "current_cmd" FLOAT64_IEEE wbc_arml5.14.current_cmd_COMPU_METHOD 0 0 -1E12 1E12 ECU_ADDRESS 0x70E68
 /begin IF_DATA XCP
  /begin DAQ_EVENT FIXED_EVENT_LIST EVENT 0x0 /end DAQ_EVENT
 /end IF_DATA
/end MEASUREMENT
/begin COMPU_METHOD wbc_arml5.14.velocity_COMPU_METHOD "" LINEAR "%6.3" "" COEFFS_LINEAR 1 0 /end COMPU_METHOD
/begin MEASUREMENT wbc_arml5.14.velocity "velocity" FLOAT64_IEEE wbc_arml5.14.velocity_COMPU_METHOD 0 0 -1E12 1E12 ECU_ADDRESS 0x70E70
 /begin IF_DATA XCP
  /begin DAQ_EVENT FIXED_EVENT_LIST EVENT 0x0 /end DAQ_EVENT
 /end IF_DATA
/end MEASUREMENT
/begin COMPU_METHOD wbc_arml5.14.max_velocity_COMPU_METHOD "" LINEAR "%6.3" "" COEFFS_LINEAR 1 0 /end COMPU_METHOD
/begin MEASUREMENT wbc_arml5.14.max_velocity "max_velocity" FLOAT64_IEEE wbc_arml5.14.max_velocity_COMPU_METHOD 0 0 -1E12 1E12 ECU_ADDRESS 0x70E78
 /begin IF_DATA XCP
  /begin DAQ_EVENT FIXED_EVENT_LIST EVENT 0x0 /end DAQ_EVENT
 /end IF_DATA
/end MEASUREMENT
/begin COMPU_METHOD wbc_arml5.14.acceleration_COMPU_METHOD "" LINEAR "%6.3" "" COEFFS_LINEAR 1 0 /end COMPU_METHOD
/begin MEASUREMENT wbc_arml5.14.acceleration "acceleration" FLOAT64_IEEE wbc_arml5.14.acceleration_COMPU_METHOD 0 0 -1E12 1E12 ECU_ADDRESS 0x70E80
 /begin IF_DATA XCP
  /begin DAQ_EVENT FIXED_EVENT_LIST EVENT 0x0 /end DAQ_EVENT
 /end IF_DATA
/end MEASUREMENT
/begin COMPU_METHOD wbc_arml5.14.deceleration_COMPU_METHOD "" LINEAR "%6.3" "" COEFFS_LINEAR 1 0 /end COMPU_METHOD
/begin MEASUREMENT wbc_arml5.14.deceleration "deceleration" FLOAT64_IEEE wbc_arml5.14.deceleration_COMPU_METHOD 0 0 -1E12 1E12 ECU_ADDRESS 0x70E88
 /begin IF_DATA XCP
  /begin DAQ_EVENT FIXED_EVENT_LIST EVENT 0x0 /end DAQ_EVENT
 /end IF_DATA
/end MEASUREMENT
/begin COMPU_METHOD wbc_arml5.14.KP_COMPU_METHOD "" LINEAR "%6.3" "" COEFFS_LINEAR 1 0 /end COMPU_METHOD
/begin MEASUREMENT wbc_arml5.14.KP "KP" FLOAT64_IEEE wbc_arml5.14.KP_COMPU_METHOD 0 0 -1E12 1E12 ECU_ADDRESS 0x70E90
 /begin IF_DATA XCP
  /begin DAQ_EVENT FIXED_EVENT_LIST EVENT 0x0 /end DAQ_EVENT
 /end IF_DATA
/end MEASUREMENT
/begin COMPU_METHOD wbc_arml5.14.KD_COMPU_METHOD "" LINEAR "%6.3" "" COEFFS_LINEAR 1 0 /end COMPU_METHOD
/begin MEASUREMENT wbc_arml5.14.KD "KD" FLOAT64_IEEE wbc_arml5.14.KD_COMPU_METHOD 0 0 -1E12 1E12 ECU_ADDRESS 0x70E98
 /begin IF_DATA XCP
  /begin DAQ_EVENT FIXED_EVENT_LIST EVENT 0x0 /end DAQ_EVENT
 /end IF_DATA
/end MEASUREMENT
/begin COMPU_METHOD wbc_arml5.14.enable_COMPU_METHOD "" LINEAR "%6.3" "" COEFFS_LINEAR 1 0 /end COMPU_METHOD
/begin MEASUREMENT wbc_arml5.14.enable "enable" SBYTE wbc_arml5.14.enable_COMPU_METHOD 0 0 -128 127 ECU_ADDRESS 0x70EA0
 /begin IF_DATA XCP
  /begin DAQ_EVENT FIXED_EVENT_LIST EVENT 0x0 /end DAQ_EVENT
 /end IF_DATA
/end MEASUREMENT
/begin COMPU_METHOD wbc_arml5.14.operation_mode_COMPU_METHOD "" LINEAR "%6.3" "" COEFFS_LINEAR 1 0 /end COMPU_METHOD
/begin MEASUREMENT wbc_arml5.14.operation_mode "operation_mode" SBYTE wbc_arml5.14.operation_mode_COMPU_METHOD 0 0 -128 127 ECU_ADDRESS 0x70EA1
 /begin IF_DATA XCP
  /begin DAQ_EVENT FIXED_EVENT_LIST EVENT 0x0 /end DAQ_EVENT
 /end IF_DATA
/end MEASUREMENT
/begin COMPU_METHOD wbc_arml5.14.polarity_COMPU_METHOD "" LINEAR "%6.3" "" COEFFS_LINEAR 1 0 /end COMPU_METHOD
/begin MEASUREMENT wbc_arml5.14.polarity "polarity" UBYTE wbc_arml5.14.polarity_COMPU_METHOD 0 0 0 255 ECU_ADDRESS 0x70EA2
 /begin IF_DATA XCP
  /begin DAQ_EVENT FIXED_EVENT_LIST EVENT 0x0 /end DAQ_EVENT
 /end IF_DATA
/end MEASUREMENT
/begin GROUP joints_cmd.14.wbc_arml5 ""
 /begin REF_MEASUREMENT wbc_arml5.14.pos_cmd wbc_arml5.14.vel_cmd wbc_arml5.14.torque_cmd wbc_arml5.14.current_cmd wbc_arml5.14.velocity wbc_arml5.14.max_velocity wbc_arml5.14.acceleration wbc_arml5.14.deceleration wbc_arml5.14.KP wbc_arml5.14.KD wbc_arml5.14.enable wbc_arml5.14.operation_mode wbc_arml5.14.polarity /end REF_MEASUREMENT
/end GROUP
/begin COMPU_METHOD wbc_arml5.14.pos_fb_COMPU_METHOD "" LINEAR "%6.3" "" COEFFS_LINEAR 1 0 /end COMPU_METHOD
/begin MEASUREMENT wbc_arml5.14.pos_fb "pos_fb" FLOAT64_IEEE wbc_arml5.14.pos_fb_COMPU_METHOD 0 0 -1E12 1E12 ECU_ADDRESS 0x6FF78
 /begin IF_DATA XCP
  /begin DAQ_EVENT FIXED_EVENT_LIST EVENT 0x0 /end DAQ_EVENT
 /end IF_DATA
/end MEASUREMENT
/begin COMPU_METHOD wbc_arml5.14.vel_fb_COMPU_METHOD "" LINEAR "%6.3" "" COEFFS_LINEAR 1 0 /end COMPU_METHOD
/begin MEASUREMENT wbc_arml5.14.vel_fb "vel_fb" FLOAT64_IEEE wbc_arml5.14.vel_fb_COMPU_METHOD 0 0 -1E12 1E12 ECU_ADDRESS 0x6FF80
 /begin IF_DATA XCP
  /begin DAQ_EVENT FIXED_EVENT_LIST EVENT 0x0 /end DAQ_EVENT
 /end IF_DATA
/end MEASUREMENT
/begin COMPU_METHOD wbc_arml5.14.torque_fb_COMPU_METHOD "" LINEAR "%6.3" "" COEFFS_LINEAR 1 0 /end COMPU_METHOD
/begin MEASUREMENT wbc_arml5.14.torque_fb "torque_fb" FLOAT64_IEEE wbc_arml5.14.torque_fb_COMPU_METHOD 0 0 -1E12 1E12 ECU_ADDRESS 0x6FF88
 /begin IF_DATA XCP
  /begin DAQ_EVENT FIXED_EVENT_LIST EVENT 0x0 /end DAQ_EVENT
 /end IF_DATA
/end MEASUREMENT
/begin COMPU_METHOD wbc_arml5.14.current_fb_COMPU_METHOD "" LINEAR "%6.3" "" COEFFS_LINEAR 1 0 /end COMPU_METHOD
/begin MEASUREMENT wbc_arml5.14.current_fb "current_fb" FLOAT64_IEEE wbc_arml5.14.current_fb_COMPU_METHOD 0 0 -1E12 1E12 ECU_ADDRESS 0x6FF90
 /begin IF_DATA XCP
  /begin DAQ_EVENT FIXED_EVENT_LIST EVENT 0x0 /end DAQ_EVENT
 /end IF_DATA
/end MEASUREMENT
/begin COMPU_METHOD wbc_arml5.14.motor_temper_COMPU_METHOD "" LINEAR "%6.3" "" COEFFS_LINEAR 1 0 /end COMPU_METHOD
/begin MEASUREMENT wbc_arml5.14.motor_temper "motor_temper" FLOAT64_IEEE wbc_arml5.14.motor_temper_COMPU_METHOD 0 0 -1E12 1E12 ECU_ADDRESS 0x6FF98
 /begin IF_DATA XCP
  /begin DAQ_EVENT FIXED_EVENT_LIST EVENT 0x0 /end DAQ_EVENT
 /end IF_DATA
/end MEASUREMENT
/begin COMPU_METHOD wbc_arml5.14.min_soft_position_COMPU_METHOD "" LINEAR "%6.3" "" COEFFS_LINEAR 1 0 /end COMPU_METHOD
/begin MEASUREMENT wbc_arml5.14.min_soft_position "min_soft_position_limit" FLOAT64_IEEE wbc_arml5.14.min_soft_position_COMPU_METHOD 0 0 -1E12 1E12 ECU_ADDRESS 0x6FFA0
 /begin IF_DATA XCP
  /begin DAQ_EVENT FIXED_EVENT_LIST EVENT 0x0 /end DAQ_EVENT
 /end IF_DATA
/end MEASUREMENT
/begin COMPU_METHOD wbc_arml5.14.max_soft_position_COMPU_METHOD "" LINEAR "%6.3" "" COEFFS_LINEAR 1 0 /end COMPU_METHOD
/begin MEASUREMENT wbc_arml5.14.max_soft_position "max_soft_position_limit" FLOAT64_IEEE wbc_arml5.14.max_soft_position_COMPU_METHOD 0 0 -1E12 1E12 ECU_ADDRESS 0x6FFA8
 /begin IF_DATA XCP
  /begin DAQ_EVENT FIXED_EVENT_LIST EVENT 0x0 /end DAQ_EVENT
 /end IF_DATA
/end MEASUREMENT
/begin COMPU_METHOD wbc_arml5.14.max_profile_veloc_COMPU_METHOD "" LINEAR "%6.3" "" COEFFS_LINEAR 1 0 /end COMPU_METHOD
/begin MEASUREMENT wbc_arml5.14.max_profile_veloc "max_profile_velocity" FLOAT64_IEEE wbc_arml5.14.max_profile_veloc_COMPU_METHOD 0 0 -1E12 1E12 ECU_ADDRESS 0x6FFB0
 /begin IF_DATA XCP
  /begin DAQ_EVENT FIXED_EVENT_LIST EVENT 0x0 /end DAQ_EVENT
 /end IF_DATA
/end MEASUREMENT
/begin COMPU_METHOD wbc_arml5.14.voltage_COMPU_METHOD "" LINEAR "%6.3" "" COEFFS_LINEAR 1 0 /end COMPU_METHOD
/begin MEASUREMENT wbc_arml5.14.voltage "voltage" FLOAT64_IEEE wbc_arml5.14.voltage_COMPU_METHOD 0 0 -1E12 1E12 ECU_ADDRESS 0x6FFC0
 /begin IF_DATA XCP
  /begin DAQ_EVENT FIXED_EVENT_LIST EVENT 0x0 /end DAQ_EVENT
 /end IF_DATA
/end MEASUREMENT
/begin COMPU_METHOD wbc_arml5.14.enabled_COMPU_METHOD "" LINEAR "%6.3" "" COEFFS_LINEAR 1 0 /end COMPU_METHOD
/begin MEASUREMENT wbc_arml5.14.enabled "enabled" SBYTE wbc_arml5.14.enabled_COMPU_METHOD 0 0 -128 127 ECU_ADDRESS 0x6FFB8
 /begin IF_DATA XCP
  /begin DAQ_EVENT FIXED_EVENT_LIST EVENT 0x0 /end DAQ_EVENT
 /end IF_DATA
/end MEASUREMENT
/begin COMPU_METHOD wbc_arml5.14.error_COMPU_METHOD "" LINEAR "%6.3" "" COEFFS_LINEAR 1 0 /end COMPU_METHOD
/begin MEASUREMENT wbc_arml5.14.error "error" SBYTE wbc_arml5.14.error_COMPU_METHOD 0 0 -128 127 ECU_ADDRESS 0x6FFB9
 /begin IF_DATA XCP
  /begin DAQ_EVENT FIXED_EVENT_LIST EVENT 0x0 /end DAQ_EVENT
 /end IF_DATA
/end MEASUREMENT
/begin COMPU_METHOD wbc_arml5.14.operation_mode_di_COMPU_METHOD "" LINEAR "%6.3" "" COEFFS_LINEAR 1 0 /end COMPU_METHOD
/begin MEASUREMENT wbc_arml5.14.operation_mode_di "operation_mode_display" SBYTE wbc_arml5.14.operation_mode_di_COMPU_METHOD 0 0 -128 127 ECU_ADDRESS 0x6FFBA
 /begin IF_DATA XCP
  /begin DAQ_EVENT FIXED_EVENT_LIST EVENT 0x0 /end DAQ_EVENT
 /end IF_DATA
/end MEASUREMENT
/begin GROUP joints_status.14.wbc_arml5 ""
 /begin REF_MEASUREMENT wbc_arml5.14.pos_fb wbc_arml5.14.vel_fb wbc_arml5.14.torque_fb wbc_arml5.14.current_fb wbc_arml5.14.motor_temper wbc_arml5.14.min_soft_position wbc_arml5.14.max_soft_position wbc_arml5.14.max_profile_veloc wbc_arml5.14.voltage wbc_arml5.14.enabled wbc_arml5.14.error wbc_arml5.14.operation_mode_di /end REF_MEASUREMENT
/end GROUP
/begin COMPU_METHOD wbc_arml6.15.pos_cmd_COMPU_METHOD "" LINEAR "%6.3" "" COEFFS_LINEAR 1 0 /end COMPU_METHOD
/begin MEASUREMENT wbc_arml6.15.pos_cmd "pos_cmd" FLOAT64_IEEE wbc_arml6.15.pos_cmd_COMPU_METHOD 0 0 -1E12 1E12 ECU_ADDRESS 0x70EA8
 /begin IF_DATA XCP
  /begin DAQ_EVENT FIXED_EVENT_LIST EVENT 0x0 /end DAQ_EVENT
 /end IF_DATA
/end MEASUREMENT
/begin COMPU_METHOD wbc_arml6.15.vel_cmd_COMPU_METHOD "" LINEAR "%6.3" "" COEFFS_LINEAR 1 0 /end COMPU_METHOD
/begin MEASUREMENT wbc_arml6.15.vel_cmd "vel_cmd" FLOAT64_IEEE wbc_arml6.15.vel_cmd_COMPU_METHOD 0 0 -1E12 1E12 ECU_ADDRESS 0x70EB0
 /begin IF_DATA XCP
  /begin DAQ_EVENT FIXED_EVENT_LIST EVENT 0x0 /end DAQ_EVENT
 /end IF_DATA
/end MEASUREMENT
/begin COMPU_METHOD wbc_arml6.15.torque_cmd_COMPU_METHOD "" LINEAR "%6.3" "" COEFFS_LINEAR 1 0 /end COMPU_METHOD
/begin MEASUREMENT wbc_arml6.15.torque_cmd "torque_cmd" FLOAT64_IEEE wbc_arml6.15.torque_cmd_COMPU_METHOD 0 0 -1E12 1E12 ECU_ADDRESS 0x70EB8
 /begin IF_DATA XCP
  /begin DAQ_EVENT FIXED_EVENT_LIST EVENT 0x0 /end DAQ_EVENT
 /end IF_DATA
/end MEASUREMENT
/begin COMPU_METHOD wbc_arml6.15.current_cmd_COMPU_METHOD "" LINEAR "%6.3" "" COEFFS_LINEAR 1 0 /end COMPU_METHOD
/begin MEASUREMENT wbc_arml6.15.current_cmd "current_cmd" FLOAT64_IEEE wbc_arml6.15.current_cmd_COMPU_METHOD 0 0 -1E12 1E12 ECU_ADDRESS 0x70EC0
 /begin IF_DATA XCP
  /begin DAQ_EVENT FIXED_EVENT_LIST EVENT 0x0 /end DAQ_EVENT
 /end IF_DATA
/end MEASUREMENT
/begin COMPU_METHOD wbc_arml6.15.velocity_COMPU_METHOD "" LINEAR "%6.3" "" COEFFS_LINEAR 1 0 /end COMPU_METHOD
/begin MEASUREMENT wbc_arml6.15.velocity "velocity" FLOAT64_IEEE wbc_arml6.15.velocity_COMPU_METHOD 0 0 -1E12 1E12 ECU_ADDRESS 0x70EC8
 /begin IF_DATA XCP
  /begin DAQ_EVENT FIXED_EVENT_LIST EVENT 0x0 /end DAQ_EVENT
 /end IF_DATA
/end MEASUREMENT
/begin COMPU_METHOD wbc_arml6.15.max_velocity_COMPU_METHOD "" LINEAR "%6.3" "" COEFFS_LINEAR 1 0 /end COMPU_METHOD
/begin MEASUREMENT wbc_arml6.15.max_velocity "max_velocity" FLOAT64_IEEE wbc_arml6.15.max_velocity_COMPU_METHOD 0 0 -1E12 1E12 ECU_ADDRESS 0x70ED0
 /begin IF_DATA XCP
  /begin DAQ_EVENT FIXED_EVENT_LIST EVENT 0x0 /end DAQ_EVENT
 /end IF_DATA
/end MEASUREMENT
/begin COMPU_METHOD wbc_arml6.15.acceleration_COMPU_METHOD "" LINEAR "%6.3" "" COEFFS_LINEAR 1 0 /end COMPU_METHOD
/begin MEASUREMENT wbc_arml6.15.acceleration "acceleration" FLOAT64_IEEE wbc_arml6.15.acceleration_COMPU_METHOD 0 0 -1E12 1E12 ECU_ADDRESS 0x70ED8
 /begin IF_DATA XCP
  /begin DAQ_EVENT FIXED_EVENT_LIST EVENT 0x0 /end DAQ_EVENT
 /end IF_DATA
/end MEASUREMENT
/begin COMPU_METHOD wbc_arml6.15.deceleration_COMPU_METHOD "" LINEAR "%6.3" "" COEFFS_LINEAR 1 0 /end COMPU_METHOD
/begin MEASUREMENT wbc_arml6.15.deceleration "deceleration" FLOAT64_IEEE wbc_arml6.15.deceleration_COMPU_METHOD 0 0 -1E12 1E12 ECU_ADDRESS 0x70EE0
 /begin IF_DATA XCP
  /begin DAQ_EVENT FIXED_EVENT_LIST EVENT 0x0 /end DAQ_EVENT
 /end IF_DATA
/end MEASUREMENT
/begin COMPU_METHOD wbc_arml6.15.KP_COMPU_METHOD "" LINEAR "%6.3" "" COEFFS_LINEAR 1 0 /end COMPU_METHOD
/begin MEASUREMENT wbc_arml6.15.KP "KP" FLOAT64_IEEE wbc_arml6.15.KP_COMPU_METHOD 0 0 -1E12 1E12 ECU_ADDRESS 0x70EE8
 /begin IF_DATA XCP
  /begin DAQ_EVENT FIXED_EVENT_LIST EVENT 0x0 /end DAQ_EVENT
 /end IF_DATA
/end MEASUREMENT
/begin COMPU_METHOD wbc_arml6.15.KD_COMPU_METHOD "" LINEAR "%6.3" "" COEFFS_LINEAR 1 0 /end COMPU_METHOD
/begin MEASUREMENT wbc_arml6.15.KD "KD" FLOAT64_IEEE wbc_arml6.15.KD_COMPU_METHOD 0 0 -1E12 1E12 ECU_ADDRESS 0x70EF0
 /begin IF_DATA XCP
  /begin DAQ_EVENT FIXED_EVENT_LIST EVENT 0x0 /end DAQ_EVENT
 /end IF_DATA
/end MEASUREMENT
/begin COMPU_METHOD wbc_arml6.15.enable_COMPU_METHOD "" LINEAR "%6.3" "" COEFFS_LINEAR 1 0 /end COMPU_METHOD
/begin MEASUREMENT wbc_arml6.15.enable "enable" SBYTE wbc_arml6.15.enable_COMPU_METHOD 0 0 -128 127 ECU_ADDRESS 0x70EF8
 /begin IF_DATA XCP
  /begin DAQ_EVENT FIXED_EVENT_LIST EVENT 0x0 /end DAQ_EVENT
 /end IF_DATA
/end MEASUREMENT
/begin COMPU_METHOD wbc_arml6.15.operation_mode_COMPU_METHOD "" LINEAR "%6.3" "" COEFFS_LINEAR 1 0 /end COMPU_METHOD
/begin MEASUREMENT wbc_arml6.15.operation_mode "operation_mode" SBYTE wbc_arml6.15.operation_mode_COMPU_METHOD 0 0 -128 127 ECU_ADDRESS 0x70EF9
 /begin IF_DATA XCP
  /begin DAQ_EVENT FIXED_EVENT_LIST EVENT 0x0 /end DAQ_EVENT
 /end IF_DATA
/end MEASUREMENT
/begin COMPU_METHOD wbc_arml6.15.polarity_COMPU_METHOD "" LINEAR "%6.3" "" COEFFS_LINEAR 1 0 /end COMPU_METHOD
/begin MEASUREMENT wbc_arml6.15.polarity "polarity" UBYTE wbc_arml6.15.polarity_COMPU_METHOD 0 0 0 255 ECU_ADDRESS 0x70EFA
 /begin IF_DATA XCP
  /begin DAQ_EVENT FIXED_EVENT_LIST EVENT 0x0 /end DAQ_EVENT
 /end IF_DATA
/end MEASUREMENT
/begin GROUP joints_cmd.15.wbc_arml6 ""
 /begin REF_MEASUREMENT wbc_arml6.15.pos_cmd wbc_arml6.15.vel_cmd wbc_arml6.15.torque_cmd wbc_arml6.15.current_cmd wbc_arml6.15.velocity wbc_arml6.15.max_velocity wbc_arml6.15.acceleration wbc_arml6.15.deceleration wbc_arml6.15.KP wbc_arml6.15.KD wbc_arml6.15.enable wbc_arml6.15.operation_mode wbc_arml6.15.polarity /end REF_MEASUREMENT
/end GROUP
/begin COMPU_METHOD wbc_arml6.15.pos_fb_COMPU_METHOD "" LINEAR "%6.3" "" COEFFS_LINEAR 1 0 /end COMPU_METHOD
/begin MEASUREMENT wbc_arml6.15.pos_fb "pos_fb" FLOAT64_IEEE wbc_arml6.15.pos_fb_COMPU_METHOD 0 0 -1E12 1E12 ECU_ADDRESS 0x6FFC8
 /begin IF_DATA XCP
  /begin DAQ_EVENT FIXED_EVENT_LIST EVENT 0x0 /end DAQ_EVENT
 /end IF_DATA
/end MEASUREMENT
/begin COMPU_METHOD wbc_arml6.15.vel_fb_COMPU_METHOD "" LINEAR "%6.3" "" COEFFS_LINEAR 1 0 /end COMPU_METHOD
/begin MEASUREMENT wbc_arml6.15.vel_fb "vel_fb" FLOAT64_IEEE wbc_arml6.15.vel_fb_COMPU_METHOD 0 0 -1E12 1E12 ECU_ADDRESS 0x6FFD0
 /begin IF_DATA XCP
  /begin DAQ_EVENT FIXED_EVENT_LIST EVENT 0x0 /end DAQ_EVENT
 /end IF_DATA
/end MEASUREMENT
/begin COMPU_METHOD wbc_arml6.15.torque_fb_COMPU_METHOD "" LINEAR "%6.3" "" COEFFS_LINEAR 1 0 /end COMPU_METHOD
/begin MEASUREMENT wbc_arml6.15.torque_fb "torque_fb" FLOAT64_IEEE wbc_arml6.15.torque_fb_COMPU_METHOD 0 0 -1E12 1E12 ECU_ADDRESS 0x6FFD8
 /begin IF_DATA XCP
  /begin DAQ_EVENT FIXED_EVENT_LIST EVENT 0x0 /end DAQ_EVENT
 /end IF_DATA
/end MEASUREMENT
/begin COMPU_METHOD wbc_arml6.15.current_fb_COMPU_METHOD "" LINEAR "%6.3" "" COEFFS_LINEAR 1 0 /end COMPU_METHOD
/begin MEASUREMENT wbc_arml6.15.current_fb "current_fb" FLOAT64_IEEE wbc_arml6.15.current_fb_COMPU_METHOD 0 0 -1E12 1E12 ECU_ADDRESS 0x6FFE0
 /begin IF_DATA XCP
  /begin DAQ_EVENT FIXED_EVENT_LIST EVENT 0x0 /end DAQ_EVENT
 /end IF_DATA
/end MEASUREMENT
/begin COMPU_METHOD wbc_arml6.15.motor_temper_COMPU_METHOD "" LINEAR "%6.3" "" COEFFS_LINEAR 1 0 /end COMPU_METHOD
/begin MEASUREMENT wbc_arml6.15.motor_temper "motor_temper" FLOAT64_IEEE wbc_arml6.15.motor_temper_COMPU_METHOD 0 0 -1E12 1E12 ECU_ADDRESS 0x6FFE8
 /begin IF_DATA XCP
  /begin DAQ_EVENT FIXED_EVENT_LIST EVENT 0x0 /end DAQ_EVENT
 /end IF_DATA
/end MEASUREMENT
/begin COMPU_METHOD wbc_arml6.15.min_soft_position_COMPU_METHOD "" LINEAR "%6.3" "" COEFFS_LINEAR 1 0 /end COMPU_METHOD
/begin MEASUREMENT wbc_arml6.15.min_soft_position "min_soft_position_limit" FLOAT64_IEEE wbc_arml6.15.min_soft_position_COMPU_METHOD 0 0 -1E12 1E12 ECU_ADDRESS 0x6FFF0
 /begin IF_DATA XCP
  /begin DAQ_EVENT FIXED_EVENT_LIST EVENT 0x0 /end DAQ_EVENT
 /end IF_DATA
/end MEASUREMENT
/begin COMPU_METHOD wbc_arml6.15.max_soft_position_COMPU_METHOD "" LINEAR "%6.3" "" COEFFS_LINEAR 1 0 /end COMPU_METHOD
/begin MEASUREMENT wbc_arml6.15.max_soft_position "max_soft_position_limit" FLOAT64_IEEE wbc_arml6.15.max_soft_position_COMPU_METHOD 0 0 -1E12 1E12 ECU_ADDRESS 0x6FFF8
 /begin IF_DATA XCP
  /begin DAQ_EVENT FIXED_EVENT_LIST EVENT 0x0 /end DAQ_EVENT
 /end IF_DATA
/end MEASUREMENT
/begin COMPU_METHOD wbc_arml6.15.max_profile_veloc_COMPU_METHOD "" LINEAR "%6.3" "" COEFFS_LINEAR 1 0 /end COMPU_METHOD
/begin MEASUREMENT wbc_arml6.15.max_profile_veloc "max_profile_velocity" FLOAT64_IEEE wbc_arml6.15.max_profile_veloc_COMPU_METHOD 0 0 -1E12 1E12 ECU_ADDRESS 0x70000
 /begin IF_DATA XCP
  /begin DAQ_EVENT FIXED_EVENT_LIST EVENT 0x0 /end DAQ_EVENT
 /end IF_DATA
/end MEASUREMENT
/begin COMPU_METHOD wbc_arml6.15.voltage_COMPU_METHOD "" LINEAR "%6.3" "" COEFFS_LINEAR 1 0 /end COMPU_METHOD
/begin MEASUREMENT wbc_arml6.15.voltage "voltage" FLOAT64_IEEE wbc_arml6.15.voltage_COMPU_METHOD 0 0 -1E12 1E12 ECU_ADDRESS 0x70010
 /begin IF_DATA XCP
  /begin DAQ_EVENT FIXED_EVENT_LIST EVENT 0x0 /end DAQ_EVENT
 /end IF_DATA
/end MEASUREMENT
/begin COMPU_METHOD wbc_arml6.15.enabled_COMPU_METHOD "" LINEAR "%6.3" "" COEFFS_LINEAR 1 0 /end COMPU_METHOD
/begin MEASUREMENT wbc_arml6.15.enabled "enabled" SBYTE wbc_arml6.15.enabled_COMPU_METHOD 0 0 -128 127 ECU_ADDRESS 0x70008
 /begin IF_DATA XCP
  /begin DAQ_EVENT FIXED_EVENT_LIST EVENT 0x0 /end DAQ_EVENT
 /end IF_DATA
/end MEASUREMENT
/begin COMPU_METHOD wbc_arml6.15.error_COMPU_METHOD "" LINEAR "%6.3" "" COEFFS_LINEAR 1 0 /end COMPU_METHOD
/begin MEASUREMENT wbc_arml6.15.error "error" SBYTE wbc_arml6.15.error_COMPU_METHOD 0 0 -128 127 ECU_ADDRESS 0x70009
 /begin IF_DATA XCP
  /begin DAQ_EVENT FIXED_EVENT_LIST EVENT 0x0 /end DAQ_EVENT
 /end IF_DATA
/end MEASUREMENT
/begin COMPU_METHOD wbc_arml6.15.operation_mode_di_COMPU_METHOD "" LINEAR "%6.3" "" COEFFS_LINEAR 1 0 /end COMPU_METHOD
/begin MEASUREMENT wbc_arml6.15.operation_mode_di "operation_mode_display" SBYTE wbc_arml6.15.operation_mode_di_COMPU_METHOD 0 0 -128 127 ECU_ADDRESS 0x7000A
 /begin IF_DATA XCP
  /begin DAQ_EVENT FIXED_EVENT_LIST EVENT 0x0 /end DAQ_EVENT
 /end IF_DATA
/end MEASUREMENT
/begin GROUP joints_status.15.wbc_arml6 ""
 /begin REF_MEASUREMENT wbc_arml6.15.pos_fb wbc_arml6.15.vel_fb wbc_arml6.15.torque_fb wbc_arml6.15.current_fb wbc_arml6.15.motor_temper wbc_arml6.15.min_soft_position wbc_arml6.15.max_soft_position wbc_arml6.15.max_profile_veloc wbc_arml6.15.voltage wbc_arml6.15.enabled wbc_arml6.15.error wbc_arml6.15.operation_mode_di /end REF_MEASUREMENT
/end GROUP
/begin COMPU_METHOD wbc_arml7.16.pos_cmd_COMPU_METHOD "" LINEAR "%6.3" "" COEFFS_LINEAR 1 0 /end COMPU_METHOD
/begin MEASUREMENT wbc_arml7.16.pos_cmd "pos_cmd" FLOAT64_IEEE wbc_arml7.16.pos_cmd_COMPU_METHOD 0 0 -1E12 1E12 ECU_ADDRESS 0x70F00
 /begin IF_DATA XCP
  /begin DAQ_EVENT FIXED_EVENT_LIST EVENT 0x0 /end DAQ_EVENT
 /end IF_DATA
/end MEASUREMENT
/begin COMPU_METHOD wbc_arml7.16.vel_cmd_COMPU_METHOD "" LINEAR "%6.3" "" COEFFS_LINEAR 1 0 /end COMPU_METHOD
/begin MEASUREMENT wbc_arml7.16.vel_cmd "vel_cmd" FLOAT64_IEEE wbc_arml7.16.vel_cmd_COMPU_METHOD 0 0 -1E12 1E12 ECU_ADDRESS 0x70F08
 /begin IF_DATA XCP
  /begin DAQ_EVENT FIXED_EVENT_LIST EVENT 0x0 /end DAQ_EVENT
 /end IF_DATA
/end MEASUREMENT
/begin COMPU_METHOD wbc_arml7.16.torque_cmd_COMPU_METHOD "" LINEAR "%6.3" "" COEFFS_LINEAR 1 0 /end COMPU_METHOD
/begin MEASUREMENT wbc_arml7.16.torque_cmd "torque_cmd" FLOAT64_IEEE wbc_arml7.16.torque_cmd_COMPU_METHOD 0 0 -1E12 1E12 ECU_ADDRESS 0x70F10
 /begin IF_DATA XCP
  /begin DAQ_EVENT FIXED_EVENT_LIST EVENT 0x0 /end DAQ_EVENT
 /end IF_DATA
/end MEASUREMENT
/begin COMPU_METHOD wbc_arml7.16.current_cmd_COMPU_METHOD "" LINEAR "%6.3" "" COEFFS_LINEAR 1 0 /end COMPU_METHOD
/begin MEASUREMENT wbc_arml7.16.current_cmd "current_cmd" FLOAT64_IEEE wbc_arml7.16.current_cmd_COMPU_METHOD 0 0 -1E12 1E12 ECU_ADDRESS 0x70F18
 /begin IF_DATA XCP
  /begin DAQ_EVENT FIXED_EVENT_LIST EVENT 0x0 /end DAQ_EVENT
 /end IF_DATA
/end MEASUREMENT
/begin COMPU_METHOD wbc_arml7.16.velocity_COMPU_METHOD "" LINEAR "%6.3" "" COEFFS_LINEAR 1 0 /end COMPU_METHOD
/begin MEASUREMENT wbc_arml7.16.velocity "velocity" FLOAT64_IEEE wbc_arml7.16.velocity_COMPU_METHOD 0 0 -1E12 1E12 ECU_ADDRESS 0x70F20
 /begin IF_DATA XCP
  /begin DAQ_EVENT FIXED_EVENT_LIST EVENT 0x0 /end DAQ_EVENT
 /end IF_DATA
/end MEASUREMENT
/begin COMPU_METHOD wbc_arml7.16.max_velocity_COMPU_METHOD "" LINEAR "%6.3" "" COEFFS_LINEAR 1 0 /end COMPU_METHOD
/begin MEASUREMENT wbc_arml7.16.max_velocity "max_velocity" FLOAT64_IEEE wbc_arml7.16.max_velocity_COMPU_METHOD 0 0 -1E12 1E12 ECU_ADDRESS 0x70F28
 /begin IF_DATA XCP
  /begin DAQ_EVENT FIXED_EVENT_LIST EVENT 0x0 /end DAQ_EVENT
 /end IF_DATA
/end MEASUREMENT
/begin COMPU_METHOD wbc_arml7.16.acceleration_COMPU_METHOD "" LINEAR "%6.3" "" COEFFS_LINEAR 1 0 /end COMPU_METHOD
/begin MEASUREMENT wbc_arml7.16.acceleration "acceleration" FLOAT64_IEEE wbc_arml7.16.acceleration_COMPU_METHOD 0 0 -1E12 1E12 ECU_ADDRESS 0x70F30
 /begin IF_DATA XCP
  /begin DAQ_EVENT FIXED_EVENT_LIST EVENT 0x0 /end DAQ_EVENT
 /end IF_DATA
/end MEASUREMENT
/begin COMPU_METHOD wbc_arml7.16.deceleration_COMPU_METHOD "" LINEAR "%6.3" "" COEFFS_LINEAR 1 0 /end COMPU_METHOD
/begin MEASUREMENT wbc_arml7.16.deceleration "deceleration" FLOAT64_IEEE wbc_arml7.16.deceleration_COMPU_METHOD 0 0 -1E12 1E12 ECU_ADDRESS 0x70F38
 /begin IF_DATA XCP
  /begin DAQ_EVENT FIXED_EVENT_LIST EVENT 0x0 /end DAQ_EVENT
 /end IF_DATA
/end MEASUREMENT
/begin COMPU_METHOD wbc_arml7.16.KP_COMPU_METHOD "" LINEAR "%6.3" "" COEFFS_LINEAR 1 0 /end COMPU_METHOD
/begin MEASUREMENT wbc_arml7.16.KP "KP" FLOAT64_IEEE wbc_arml7.16.KP_COMPU_METHOD 0 0 -1E12 1E12 ECU_ADDRESS 0x70F40
 /begin IF_DATA XCP
  /begin DAQ_EVENT FIXED_EVENT_LIST EVENT 0x0 /end DAQ_EVENT
 /end IF_DATA
/end MEASUREMENT
/begin COMPU_METHOD wbc_arml7.16.KD_COMPU_METHOD "" LINEAR "%6.3" "" COEFFS_LINEAR 1 0 /end COMPU_METHOD
/begin MEASUREMENT wbc_arml7.16.KD "KD" FLOAT64_IEEE wbc_arml7.16.KD_COMPU_METHOD 0 0 -1E12 1E12 ECU_ADDRESS 0x70F48
 /begin IF_DATA XCP
  /begin DAQ_EVENT FIXED_EVENT_LIST EVENT 0x0 /end DAQ_EVENT
 /end IF_DATA
/end MEASUREMENT
/begin COMPU_METHOD wbc_arml7.16.enable_COMPU_METHOD "" LINEAR "%6.3" "" COEFFS_LINEAR 1 0 /end COMPU_METHOD
/begin MEASUREMENT wbc_arml7.16.enable "enable" SBYTE wbc_arml7.16.enable_COMPU_METHOD 0 0 -128 127 ECU_ADDRESS 0x70F50
 /begin IF_DATA XCP
  /begin DAQ_EVENT FIXED_EVENT_LIST EVENT 0x0 /end DAQ_EVENT
 /end IF_DATA
/end MEASUREMENT
/begin COMPU_METHOD wbc_arml7.16.operation_mode_COMPU_METHOD "" LINEAR "%6.3" "" COEFFS_LINEAR 1 0 /end COMPU_METHOD
/begin MEASUREMENT wbc_arml7.16.operation_mode "operation_mode" SBYTE wbc_arml7.16.operation_mode_COMPU_METHOD 0 0 -128 127 ECU_ADDRESS 0x70F51
 /begin IF_DATA XCP
  /begin DAQ_EVENT FIXED_EVENT_LIST EVENT 0x0 /end DAQ_EVENT
 /end IF_DATA
/end MEASUREMENT
/begin COMPU_METHOD wbc_arml7.16.polarity_COMPU_METHOD "" LINEAR "%6.3" "" COEFFS_LINEAR 1 0 /end COMPU_METHOD
/begin MEASUREMENT wbc_arml7.16.polarity "polarity" UBYTE wbc_arml7.16.polarity_COMPU_METHOD 0 0 0 255 ECU_ADDRESS 0x70F52
 /begin IF_DATA XCP
  /begin DAQ_EVENT FIXED_EVENT_LIST EVENT 0x0 /end DAQ_EVENT
 /end IF_DATA
/end MEASUREMENT
/begin GROUP joints_cmd.16.wbc_arml7 ""
 /begin REF_MEASUREMENT wbc_arml7.16.pos_cmd wbc_arml7.16.vel_cmd wbc_arml7.16.torque_cmd wbc_arml7.16.current_cmd wbc_arml7.16.velocity wbc_arml7.16.max_velocity wbc_arml7.16.acceleration wbc_arml7.16.deceleration wbc_arml7.16.KP wbc_arml7.16.KD wbc_arml7.16.enable wbc_arml7.16.operation_mode wbc_arml7.16.polarity /end REF_MEASUREMENT
/end GROUP
/begin COMPU_METHOD wbc_arml7.16.pos_fb_COMPU_METHOD "" LINEAR "%6.3" "" COEFFS_LINEAR 1 0 /end COMPU_METHOD
/begin MEASUREMENT wbc_arml7.16.pos_fb "pos_fb" FLOAT64_IEEE wbc_arml7.16.pos_fb_COMPU_METHOD 0 0 -1E12 1E12 ECU_ADDRESS 0x70018
 /begin IF_DATA XCP
  /begin DAQ_EVENT FIXED_EVENT_LIST EVENT 0x0 /end DAQ_EVENT
 /end IF_DATA
/end MEASUREMENT
/begin COMPU_METHOD wbc_arml7.16.vel_fb_COMPU_METHOD "" LINEAR "%6.3" "" COEFFS_LINEAR 1 0 /end COMPU_METHOD
/begin MEASUREMENT wbc_arml7.16.vel_fb "vel_fb" FLOAT64_IEEE wbc_arml7.16.vel_fb_COMPU_METHOD 0 0 -1E12 1E12 ECU_ADDRESS 0x70020
 /begin IF_DATA XCP
  /begin DAQ_EVENT FIXED_EVENT_LIST EVENT 0x0 /end DAQ_EVENT
 /end IF_DATA
/end MEASUREMENT
/begin COMPU_METHOD wbc_arml7.16.torque_fb_COMPU_METHOD "" LINEAR "%6.3" "" COEFFS_LINEAR 1 0 /end COMPU_METHOD
/begin MEASUREMENT wbc_arml7.16.torque_fb "torque_fb" FLOAT64_IEEE wbc_arml7.16.torque_fb_COMPU_METHOD 0 0 -1E12 1E12 ECU_ADDRESS 0x70028
 /begin IF_DATA XCP
  /begin DAQ_EVENT FIXED_EVENT_LIST EVENT 0x0 /end DAQ_EVENT
 /end IF_DATA
/end MEASUREMENT
/begin COMPU_METHOD wbc_arml7.16.current_fb_COMPU_METHOD "" LINEAR "%6.3" "" COEFFS_LINEAR 1 0 /end COMPU_METHOD
/begin MEASUREMENT wbc_arml7.16.current_fb "current_fb" FLOAT64_IEEE wbc_arml7.16.current_fb_COMPU_METHOD 0 0 -1E12 1E12 ECU_ADDRESS 0x70030
 /begin IF_DATA XCP
  /begin DAQ_EVENT FIXED_EVENT_LIST EVENT 0x0 /end DAQ_EVENT
 /end IF_DATA
/end MEASUREMENT
/begin COMPU_METHOD wbc_arml7.16.motor_temper_COMPU_METHOD "" LINEAR "%6.3" "" COEFFS_LINEAR 1 0 /end COMPU_METHOD
/begin MEASUREMENT wbc_arml7.16.motor_temper "motor_temper" FLOAT64_IEEE wbc_arml7.16.motor_temper_COMPU_METHOD 0 0 -1E12 1E12 ECU_ADDRESS 0x70038
 /begin IF_DATA XCP
  /begin DAQ_EVENT FIXED_EVENT_LIST EVENT 0x0 /end DAQ_EVENT
 /end IF_DATA
/end MEASUREMENT
/begin COMPU_METHOD wbc_arml7.16.min_soft_position_COMPU_METHOD "" LINEAR "%6.3" "" COEFFS_LINEAR 1 0 /end COMPU_METHOD
/begin MEASUREMENT wbc_arml7.16.min_soft_position "min_soft_position_limit" FLOAT64_IEEE wbc_arml7.16.min_soft_position_COMPU_METHOD 0 0 -1E12 1E12 ECU_ADDRESS 0x70040
 /begin IF_DATA XCP
  /begin DAQ_EVENT FIXED_EVENT_LIST EVENT 0x0 /end DAQ_EVENT
 /end IF_DATA
/end MEASUREMENT
/begin COMPU_METHOD wbc_arml7.16.max_soft_position_COMPU_METHOD "" LINEAR "%6.3" "" COEFFS_LINEAR 1 0 /end COMPU_METHOD
/begin MEASUREMENT wbc_arml7.16.max_soft_position "max_soft_position_limit" FLOAT64_IEEE wbc_arml7.16.max_soft_position_COMPU_METHOD 0 0 -1E12 1E12 ECU_ADDRESS 0x70048
 /begin IF_DATA XCP
  /begin DAQ_EVENT FIXED_EVENT_LIST EVENT 0x0 /end DAQ_EVENT
 /end IF_DATA
/end MEASUREMENT
/begin COMPU_METHOD wbc_arml7.16.max_profile_veloc_COMPU_METHOD "" LINEAR "%6.3" "" COEFFS_LINEAR 1 0 /end COMPU_METHOD
/begin MEASUREMENT wbc_arml7.16.max_profile_veloc "max_profile_velocity" FLOAT64_IEEE wbc_arml7.16.max_profile_veloc_COMPU_METHOD 0 0 -1E12 1E12 ECU_ADDRESS 0x70050
 /begin IF_DATA XCP
  /begin DAQ_EVENT FIXED_EVENT_LIST EVENT 0x0 /end DAQ_EVENT
 /end IF_DATA
/end MEASUREMENT
/begin COMPU_METHOD wbc_arml7.16.voltage_COMPU_METHOD "" LINEAR "%6.3" "" COEFFS_LINEAR 1 0 /end COMPU_METHOD
/begin MEASUREMENT wbc_arml7.16.voltage "voltage" FLOAT64_IEEE wbc_arml7.16.voltage_COMPU_METHOD 0 0 -1E12 1E12 ECU_ADDRESS 0x70060
 /begin IF_DATA XCP
  /begin DAQ_EVENT FIXED_EVENT_LIST EVENT 0x0 /end DAQ_EVENT
 /end IF_DATA
/end MEASUREMENT
/begin COMPU_METHOD wbc_arml7.16.enabled_COMPU_METHOD "" LINEAR "%6.3" "" COEFFS_LINEAR 1 0 /end COMPU_METHOD
/begin MEASUREMENT wbc_arml7.16.enabled "enabled" SBYTE wbc_arml7.16.enabled_COMPU_METHOD 0 0 -128 127 ECU_ADDRESS 0x70058
 /begin IF_DATA XCP
  /begin DAQ_EVENT FIXED_EVENT_LIST EVENT 0x0 /end DAQ_EVENT
 /end IF_DATA
/end MEASUREMENT
/begin COMPU_METHOD wbc_arml7.16.error_COMPU_METHOD "" LINEAR "%6.3" "" COEFFS_LINEAR 1 0 /end COMPU_METHOD
/begin MEASUREMENT wbc_arml7.16.error "error" SBYTE wbc_arml7.16.error_COMPU_METHOD 0 0 -128 127 ECU_ADDRESS 0x70059
 /begin IF_DATA XCP
  /begin DAQ_EVENT FIXED_EVENT_LIST EVENT 0x0 /end DAQ_EVENT
 /end IF_DATA
/end MEASUREMENT
/begin COMPU_METHOD wbc_arml7.16.operation_mode_di_COMPU_METHOD "" LINEAR "%6.3" "" COEFFS_LINEAR 1 0 /end COMPU_METHOD
/begin MEASUREMENT wbc_arml7.16.operation_mode_di "operation_mode_display" SBYTE wbc_arml7.16.operation_mode_di_COMPU_METHOD 0 0 -128 127 ECU_ADDRESS 0x7005A
 /begin IF_DATA XCP
  /begin DAQ_EVENT FIXED_EVENT_LIST EVENT 0x0 /end DAQ_EVENT
 /end IF_DATA
/end MEASUREMENT
/begin GROUP joints_status.16.wbc_arml7 ""
 /begin REF_MEASUREMENT wbc_arml7.16.pos_fb wbc_arml7.16.vel_fb wbc_arml7.16.torque_fb wbc_arml7.16.current_fb wbc_arml7.16.motor_temper wbc_arml7.16.min_soft_position wbc_arml7.16.max_soft_position wbc_arml7.16.max_profile_veloc wbc_arml7.16.voltage wbc_arml7.16.enabled wbc_arml7.16.error wbc_arml7.16.operation_mode_di /end REF_MEASUREMENT
/end GROUP
/begin COMPU_METHOD wbc_armr1.17.pos_cmd_COMPU_METHOD "" LINEAR "%6.3" "" COEFFS_LINEAR 1 0 /end COMPU_METHOD
/begin MEASUREMENT wbc_armr1.17.pos_cmd "pos_cmd" FLOAT64_IEEE wbc_armr1.17.pos_cmd_COMPU_METHOD 0 0 -1E12 1E12 ECU_ADDRESS 0x70F58
 /begin IF_DATA XCP
  /begin DAQ_EVENT FIXED_EVENT_LIST EVENT 0x0 /end DAQ_EVENT
 /end IF_DATA
/end MEASUREMENT
/begin COMPU_METHOD wbc_armr1.17.vel_cmd_COMPU_METHOD "" LINEAR "%6.3" "" COEFFS_LINEAR 1 0 /end COMPU_METHOD
/begin MEASUREMENT wbc_armr1.17.vel_cmd "vel_cmd" FLOAT64_IEEE wbc_armr1.17.vel_cmd_COMPU_METHOD 0 0 -1E12 1E12 ECU_ADDRESS 0x70F60
 /begin IF_DATA XCP
  /begin DAQ_EVENT FIXED_EVENT_LIST EVENT 0x0 /end DAQ_EVENT
 /end IF_DATA
/end MEASUREMENT
/begin COMPU_METHOD wbc_armr1.17.torque_cmd_COMPU_METHOD "" LINEAR "%6.3" "" COEFFS_LINEAR 1 0 /end COMPU_METHOD
/begin MEASUREMENT wbc_armr1.17.torque_cmd "torque_cmd" FLOAT64_IEEE wbc_armr1.17.torque_cmd_COMPU_METHOD 0 0 -1E12 1E12 ECU_ADDRESS 0x70F68
 /begin IF_DATA XCP
  /begin DAQ_EVENT FIXED_EVENT_LIST EVENT 0x0 /end DAQ_EVENT
 /end IF_DATA
/end MEASUREMENT
/begin COMPU_METHOD wbc_armr1.17.current_cmd_COMPU_METHOD "" LINEAR "%6.3" "" COEFFS_LINEAR 1 0 /end COMPU_METHOD
/begin MEASUREMENT wbc_armr1.17.current_cmd "current_cmd" FLOAT64_IEEE wbc_armr1.17.current_cmd_COMPU_METHOD 0 0 -1E12 1E12 ECU_ADDRESS 0x70F70
 /begin IF_DATA XCP
  /begin DAQ_EVENT FIXED_EVENT_LIST EVENT 0x0 /end DAQ_EVENT
 /end IF_DATA
/end MEASUREMENT
/begin COMPU_METHOD wbc_armr1.17.velocity_COMPU_METHOD "" LINEAR "%6.3" "" COEFFS_LINEAR 1 0 /end COMPU_METHOD
/begin MEASUREMENT wbc_armr1.17.velocity "velocity" FLOAT64_IEEE wbc_armr1.17.velocity_COMPU_METHOD 0 0 -1E12 1E12 ECU_ADDRESS 0x70F78
 /begin IF_DATA XCP
  /begin DAQ_EVENT FIXED_EVENT_LIST EVENT 0x0 /end DAQ_EVENT
 /end IF_DATA
/end MEASUREMENT
/begin COMPU_METHOD wbc_armr1.17.max_velocity_COMPU_METHOD "" LINEAR "%6.3" "" COEFFS_LINEAR 1 0 /end COMPU_METHOD
/begin MEASUREMENT wbc_armr1.17.max_velocity "max_velocity" FLOAT64_IEEE wbc_armr1.17.max_velocity_COMPU_METHOD 0 0 -1E12 1E12 ECU_ADDRESS 0x70F80
 /begin IF_DATA XCP
  /begin DAQ_EVENT FIXED_EVENT_LIST EVENT 0x0 /end DAQ_EVENT
 /end IF_DATA
/end MEASUREMENT
/begin COMPU_METHOD wbc_armr1.17.acceleration_COMPU_METHOD "" LINEAR "%6.3" "" COEFFS_LINEAR 1 0 /end COMPU_METHOD
/begin MEASUREMENT wbc_armr1.17.acceleration "acceleration" FLOAT64_IEEE wbc_armr1.17.acceleration_COMPU_METHOD 0 0 -1E12 1E12 ECU_ADDRESS 0x70F88
 /begin IF_DATA XCP
  /begin DAQ_EVENT FIXED_EVENT_LIST EVENT 0x0 /end DAQ_EVENT
 /end IF_DATA
/end MEASUREMENT
/begin COMPU_METHOD wbc_armr1.17.deceleration_COMPU_METHOD "" LINEAR "%6.3" "" COEFFS_LINEAR 1 0 /end COMPU_METHOD
/begin MEASUREMENT wbc_armr1.17.deceleration "deceleration" FLOAT64_IEEE wbc_armr1.17.deceleration_COMPU_METHOD 0 0 -1E12 1E12 ECU_ADDRESS 0x70F90
 /begin IF_DATA XCP
  /begin DAQ_EVENT FIXED_EVENT_LIST EVENT 0x0 /end DAQ_EVENT
 /end IF_DATA
/end MEASUREMENT
/begin COMPU_METHOD wbc_armr1.17.KP_COMPU_METHOD "" LINEAR "%6.3" "" COEFFS_LINEAR 1 0 /end COMPU_METHOD
/begin MEASUREMENT wbc_armr1.17.KP "KP" FLOAT64_IEEE wbc_armr1.17.KP_COMPU_METHOD 0 0 -1E12 1E12 ECU_ADDRESS 0x70F98
 /begin IF_DATA XCP
  /begin DAQ_EVENT FIXED_EVENT_LIST EVENT 0x0 /end DAQ_EVENT
 /end IF_DATA
/end MEASUREMENT
/begin COMPU_METHOD wbc_armr1.17.KD_COMPU_METHOD "" LINEAR "%6.3" "" COEFFS_LINEAR 1 0 /end COMPU_METHOD
/begin MEASUREMENT wbc_armr1.17.KD "KD" FLOAT64_IEEE wbc_armr1.17.KD_COMPU_METHOD 0 0 -1E12 1E12 ECU_ADDRESS 0x70FA0
 /begin IF_DATA XCP
  /begin DAQ_EVENT FIXED_EVENT_LIST EVENT 0x0 /end DAQ_EVENT
 /end IF_DATA
/end MEASUREMENT
/begin COMPU_METHOD wbc_armr1.17.enable_COMPU_METHOD "" LINEAR "%6.3" "" COEFFS_LINEAR 1 0 /end COMPU_METHOD
/begin MEASUREMENT wbc_armr1.17.enable "enable" SBYTE wbc_armr1.17.enable_COMPU_METHOD 0 0 -128 127 ECU_ADDRESS 0x70FA8
 /begin IF_DATA XCP
  /begin DAQ_EVENT FIXED_EVENT_LIST EVENT 0x0 /end DAQ_EVENT
 /end IF_DATA
/end MEASUREMENT
/begin COMPU_METHOD wbc_armr1.17.operation_mode_COMPU_METHOD "" LINEAR "%6.3" "" COEFFS_LINEAR 1 0 /end COMPU_METHOD
/begin MEASUREMENT wbc_armr1.17.operation_mode "operation_mode" SBYTE wbc_armr1.17.operation_mode_COMPU_METHOD 0 0 -128 127 ECU_ADDRESS 0x70FA9
 /begin IF_DATA XCP
  /begin DAQ_EVENT FIXED_EVENT_LIST EVENT 0x0 /end DAQ_EVENT
 /end IF_DATA
/end MEASUREMENT
/begin COMPU_METHOD wbc_armr1.17.polarity_COMPU_METHOD "" LINEAR "%6.3" "" COEFFS_LINEAR 1 0 /end COMPU_METHOD
/begin MEASUREMENT wbc_armr1.17.polarity "polarity" UBYTE wbc_armr1.17.polarity_COMPU_METHOD 0 0 0 255 ECU_ADDRESS 0x70FAA
 /begin IF_DATA XCP
  /begin DAQ_EVENT FIXED_EVENT_LIST EVENT 0x0 /end DAQ_EVENT
 /end IF_DATA
/end MEASUREMENT
/begin GROUP joints_cmd.17.wbc_armr1 ""
 /begin REF_MEASUREMENT wbc_armr1.17.pos_cmd wbc_armr1.17.vel_cmd wbc_armr1.17.torque_cmd wbc_armr1.17.current_cmd wbc_armr1.17.velocity wbc_armr1.17.max_velocity wbc_armr1.17.acceleration wbc_armr1.17.deceleration wbc_armr1.17.KP wbc_armr1.17.KD wbc_armr1.17.enable wbc_armr1.17.operation_mode wbc_armr1.17.polarity /end REF_MEASUREMENT
/end GROUP
/begin COMPU_METHOD wbc_armr1.17.pos_fb_COMPU_METHOD "" LINEAR "%6.3" "" COEFFS_LINEAR 1 0 /end COMPU_METHOD
/begin MEASUREMENT wbc_armr1.17.pos_fb "pos_fb" FLOAT64_IEEE wbc_armr1.17.pos_fb_COMPU_METHOD 0 0 -1E12 1E12 ECU_ADDRESS 0x70068
 /begin IF_DATA XCP
  /begin DAQ_EVENT FIXED_EVENT_LIST EVENT 0x0 /end DAQ_EVENT
 /end IF_DATA
/end MEASUREMENT
/begin COMPU_METHOD wbc_armr1.17.vel_fb_COMPU_METHOD "" LINEAR "%6.3" "" COEFFS_LINEAR 1 0 /end COMPU_METHOD
/begin MEASUREMENT wbc_armr1.17.vel_fb "vel_fb" FLOAT64_IEEE wbc_armr1.17.vel_fb_COMPU_METHOD 0 0 -1E12 1E12 ECU_ADDRESS 0x70070
 /begin IF_DATA XCP
  /begin DAQ_EVENT FIXED_EVENT_LIST EVENT 0x0 /end DAQ_EVENT
 /end IF_DATA
/end MEASUREMENT
/begin COMPU_METHOD wbc_armr1.17.torque_fb_COMPU_METHOD "" LINEAR "%6.3" "" COEFFS_LINEAR 1 0 /end COMPU_METHOD
/begin MEASUREMENT wbc_armr1.17.torque_fb "torque_fb" FLOAT64_IEEE wbc_armr1.17.torque_fb_COMPU_METHOD 0 0 -1E12 1E12 ECU_ADDRESS 0x70078
 /begin IF_DATA XCP
  /begin DAQ_EVENT FIXED_EVENT_LIST EVENT 0x0 /end DAQ_EVENT
 /end IF_DATA
/end MEASUREMENT
/begin COMPU_METHOD wbc_armr1.17.current_fb_COMPU_METHOD "" LINEAR "%6.3" "" COEFFS_LINEAR 1 0 /end COMPU_METHOD
/begin MEASUREMENT wbc_armr1.17.current_fb "current_fb" FLOAT64_IEEE wbc_armr1.17.current_fb_COMPU_METHOD 0 0 -1E12 1E12 ECU_ADDRESS 0x70080
 /begin IF_DATA XCP
  /begin DAQ_EVENT FIXED_EVENT_LIST EVENT 0x0 /end DAQ_EVENT
 /end IF_DATA
/end MEASUREMENT
/begin COMPU_METHOD wbc_armr1.17.motor_temper_COMPU_METHOD "" LINEAR "%6.3" "" COEFFS_LINEAR 1 0 /end COMPU_METHOD
/begin MEASUREMENT wbc_armr1.17.motor_temper "motor_temper" FLOAT64_IEEE wbc_armr1.17.motor_temper_COMPU_METHOD 0 0 -1E12 1E12 ECU_ADDRESS 0x70088
 /begin IF_DATA XCP
  /begin DAQ_EVENT FIXED_EVENT_LIST EVENT 0x0 /end DAQ_EVENT
 /end IF_DATA
/end MEASUREMENT
/begin COMPU_METHOD wbc_armr1.17.min_soft_position_COMPU_METHOD "" LINEAR "%6.3" "" COEFFS_LINEAR 1 0 /end COMPU_METHOD
/begin MEASUREMENT wbc_armr1.17.min_soft_position "min_soft_position_limit" FLOAT64_IEEE wbc_armr1.17.min_soft_position_COMPU_METHOD 0 0 -1E12 1E12 ECU_ADDRESS 0x70090
 /begin IF_DATA XCP
  /begin DAQ_EVENT FIXED_EVENT_LIST EVENT 0x0 /end DAQ_EVENT
 /end IF_DATA
/end MEASUREMENT
/begin COMPU_METHOD wbc_armr1.17.max_soft_position_COMPU_METHOD "" LINEAR "%6.3" "" COEFFS_LINEAR 1 0 /end COMPU_METHOD
/begin MEASUREMENT wbc_armr1.17.max_soft_position "max_soft_position_limit" FLOAT64_IEEE wbc_armr1.17.max_soft_position_COMPU_METHOD 0 0 -1E12 1E12 ECU_ADDRESS 0x70098
 /begin IF_DATA XCP
  /begin DAQ_EVENT FIXED_EVENT_LIST EVENT 0x0 /end DAQ_EVENT
 /end IF_DATA
/end MEASUREMENT
/begin COMPU_METHOD wbc_armr1.17.max_profile_veloc_COMPU_METHOD "" LINEAR "%6.3" "" COEFFS_LINEAR 1 0 /end COMPU_METHOD
/begin MEASUREMENT wbc_armr1.17.max_profile_veloc "max_profile_velocity" FLOAT64_IEEE wbc_armr1.17.max_profile_veloc_COMPU_METHOD 0 0 -1E12 1E12 ECU_ADDRESS 0x700A0
 /begin IF_DATA XCP
  /begin DAQ_EVENT FIXED_EVENT_LIST EVENT 0x0 /end DAQ_EVENT
 /end IF_DATA
/end MEASUREMENT
/begin COMPU_METHOD wbc_armr1.17.voltage_COMPU_METHOD "" LINEAR "%6.3" "" COEFFS_LINEAR 1 0 /end COMPU_METHOD
/begin MEASUREMENT wbc_armr1.17.voltage "voltage" FLOAT64_IEEE wbc_armr1.17.voltage_COMPU_METHOD 0 0 -1E12 1E12 ECU_ADDRESS 0x700B0
 /begin IF_DATA XCP
  /begin DAQ_EVENT FIXED_EVENT_LIST EVENT 0x0 /end DAQ_EVENT
 /end IF_DATA
/end MEASUREMENT
/begin COMPU_METHOD wbc_armr1.17.enabled_COMPU_METHOD "" LINEAR "%6.3" "" COEFFS_LINEAR 1 0 /end COMPU_METHOD
/begin MEASUREMENT wbc_armr1.17.enabled "enabled" SBYTE wbc_armr1.17.enabled_COMPU_METHOD 0 0 -128 127 ECU_ADDRESS 0x700A8
 /begin IF_DATA XCP
  /begin DAQ_EVENT FIXED_EVENT_LIST EVENT 0x0 /end DAQ_EVENT
 /end IF_DATA
/end MEASUREMENT
/begin COMPU_METHOD wbc_armr1.17.error_COMPU_METHOD "" LINEAR "%6.3" "" COEFFS_LINEAR 1 0 /end COMPU_METHOD
/begin MEASUREMENT wbc_armr1.17.error "error" SBYTE wbc_armr1.17.error_COMPU_METHOD 0 0 -128 127 ECU_ADDRESS 0x700A9
 /begin IF_DATA XCP
  /begin DAQ_EVENT FIXED_EVENT_LIST EVENT 0x0 /end DAQ_EVENT
 /end IF_DATA
/end MEASUREMENT
/begin COMPU_METHOD wbc_armr1.17.operation_mode_di_COMPU_METHOD "" LINEAR "%6.3" "" COEFFS_LINEAR 1 0 /end COMPU_METHOD
/begin MEASUREMENT wbc_armr1.17.operation_mode_di "operation_mode_display" SBYTE wbc_armr1.17.operation_mode_di_COMPU_METHOD 0 0 -128 127 ECU_ADDRESS 0x700AA
 /begin IF_DATA XCP
  /begin DAQ_EVENT FIXED_EVENT_LIST EVENT 0x0 /end DAQ_EVENT
 /end IF_DATA
/end MEASUREMENT
/begin GROUP joints_status.17.wbc_armr1 ""
 /begin REF_MEASUREMENT wbc_armr1.17.pos_fb wbc_armr1.17.vel_fb wbc_armr1.17.torque_fb wbc_armr1.17.current_fb wbc_armr1.17.motor_temper wbc_armr1.17.min_soft_position wbc_armr1.17.max_soft_position wbc_armr1.17.max_profile_veloc wbc_armr1.17.voltage wbc_armr1.17.enabled wbc_armr1.17.error wbc_armr1.17.operation_mode_di /end REF_MEASUREMENT
/end GROUP
/begin COMPU_METHOD wbc_armr2.18.pos_cmd_COMPU_METHOD "" LINEAR "%6.3" "" COEFFS_LINEAR 1 0 /end COMPU_METHOD
/begin MEASUREMENT wbc_armr2.18.pos_cmd "pos_cmd" FLOAT64_IEEE wbc_armr2.18.pos_cmd_COMPU_METHOD 0 0 -1E12 1E12 ECU_ADDRESS 0x70FB0
 /begin IF_DATA XCP
  /begin DAQ_EVENT FIXED_EVENT_LIST EVENT 0x0 /end DAQ_EVENT
 /end IF_DATA
/end MEASUREMENT
/begin COMPU_METHOD wbc_armr2.18.vel_cmd_COMPU_METHOD "" LINEAR "%6.3" "" COEFFS_LINEAR 1 0 /end COMPU_METHOD
/begin MEASUREMENT wbc_armr2.18.vel_cmd "vel_cmd" FLOAT64_IEEE wbc_armr2.18.vel_cmd_COMPU_METHOD 0 0 -1E12 1E12 ECU_ADDRESS 0x70FB8
 /begin IF_DATA XCP
  /begin DAQ_EVENT FIXED_EVENT_LIST EVENT 0x0 /end DAQ_EVENT
 /end IF_DATA
/end MEASUREMENT
/begin COMPU_METHOD wbc_armr2.18.torque_cmd_COMPU_METHOD "" LINEAR "%6.3" "" COEFFS_LINEAR 1 0 /end COMPU_METHOD
/begin MEASUREMENT wbc_armr2.18.torque_cmd "torque_cmd" FLOAT64_IEEE wbc_armr2.18.torque_cmd_COMPU_METHOD 0 0 -1E12 1E12 ECU_ADDRESS 0x70FC0
 /begin IF_DATA XCP
  /begin DAQ_EVENT FIXED_EVENT_LIST EVENT 0x0 /end DAQ_EVENT
 /end IF_DATA
/end MEASUREMENT
/begin COMPU_METHOD wbc_armr2.18.current_cmd_COMPU_METHOD "" LINEAR "%6.3" "" COEFFS_LINEAR 1 0 /end COMPU_METHOD
/begin MEASUREMENT wbc_armr2.18.current_cmd "current_cmd" FLOAT64_IEEE wbc_armr2.18.current_cmd_COMPU_METHOD 0 0 -1E12 1E12 ECU_ADDRESS 0x70FC8
 /begin IF_DATA XCP
  /begin DAQ_EVENT FIXED_EVENT_LIST EVENT 0x0 /end DAQ_EVENT
 /end IF_DATA
/end MEASUREMENT
/begin COMPU_METHOD wbc_armr2.18.velocity_COMPU_METHOD "" LINEAR "%6.3" "" COEFFS_LINEAR 1 0 /end COMPU_METHOD
/begin MEASUREMENT wbc_armr2.18.velocity "velocity" FLOAT64_IEEE wbc_armr2.18.velocity_COMPU_METHOD 0 0 -1E12 1E12 ECU_ADDRESS 0x70FD0
 /begin IF_DATA XCP
  /begin DAQ_EVENT FIXED_EVENT_LIST EVENT 0x0 /end DAQ_EVENT
 /end IF_DATA
/end MEASUREMENT
/begin COMPU_METHOD wbc_armr2.18.max_velocity_COMPU_METHOD "" LINEAR "%6.3" "" COEFFS_LINEAR 1 0 /end COMPU_METHOD
/begin MEASUREMENT wbc_armr2.18.max_velocity "max_velocity" FLOAT64_IEEE wbc_armr2.18.max_velocity_COMPU_METHOD 0 0 -1E12 1E12 ECU_ADDRESS 0x70FD8
 /begin IF_DATA XCP
  /begin DAQ_EVENT FIXED_EVENT_LIST EVENT 0x0 /end DAQ_EVENT
 /end IF_DATA
/end MEASUREMENT
/begin COMPU_METHOD wbc_armr2.18.acceleration_COMPU_METHOD "" LINEAR "%6.3" "" COEFFS_LINEAR 1 0 /end COMPU_METHOD
/begin MEASUREMENT wbc_armr2.18.acceleration "acceleration" FLOAT64_IEEE wbc_armr2.18.acceleration_COMPU_METHOD 0 0 -1E12 1E12 ECU_ADDRESS 0x70FE0
 /begin IF_DATA XCP
  /begin DAQ_EVENT FIXED_EVENT_LIST EVENT 0x0 /end DAQ_EVENT
 /end IF_DATA
/end MEASUREMENT
/begin COMPU_METHOD wbc_armr2.18.deceleration_COMPU_METHOD "" LINEAR "%6.3" "" COEFFS_LINEAR 1 0 /end COMPU_METHOD
/begin MEASUREMENT wbc_armr2.18.deceleration "deceleration" FLOAT64_IEEE wbc_armr2.18.deceleration_COMPU_METHOD 0 0 -1E12 1E12 ECU_ADDRESS 0x70FE8
 /begin IF_DATA XCP
  /begin DAQ_EVENT FIXED_EVENT_LIST EVENT 0x0 /end DAQ_EVENT
 /end IF_DATA
/end MEASUREMENT
/begin COMPU_METHOD wbc_armr2.18.KP_COMPU_METHOD "" LINEAR "%6.3" "" COEFFS_LINEAR 1 0 /end COMPU_METHOD
/begin MEASUREMENT wbc_armr2.18.KP "KP" FLOAT64_IEEE wbc_armr2.18.KP_COMPU_METHOD 0 0 -1E12 1E12 ECU_ADDRESS 0x70FF0
 /begin IF_DATA XCP
  /begin DAQ_EVENT FIXED_EVENT_LIST EVENT 0x0 /end DAQ_EVENT
 /end IF_DATA
/end MEASUREMENT
/begin COMPU_METHOD wbc_armr2.18.KD_COMPU_METHOD "" LINEAR "%6.3" "" COEFFS_LINEAR 1 0 /end COMPU_METHOD
/begin MEASUREMENT wbc_armr2.18.KD "KD" FLOAT64_IEEE wbc_armr2.18.KD_COMPU_METHOD 0 0 -1E12 1E12 ECU_ADDRESS 0x70FF8
 /begin IF_DATA XCP
  /begin DAQ_EVENT FIXED_EVENT_LIST EVENT 0x0 /end DAQ_EVENT
 /end IF_DATA
/end MEASUREMENT
/begin COMPU_METHOD wbc_armr2.18.enable_COMPU_METHOD "" LINEAR "%6.3" "" COEFFS_LINEAR 1 0 /end COMPU_METHOD
/begin MEASUREMENT wbc_armr2.18.enable "enable" SBYTE wbc_armr2.18.enable_COMPU_METHOD 0 0 -128 127 ECU_ADDRESS 0x71000
 /begin IF_DATA XCP
  /begin DAQ_EVENT FIXED_EVENT_LIST EVENT 0x0 /end DAQ_EVENT
 /end IF_DATA
/end MEASUREMENT
/begin COMPU_METHOD wbc_armr2.18.operation_mode_COMPU_METHOD "" LINEAR "%6.3" "" COEFFS_LINEAR 1 0 /end COMPU_METHOD
/begin MEASUREMENT wbc_armr2.18.operation_mode "operation_mode" SBYTE wbc_armr2.18.operation_mode_COMPU_METHOD 0 0 -128 127 ECU_ADDRESS 0x71001
 /begin IF_DATA XCP
  /begin DAQ_EVENT FIXED_EVENT_LIST EVENT 0x0 /end DAQ_EVENT
 /end IF_DATA
/end MEASUREMENT
/begin COMPU_METHOD wbc_armr2.18.polarity_COMPU_METHOD "" LINEAR "%6.3" "" COEFFS_LINEAR 1 0 /end COMPU_METHOD
/begin MEASUREMENT wbc_armr2.18.polarity "polarity" UBYTE wbc_armr2.18.polarity_COMPU_METHOD 0 0 0 255 ECU_ADDRESS 0x71002
 /begin IF_DATA XCP
  /begin DAQ_EVENT FIXED_EVENT_LIST EVENT 0x0 /end DAQ_EVENT
 /end IF_DATA
/end MEASUREMENT
/begin GROUP joints_cmd.18.wbc_armr2 ""
 /begin REF_MEASUREMENT wbc_armr2.18.pos_cmd wbc_armr2.18.vel_cmd wbc_armr2.18.torque_cmd wbc_armr2.18.current_cmd wbc_armr2.18.velocity wbc_armr2.18.max_velocity wbc_armr2.18.acceleration wbc_armr2.18.deceleration wbc_armr2.18.KP wbc_armr2.18.KD wbc_armr2.18.enable wbc_armr2.18.operation_mode wbc_armr2.18.polarity /end REF_MEASUREMENT
/end GROUP
/begin COMPU_METHOD wbc_armr2.18.pos_fb_COMPU_METHOD "" LINEAR "%6.3" "" COEFFS_LINEAR 1 0 /end COMPU_METHOD
/begin MEASUREMENT wbc_armr2.18.pos_fb "pos_fb" FLOAT64_IEEE wbc_armr2.18.pos_fb_COMPU_METHOD 0 0 -1E12 1E12 ECU_ADDRESS 0x700B8
 /begin IF_DATA XCP
  /begin DAQ_EVENT FIXED_EVENT_LIST EVENT 0x0 /end DAQ_EVENT
 /end IF_DATA
/end MEASUREMENT
/begin COMPU_METHOD wbc_armr2.18.vel_fb_COMPU_METHOD "" LINEAR "%6.3" "" COEFFS_LINEAR 1 0 /end COMPU_METHOD
/begin MEASUREMENT wbc_armr2.18.vel_fb "vel_fb" FLOAT64_IEEE wbc_armr2.18.vel_fb_COMPU_METHOD 0 0 -1E12 1E12 ECU_ADDRESS 0x700C0
 /begin IF_DATA XCP
  /begin DAQ_EVENT FIXED_EVENT_LIST EVENT 0x0 /end DAQ_EVENT
 /end IF_DATA
/end MEASUREMENT
/begin COMPU_METHOD wbc_armr2.18.torque_fb_COMPU_METHOD "" LINEAR "%6.3" "" COEFFS_LINEAR 1 0 /end COMPU_METHOD
/begin MEASUREMENT wbc_armr2.18.torque_fb "torque_fb" FLOAT64_IEEE wbc_armr2.18.torque_fb_COMPU_METHOD 0 0 -1E12 1E12 ECU_ADDRESS 0x700C8
 /begin IF_DATA XCP
  /begin DAQ_EVENT FIXED_EVENT_LIST EVENT 0x0 /end DAQ_EVENT
 /end IF_DATA
/end MEASUREMENT
/begin COMPU_METHOD wbc_armr2.18.current_fb_COMPU_METHOD "" LINEAR "%6.3" "" COEFFS_LINEAR 1 0 /end COMPU_METHOD
/begin MEASUREMENT wbc_armr2.18.current_fb "current_fb" FLOAT64_IEEE wbc_armr2.18.current_fb_COMPU_METHOD 0 0 -1E12 1E12 ECU_ADDRESS 0x700D0
 /begin IF_DATA XCP
  /begin DAQ_EVENT FIXED_EVENT_LIST EVENT 0x0 /end DAQ_EVENT
 /end IF_DATA
/end MEASUREMENT
/begin COMPU_METHOD wbc_armr2.18.motor_temper_COMPU_METHOD "" LINEAR "%6.3" "" COEFFS_LINEAR 1 0 /end COMPU_METHOD
/begin MEASUREMENT wbc_armr2.18.motor_temper "motor_temper" FLOAT64_IEEE wbc_armr2.18.motor_temper_COMPU_METHOD 0 0 -1E12 1E12 ECU_ADDRESS 0x700D8
 /begin IF_DATA XCP
  /begin DAQ_EVENT FIXED_EVENT_LIST EVENT 0x0 /end DAQ_EVENT
 /end IF_DATA
/end MEASUREMENT
/begin COMPU_METHOD wbc_armr2.18.min_soft_position_COMPU_METHOD "" LINEAR "%6.3" "" COEFFS_LINEAR 1 0 /end COMPU_METHOD
/begin MEASUREMENT wbc_armr2.18.min_soft_position "min_soft_position_limit" FLOAT64_IEEE wbc_armr2.18.min_soft_position_COMPU_METHOD 0 0 -1E12 1E12 ECU_ADDRESS 0x700E0
 /begin IF_DATA XCP
  /begin DAQ_EVENT FIXED_EVENT_LIST EVENT 0x0 /end DAQ_EVENT
 /end IF_DATA
/end MEASUREMENT
/begin COMPU_METHOD wbc_armr2.18.max_soft_position_COMPU_METHOD "" LINEAR "%6.3" "" COEFFS_LINEAR 1 0 /end COMPU_METHOD
/begin MEASUREMENT wbc_armr2.18.max_soft_position "max_soft_position_limit" FLOAT64_IEEE wbc_armr2.18.max_soft_position_COMPU_METHOD 0 0 -1E12 1E12 ECU_ADDRESS 0x700E8
 /begin IF_DATA XCP
  /begin DAQ_EVENT FIXED_EVENT_LIST EVENT 0x0 /end DAQ_EVENT
 /end IF_DATA
/end MEASUREMENT
/begin COMPU_METHOD wbc_armr2.18.max_profile_veloc_COMPU_METHOD "" LINEAR "%6.3" "" COEFFS_LINEAR 1 0 /end COMPU_METHOD
/begin MEASUREMENT wbc_armr2.18.max_profile_veloc "max_profile_velocity" FLOAT64_IEEE wbc_armr2.18.max_profile_veloc_COMPU_METHOD 0 0 -1E12 1E12 ECU_ADDRESS 0x700F0
 /begin IF_DATA XCP
  /begin DAQ_EVENT FIXED_EVENT_LIST EVENT 0x0 /end DAQ_EVENT
 /end IF_DATA
/end MEASUREMENT
/begin COMPU_METHOD wbc_armr2.18.voltage_COMPU_METHOD "" LINEAR "%6.3" "" COEFFS_LINEAR 1 0 /end COMPU_METHOD
/begin MEASUREMENT wbc_armr2.18.voltage "voltage" FLOAT64_IEEE wbc_armr2.18.voltage_COMPU_METHOD 0 0 -1E12 1E12 ECU_ADDRESS 0x70100
 /begin IF_DATA XCP
  /begin DAQ_EVENT FIXED_EVENT_LIST EVENT 0x0 /end DAQ_EVENT
 /end IF_DATA
/end MEASUREMENT
/begin COMPU_METHOD wbc_armr2.18.enabled_COMPU_METHOD "" LINEAR "%6.3" "" COEFFS_LINEAR 1 0 /end COMPU_METHOD
/begin MEASUREMENT wbc_armr2.18.enabled "enabled" SBYTE wbc_armr2.18.enabled_COMPU_METHOD 0 0 -128 127 ECU_ADDRESS 0x700F8
 /begin IF_DATA XCP
  /begin DAQ_EVENT FIXED_EVENT_LIST EVENT 0x0 /end DAQ_EVENT
 /end IF_DATA
/end MEASUREMENT
/begin COMPU_METHOD wbc_armr2.18.error_COMPU_METHOD "" LINEAR "%6.3" "" COEFFS_LINEAR 1 0 /end COMPU_METHOD
/begin MEASUREMENT wbc_armr2.18.error "error" SBYTE wbc_armr2.18.error_COMPU_METHOD 0 0 -128 127 ECU_ADDRESS 0x700F9
 /begin IF_DATA XCP
  /begin DAQ_EVENT FIXED_EVENT_LIST EVENT 0x0 /end DAQ_EVENT
 /end IF_DATA
/end MEASUREMENT
/begin COMPU_METHOD wbc_armr2.18.operation_mode_di_COMPU_METHOD "" LINEAR "%6.3" "" COEFFS_LINEAR 1 0 /end COMPU_METHOD
/begin MEASUREMENT wbc_armr2.18.operation_mode_di "operation_mode_display" SBYTE wbc_armr2.18.operation_mode_di_COMPU_METHOD 0 0 -128 127 ECU_ADDRESS 0x700FA
 /begin IF_DATA XCP
  /begin DAQ_EVENT FIXED_EVENT_LIST EVENT 0x0 /end DAQ_EVENT
 /end IF_DATA
/end MEASUREMENT
/begin GROUP joints_status.18.wbc_armr2 ""
 /begin REF_MEASUREMENT wbc_armr2.18.pos_fb wbc_armr2.18.vel_fb wbc_armr2.18.torque_fb wbc_armr2.18.current_fb wbc_armr2.18.motor_temper wbc_armr2.18.min_soft_position wbc_armr2.18.max_soft_position wbc_armr2.18.max_profile_veloc wbc_armr2.18.voltage wbc_armr2.18.enabled wbc_armr2.18.error wbc_armr2.18.operation_mode_di /end REF_MEASUREMENT
/end GROUP
/begin COMPU_METHOD wbc_armr3.19.pos_cmd_COMPU_METHOD "" LINEAR "%6.3" "" COEFFS_LINEAR 1 0 /end COMPU_METHOD
/begin MEASUREMENT wbc_armr3.19.pos_cmd "pos_cmd" FLOAT64_IEEE wbc_armr3.19.pos_cmd_COMPU_METHOD 0 0 -1E12 1E12 ECU_ADDRESS 0x71008
 /begin IF_DATA XCP
  /begin DAQ_EVENT FIXED_EVENT_LIST EVENT 0x0 /end DAQ_EVENT
 /end IF_DATA
/end MEASUREMENT
/begin COMPU_METHOD wbc_armr3.19.vel_cmd_COMPU_METHOD "" LINEAR "%6.3" "" COEFFS_LINEAR 1 0 /end COMPU_METHOD
/begin MEASUREMENT wbc_armr3.19.vel_cmd "vel_cmd" FLOAT64_IEEE wbc_armr3.19.vel_cmd_COMPU_METHOD 0 0 -1E12 1E12 ECU_ADDRESS 0x71010
 /begin IF_DATA XCP
  /begin DAQ_EVENT FIXED_EVENT_LIST EVENT 0x0 /end DAQ_EVENT
 /end IF_DATA
/end MEASUREMENT
/begin COMPU_METHOD wbc_armr3.19.torque_cmd_COMPU_METHOD "" LINEAR "%6.3" "" COEFFS_LINEAR 1 0 /end COMPU_METHOD
/begin MEASUREMENT wbc_armr3.19.torque_cmd "torque_cmd" FLOAT64_IEEE wbc_armr3.19.torque_cmd_COMPU_METHOD 0 0 -1E12 1E12 ECU_ADDRESS 0x71018
 /begin IF_DATA XCP
  /begin DAQ_EVENT FIXED_EVENT_LIST EVENT 0x0 /end DAQ_EVENT
 /end IF_DATA
/end MEASUREMENT
/begin COMPU_METHOD wbc_armr3.19.current_cmd_COMPU_METHOD "" LINEAR "%6.3" "" COEFFS_LINEAR 1 0 /end COMPU_METHOD
/begin MEASUREMENT wbc_armr3.19.current_cmd "current_cmd" FLOAT64_IEEE wbc_armr3.19.current_cmd_COMPU_METHOD 0 0 -1E12 1E12 ECU_ADDRESS 0x71020
 /begin IF_DATA XCP
  /begin DAQ_EVENT FIXED_EVENT_LIST EVENT 0x0 /end DAQ_EVENT
 /end IF_DATA
/end MEASUREMENT
/begin COMPU_METHOD wbc_armr3.19.velocity_COMPU_METHOD "" LINEAR "%6.3" "" COEFFS_LINEAR 1 0 /end COMPU_METHOD
/begin MEASUREMENT wbc_armr3.19.velocity "velocity" FLOAT64_IEEE wbc_armr3.19.velocity_COMPU_METHOD 0 0 -1E12 1E12 ECU_ADDRESS 0x71028
 /begin IF_DATA XCP
  /begin DAQ_EVENT FIXED_EVENT_LIST EVENT 0x0 /end DAQ_EVENT
 /end IF_DATA
/end MEASUREMENT
/begin COMPU_METHOD wbc_armr3.19.max_velocity_COMPU_METHOD "" LINEAR "%6.3" "" COEFFS_LINEAR 1 0 /end COMPU_METHOD
/begin MEASUREMENT wbc_armr3.19.max_velocity "max_velocity" FLOAT64_IEEE wbc_armr3.19.max_velocity_COMPU_METHOD 0 0 -1E12 1E12 ECU_ADDRESS 0x71030
 /begin IF_DATA XCP
  /begin DAQ_EVENT FIXED_EVENT_LIST EVENT 0x0 /end DAQ_EVENT
 /end IF_DATA
/end MEASUREMENT
/begin COMPU_METHOD wbc_armr3.19.acceleration_COMPU_METHOD "" LINEAR "%6.3" "" COEFFS_LINEAR 1 0 /end COMPU_METHOD
/begin MEASUREMENT wbc_armr3.19.acceleration "acceleration" FLOAT64_IEEE wbc_armr3.19.acceleration_COMPU_METHOD 0 0 -1E12 1E12 ECU_ADDRESS 0x71038
 /begin IF_DATA XCP
  /begin DAQ_EVENT FIXED_EVENT_LIST EVENT 0x0 /end DAQ_EVENT
 /end IF_DATA
/end MEASUREMENT
/begin COMPU_METHOD wbc_armr3.19.deceleration_COMPU_METHOD "" LINEAR "%6.3" "" COEFFS_LINEAR 1 0 /end COMPU_METHOD
/begin MEASUREMENT wbc_armr3.19.deceleration "deceleration" FLOAT64_IEEE wbc_armr3.19.deceleration_COMPU_METHOD 0 0 -1E12 1E12 ECU_ADDRESS 0x71040
 /begin IF_DATA XCP
  /begin DAQ_EVENT FIXED_EVENT_LIST EVENT 0x0 /end DAQ_EVENT
 /end IF_DATA
/end MEASUREMENT
/begin COMPU_METHOD wbc_armr3.19.KP_COMPU_METHOD "" LINEAR "%6.3" "" COEFFS_LINEAR 1 0 /end COMPU_METHOD
/begin MEASUREMENT wbc_armr3.19.KP "KP" FLOAT64_IEEE wbc_armr3.19.KP_COMPU_METHOD 0 0 -1E12 1E12 ECU_ADDRESS 0x71048
 /begin IF_DATA XCP
  /begin DAQ_EVENT FIXED_EVENT_LIST EVENT 0x0 /end DAQ_EVENT
 /end IF_DATA
/end MEASUREMENT
/begin COMPU_METHOD wbc_armr3.19.KD_COMPU_METHOD "" LINEAR "%6.3" "" COEFFS_LINEAR 1 0 /end COMPU_METHOD
/begin MEASUREMENT wbc_armr3.19.KD "KD" FLOAT64_IEEE wbc_armr3.19.KD_COMPU_METHOD 0 0 -1E12 1E12 ECU_ADDRESS 0x71050
 /begin IF_DATA XCP
  /begin DAQ_EVENT FIXED_EVENT_LIST EVENT 0x0 /end DAQ_EVENT
 /end IF_DATA
/end MEASUREMENT
/begin COMPU_METHOD wbc_armr3.19.enable_COMPU_METHOD "" LINEAR "%6.3" "" COEFFS_LINEAR 1 0 /end COMPU_METHOD
/begin MEASUREMENT wbc_armr3.19.enable "enable" SBYTE wbc_armr3.19.enable_COMPU_METHOD 0 0 -128 127 ECU_ADDRESS 0x71058
 /begin IF_DATA XCP
  /begin DAQ_EVENT FIXED_EVENT_LIST EVENT 0x0 /end DAQ_EVENT
 /end IF_DATA
/end MEASUREMENT
/begin COMPU_METHOD wbc_armr3.19.operation_mode_COMPU_METHOD "" LINEAR "%6.3" "" COEFFS_LINEAR 1 0 /end COMPU_METHOD
/begin MEASUREMENT wbc_armr3.19.operation_mode "operation_mode" SBYTE wbc_armr3.19.operation_mode_COMPU_METHOD 0 0 -128 127 ECU_ADDRESS 0x71059
 /begin IF_DATA XCP
  /begin DAQ_EVENT FIXED_EVENT_LIST EVENT 0x0 /end DAQ_EVENT
 /end IF_DATA
/end MEASUREMENT
/begin COMPU_METHOD wbc_armr3.19.polarity_COMPU_METHOD "" LINEAR "%6.3" "" COEFFS_LINEAR 1 0 /end COMPU_METHOD
/begin MEASUREMENT wbc_armr3.19.polarity "polarity" UBYTE wbc_armr3.19.polarity_COMPU_METHOD 0 0 0 255 ECU_ADDRESS 0x7105A
 /begin IF_DATA XCP
  /begin DAQ_EVENT FIXED_EVENT_LIST EVENT 0x0 /end DAQ_EVENT
 /end IF_DATA
/end MEASUREMENT
/begin GROUP joints_cmd.19.wbc_armr3 ""
 /begin REF_MEASUREMENT wbc_armr3.19.pos_cmd wbc_armr3.19.vel_cmd wbc_armr3.19.torque_cmd wbc_armr3.19.current_cmd wbc_armr3.19.velocity wbc_armr3.19.max_velocity wbc_armr3.19.acceleration wbc_armr3.19.deceleration wbc_armr3.19.KP wbc_armr3.19.KD wbc_armr3.19.enable wbc_armr3.19.operation_mode wbc_armr3.19.polarity /end REF_MEASUREMENT
/end GROUP
/begin COMPU_METHOD wbc_armr3.19.pos_fb_COMPU_METHOD "" LINEAR "%6.3" "" COEFFS_LINEAR 1 0 /end COMPU_METHOD
/begin MEASUREMENT wbc_armr3.19.pos_fb "pos_fb" FLOAT64_IEEE wbc_armr3.19.pos_fb_COMPU_METHOD 0 0 -1E12 1E12 ECU_ADDRESS 0x70108
 /begin IF_DATA XCP
  /begin DAQ_EVENT FIXED_EVENT_LIST EVENT 0x0 /end DAQ_EVENT
 /end IF_DATA
/end MEASUREMENT
/begin COMPU_METHOD wbc_armr3.19.vel_fb_COMPU_METHOD "" LINEAR "%6.3" "" COEFFS_LINEAR 1 0 /end COMPU_METHOD
/begin MEASUREMENT wbc_armr3.19.vel_fb "vel_fb" FLOAT64_IEEE wbc_armr3.19.vel_fb_COMPU_METHOD 0 0 -1E12 1E12 ECU_ADDRESS 0x70110
 /begin IF_DATA XCP
  /begin DAQ_EVENT FIXED_EVENT_LIST EVENT 0x0 /end DAQ_EVENT
 /end IF_DATA
/end MEASUREMENT
/begin COMPU_METHOD wbc_armr3.19.torque_fb_COMPU_METHOD "" LINEAR "%6.3" "" COEFFS_LINEAR 1 0 /end COMPU_METHOD
/begin MEASUREMENT wbc_armr3.19.torque_fb "torque_fb" FLOAT64_IEEE wbc_armr3.19.torque_fb_COMPU_METHOD 0 0 -1E12 1E12 ECU_ADDRESS 0x70118
 /begin IF_DATA XCP
  /begin DAQ_EVENT FIXED_EVENT_LIST EVENT 0x0 /end DAQ_EVENT
 /end IF_DATA
/end MEASUREMENT
/begin COMPU_METHOD wbc_armr3.19.current_fb_COMPU_METHOD "" LINEAR "%6.3" "" COEFFS_LINEAR 1 0 /end COMPU_METHOD
/begin MEASUREMENT wbc_armr3.19.current_fb "current_fb" FLOAT64_IEEE wbc_armr3.19.current_fb_COMPU_METHOD 0 0 -1E12 1E12 ECU_ADDRESS 0x70120
 /begin IF_DATA XCP
  /begin DAQ_EVENT FIXED_EVENT_LIST EVENT 0x0 /end DAQ_EVENT
 /end IF_DATA
/end MEASUREMENT
/begin COMPU_METHOD wbc_armr3.19.motor_temper_COMPU_METHOD "" LINEAR "%6.3" "" COEFFS_LINEAR 1 0 /end COMPU_METHOD
/begin MEASUREMENT wbc_armr3.19.motor_temper "motor_temper" FLOAT64_IEEE wbc_armr3.19.motor_temper_COMPU_METHOD 0 0 -1E12 1E12 ECU_ADDRESS 0x70128
 /begin IF_DATA XCP
  /begin DAQ_EVENT FIXED_EVENT_LIST EVENT 0x0 /end DAQ_EVENT
 /end IF_DATA
/end MEASUREMENT
/begin COMPU_METHOD wbc_armr3.19.min_soft_position_COMPU_METHOD "" LINEAR "%6.3" "" COEFFS_LINEAR 1 0 /end COMPU_METHOD
/begin MEASUREMENT wbc_armr3.19.min_soft_position "min_soft_position_limit" FLOAT64_IEEE wbc_armr3.19.min_soft_position_COMPU_METHOD 0 0 -1E12 1E12 ECU_ADDRESS 0x70130
 /begin IF_DATA XCP
  /begin DAQ_EVENT FIXED_EVENT_LIST EVENT 0x0 /end DAQ_EVENT
 /end IF_DATA
/end MEASUREMENT
/begin COMPU_METHOD wbc_armr3.19.max_soft_position_COMPU_METHOD "" LINEAR "%6.3" "" COEFFS_LINEAR 1 0 /end COMPU_METHOD
/begin MEASUREMENT wbc_armr3.19.max_soft_position "max_soft_position_limit" FLOAT64_IEEE wbc_armr3.19.max_soft_position_COMPU_METHOD 0 0 -1E12 1E12 ECU_ADDRESS 0x70138
 /begin IF_DATA XCP
  /begin DAQ_EVENT FIXED_EVENT_LIST EVENT 0x0 /end DAQ_EVENT
 /end IF_DATA
/end MEASUREMENT
/begin COMPU_METHOD wbc_armr3.19.max_profile_veloc_COMPU_METHOD "" LINEAR "%6.3" "" COEFFS_LINEAR 1 0 /end COMPU_METHOD
/begin MEASUREMENT wbc_armr3.19.max_profile_veloc "max_profile_velocity" FLOAT64_IEEE wbc_armr3.19.max_profile_veloc_COMPU_METHOD 0 0 -1E12 1E12 ECU_ADDRESS 0x70140
 /begin IF_DATA XCP
  /begin DAQ_EVENT FIXED_EVENT_LIST EVENT 0x0 /end DAQ_EVENT
 /end IF_DATA
/end MEASUREMENT
/begin COMPU_METHOD wbc_armr3.19.voltage_COMPU_METHOD "" LINEAR "%6.3" "" COEFFS_LINEAR 1 0 /end COMPU_METHOD
/begin MEASUREMENT wbc_armr3.19.voltage "voltage" FLOAT64_IEEE wbc_armr3.19.voltage_COMPU_METHOD 0 0 -1E12 1E12 ECU_ADDRESS 0x70150
 /begin IF_DATA XCP
  /begin DAQ_EVENT FIXED_EVENT_LIST EVENT 0x0 /end DAQ_EVENT
 /end IF_DATA
/end MEASUREMENT
/begin COMPU_METHOD wbc_armr3.19.enabled_COMPU_METHOD "" LINEAR "%6.3" "" COEFFS_LINEAR 1 0 /end COMPU_METHOD
/begin MEASUREMENT wbc_armr3.19.enabled "enabled" SBYTE wbc_armr3.19.enabled_COMPU_METHOD 0 0 -128 127 ECU_ADDRESS 0x70148
 /begin IF_DATA XCP
  /begin DAQ_EVENT FIXED_EVENT_LIST EVENT 0x0 /end DAQ_EVENT
 /end IF_DATA
/end MEASUREMENT
/begin COMPU_METHOD wbc_armr3.19.error_COMPU_METHOD "" LINEAR "%6.3" "" COEFFS_LINEAR 1 0 /end COMPU_METHOD
/begin MEASUREMENT wbc_armr3.19.error "error" SBYTE wbc_armr3.19.error_COMPU_METHOD 0 0 -128 127 ECU_ADDRESS 0x70149
 /begin IF_DATA XCP
  /begin DAQ_EVENT FIXED_EVENT_LIST EVENT 0x0 /end DAQ_EVENT
 /end IF_DATA
/end MEASUREMENT
/begin COMPU_METHOD wbc_armr3.19.operation_mode_di_COMPU_METHOD "" LINEAR "%6.3" "" COEFFS_LINEAR 1 0 /end COMPU_METHOD
/begin MEASUREMENT wbc_armr3.19.operation_mode_di "operation_mode_display" SBYTE wbc_armr3.19.operation_mode_di_COMPU_METHOD 0 0 -128 127 ECU_ADDRESS 0x7014A
 /begin IF_DATA XCP
  /begin DAQ_EVENT FIXED_EVENT_LIST EVENT 0x0 /end DAQ_EVENT
 /end IF_DATA
/end MEASUREMENT
/begin GROUP joints_status.19.wbc_armr3 ""
 /begin REF_MEASUREMENT wbc_armr3.19.pos_fb wbc_armr3.19.vel_fb wbc_armr3.19.torque_fb wbc_armr3.19.current_fb wbc_armr3.19.motor_temper wbc_armr3.19.min_soft_position wbc_armr3.19.max_soft_position wbc_armr3.19.max_profile_veloc wbc_armr3.19.voltage wbc_armr3.19.enabled wbc_armr3.19.error wbc_armr3.19.operation_mode_di /end REF_MEASUREMENT
/end GROUP
/begin COMPU_METHOD wbc_armr4.20.pos_cmd_COMPU_METHOD "" LINEAR "%6.3" "" COEFFS_LINEAR 1 0 /end COMPU_METHOD
/begin MEASUREMENT wbc_armr4.20.pos_cmd "pos_cmd" FLOAT64_IEEE wbc_armr4.20.pos_cmd_COMPU_METHOD 0 0 -1E12 1E12 ECU_ADDRESS 0x71060
 /begin IF_DATA XCP
  /begin DAQ_EVENT FIXED_EVENT_LIST EVENT 0x0 /end DAQ_EVENT
 /end IF_DATA
/end MEASUREMENT
/begin COMPU_METHOD wbc_armr4.20.vel_cmd_COMPU_METHOD "" LINEAR "%6.3" "" COEFFS_LINEAR 1 0 /end COMPU_METHOD
/begin MEASUREMENT wbc_armr4.20.vel_cmd "vel_cmd" FLOAT64_IEEE wbc_armr4.20.vel_cmd_COMPU_METHOD 0 0 -1E12 1E12 ECU_ADDRESS 0x71068
 /begin IF_DATA XCP
  /begin DAQ_EVENT FIXED_EVENT_LIST EVENT 0x0 /end DAQ_EVENT
 /end IF_DATA
/end MEASUREMENT
/begin COMPU_METHOD wbc_armr4.20.torque_cmd_COMPU_METHOD "" LINEAR "%6.3" "" COEFFS_LINEAR 1 0 /end COMPU_METHOD
/begin MEASUREMENT wbc_armr4.20.torque_cmd "torque_cmd" FLOAT64_IEEE wbc_armr4.20.torque_cmd_COMPU_METHOD 0 0 -1E12 1E12 ECU_ADDRESS 0x71070
 /begin IF_DATA XCP
  /begin DAQ_EVENT FIXED_EVENT_LIST EVENT 0x0 /end DAQ_EVENT
 /end IF_DATA
/end MEASUREMENT
/begin COMPU_METHOD wbc_armr4.20.current_cmd_COMPU_METHOD "" LINEAR "%6.3" "" COEFFS_LINEAR 1 0 /end COMPU_METHOD
/begin MEASUREMENT wbc_armr4.20.current_cmd "current_cmd" FLOAT64_IEEE wbc_armr4.20.current_cmd_COMPU_METHOD 0 0 -1E12 1E12 ECU_ADDRESS 0x71078
 /begin IF_DATA XCP
  /begin DAQ_EVENT FIXED_EVENT_LIST EVENT 0x0 /end DAQ_EVENT
 /end IF_DATA
/end MEASUREMENT
/begin COMPU_METHOD wbc_armr4.20.velocity_COMPU_METHOD "" LINEAR "%6.3" "" COEFFS_LINEAR 1 0 /end COMPU_METHOD
/begin MEASUREMENT wbc_armr4.20.velocity "velocity" FLOAT64_IEEE wbc_armr4.20.velocity_COMPU_METHOD 0 0 -1E12 1E12 ECU_ADDRESS 0x71080
 /begin IF_DATA XCP
  /begin DAQ_EVENT FIXED_EVENT_LIST EVENT 0x0 /end DAQ_EVENT
 /end IF_DATA
/end MEASUREMENT
/begin COMPU_METHOD wbc_armr4.20.max_velocity_COMPU_METHOD "" LINEAR "%6.3" "" COEFFS_LINEAR 1 0 /end COMPU_METHOD
/begin MEASUREMENT wbc_armr4.20.max_velocity "max_velocity" FLOAT64_IEEE wbc_armr4.20.max_velocity_COMPU_METHOD 0 0 -1E12 1E12 ECU_ADDRESS 0x71088
 /begin IF_DATA XCP
  /begin DAQ_EVENT FIXED_EVENT_LIST EVENT 0x0 /end DAQ_EVENT
 /end IF_DATA
/end MEASUREMENT
/begin COMPU_METHOD wbc_armr4.20.acceleration_COMPU_METHOD "" LINEAR "%6.3" "" COEFFS_LINEAR 1 0 /end COMPU_METHOD
/begin MEASUREMENT wbc_armr4.20.acceleration "acceleration" FLOAT64_IEEE wbc_armr4.20.acceleration_COMPU_METHOD 0 0 -1E12 1E12 ECU_ADDRESS 0x71090
 /begin IF_DATA XCP
  /begin DAQ_EVENT FIXED_EVENT_LIST EVENT 0x0 /end DAQ_EVENT
 /end IF_DATA
/end MEASUREMENT
/begin COMPU_METHOD wbc_armr4.20.deceleration_COMPU_METHOD "" LINEAR "%6.3" "" COEFFS_LINEAR 1 0 /end COMPU_METHOD
/begin MEASUREMENT wbc_armr4.20.deceleration "deceleration" FLOAT64_IEEE wbc_armr4.20.deceleration_COMPU_METHOD 0 0 -1E12 1E12 ECU_ADDRESS 0x71098
 /begin IF_DATA XCP
  /begin DAQ_EVENT FIXED_EVENT_LIST EVENT 0x0 /end DAQ_EVENT
 /end IF_DATA
/end MEASUREMENT
/begin COMPU_METHOD wbc_armr4.20.KP_COMPU_METHOD "" LINEAR "%6.3" "" COEFFS_LINEAR 1 0 /end COMPU_METHOD
/begin MEASUREMENT wbc_armr4.20.KP "KP" FLOAT64_IEEE wbc_armr4.20.KP_COMPU_METHOD 0 0 -1E12 1E12 ECU_ADDRESS 0x710A0
 /begin IF_DATA XCP
  /begin DAQ_EVENT FIXED_EVENT_LIST EVENT 0x0 /end DAQ_EVENT
 /end IF_DATA
/end MEASUREMENT
/begin COMPU_METHOD wbc_armr4.20.KD_COMPU_METHOD "" LINEAR "%6.3" "" COEFFS_LINEAR 1 0 /end COMPU_METHOD
/begin MEASUREMENT wbc_armr4.20.KD "KD" FLOAT64_IEEE wbc_armr4.20.KD_COMPU_METHOD 0 0 -1E12 1E12 ECU_ADDRESS 0x710A8
 /begin IF_DATA XCP
  /begin DAQ_EVENT FIXED_EVENT_LIST EVENT 0x0 /end DAQ_EVENT
 /end IF_DATA
/end MEASUREMENT
/begin COMPU_METHOD wbc_armr4.20.enable_COMPU_METHOD "" LINEAR "%6.3" "" COEFFS_LINEAR 1 0 /end COMPU_METHOD
/begin MEASUREMENT wbc_armr4.20.enable "enable" SBYTE wbc_armr4.20.enable_COMPU_METHOD 0 0 -128 127 ECU_ADDRESS 0x710B0
 /begin IF_DATA XCP
  /begin DAQ_EVENT FIXED_EVENT_LIST EVENT 0x0 /end DAQ_EVENT
 /end IF_DATA
/end MEASUREMENT
/begin COMPU_METHOD wbc_armr4.20.operation_mode_COMPU_METHOD "" LINEAR "%6.3" "" COEFFS_LINEAR 1 0 /end COMPU_METHOD
/begin MEASUREMENT wbc_armr4.20.operation_mode "operation_mode" SBYTE wbc_armr4.20.operation_mode_COMPU_METHOD 0 0 -128 127 ECU_ADDRESS 0x710B1
 /begin IF_DATA XCP
  /begin DAQ_EVENT FIXED_EVENT_LIST EVENT 0x0 /end DAQ_EVENT
 /end IF_DATA
/end MEASUREMENT
/begin COMPU_METHOD wbc_armr4.20.polarity_COMPU_METHOD "" LINEAR "%6.3" "" COEFFS_LINEAR 1 0 /end COMPU_METHOD
/begin MEASUREMENT wbc_armr4.20.polarity "polarity" UBYTE wbc_armr4.20.polarity_COMPU_METHOD 0 0 0 255 ECU_ADDRESS 0x710B2
 /begin IF_DATA XCP
  /begin DAQ_EVENT FIXED_EVENT_LIST EVENT 0x0 /end DAQ_EVENT
 /end IF_DATA
/end MEASUREMENT
/begin GROUP joints_cmd.20.wbc_armr4 ""
 /begin REF_MEASUREMENT wbc_armr4.20.pos_cmd wbc_armr4.20.vel_cmd wbc_armr4.20.torque_cmd wbc_armr4.20.current_cmd wbc_armr4.20.velocity wbc_armr4.20.max_velocity wbc_armr4.20.acceleration wbc_armr4.20.deceleration wbc_armr4.20.KP wbc_armr4.20.KD wbc_armr4.20.enable wbc_armr4.20.operation_mode wbc_armr4.20.polarity /end REF_MEASUREMENT
/end GROUP
/begin COMPU_METHOD wbc_armr4.20.pos_fb_COMPU_METHOD "" LINEAR "%6.3" "" COEFFS_LINEAR 1 0 /end COMPU_METHOD
/begin MEASUREMENT wbc_armr4.20.pos_fb "pos_fb" FLOAT64_IEEE wbc_armr4.20.pos_fb_COMPU_METHOD 0 0 -1E12 1E12 ECU_ADDRESS 0x70158
 /begin IF_DATA XCP
  /begin DAQ_EVENT FIXED_EVENT_LIST EVENT 0x0 /end DAQ_EVENT
 /end IF_DATA
/end MEASUREMENT
/begin COMPU_METHOD wbc_armr4.20.vel_fb_COMPU_METHOD "" LINEAR "%6.3" "" COEFFS_LINEAR 1 0 /end COMPU_METHOD
/begin MEASUREMENT wbc_armr4.20.vel_fb "vel_fb" FLOAT64_IEEE wbc_armr4.20.vel_fb_COMPU_METHOD 0 0 -1E12 1E12 ECU_ADDRESS 0x70160
 /begin IF_DATA XCP
  /begin DAQ_EVENT FIXED_EVENT_LIST EVENT 0x0 /end DAQ_EVENT
 /end IF_DATA
/end MEASUREMENT
/begin COMPU_METHOD wbc_armr4.20.torque_fb_COMPU_METHOD "" LINEAR "%6.3" "" COEFFS_LINEAR 1 0 /end COMPU_METHOD
/begin MEASUREMENT wbc_armr4.20.torque_fb "torque_fb" FLOAT64_IEEE wbc_armr4.20.torque_fb_COMPU_METHOD 0 0 -1E12 1E12 ECU_ADDRESS 0x70168
 /begin IF_DATA XCP
  /begin DAQ_EVENT FIXED_EVENT_LIST EVENT 0x0 /end DAQ_EVENT
 /end IF_DATA
/end MEASUREMENT
/begin COMPU_METHOD wbc_armr4.20.current_fb_COMPU_METHOD "" LINEAR "%6.3" "" COEFFS_LINEAR 1 0 /end COMPU_METHOD
/begin MEASUREMENT wbc_armr4.20.current_fb "current_fb" FLOAT64_IEEE wbc_armr4.20.current_fb_COMPU_METHOD 0 0 -1E12 1E12 ECU_ADDRESS 0x70170
 /begin IF_DATA XCP
  /begin DAQ_EVENT FIXED_EVENT_LIST EVENT 0x0 /end DAQ_EVENT
 /end IF_DATA
/end MEASUREMENT
/begin COMPU_METHOD wbc_armr4.20.motor_temper_COMPU_METHOD "" LINEAR "%6.3" "" COEFFS_LINEAR 1 0 /end COMPU_METHOD
/begin MEASUREMENT wbc_armr4.20.motor_temper "motor_temper" FLOAT64_IEEE wbc_armr4.20.motor_temper_COMPU_METHOD 0 0 -1E12 1E12 ECU_ADDRESS 0x70178
 /begin IF_DATA XCP
  /begin DAQ_EVENT FIXED_EVENT_LIST EVENT 0x0 /end DAQ_EVENT
 /end IF_DATA
/end MEASUREMENT
/begin COMPU_METHOD wbc_armr4.20.min_soft_position_COMPU_METHOD "" LINEAR "%6.3" "" COEFFS_LINEAR 1 0 /end COMPU_METHOD
/begin MEASUREMENT wbc_armr4.20.min_soft_position "min_soft_position_limit" FLOAT64_IEEE wbc_armr4.20.min_soft_position_COMPU_METHOD 0 0 -1E12 1E12 ECU_ADDRESS 0x70180
 /begin IF_DATA XCP
  /begin DAQ_EVENT FIXED_EVENT_LIST EVENT 0x0 /end DAQ_EVENT
 /end IF_DATA
/end MEASUREMENT
/begin COMPU_METHOD wbc_armr4.20.max_soft_position_COMPU_METHOD "" LINEAR "%6.3" "" COEFFS_LINEAR 1 0 /end COMPU_METHOD
/begin MEASUREMENT wbc_armr4.20.max_soft_position "max_soft_position_limit" FLOAT64_IEEE wbc_armr4.20.max_soft_position_COMPU_METHOD 0 0 -1E12 1E12 ECU_ADDRESS 0x70188
 /begin IF_DATA XCP
  /begin DAQ_EVENT FIXED_EVENT_LIST EVENT 0x0 /end DAQ_EVENT
 /end IF_DATA
/end MEASUREMENT
/begin COMPU_METHOD wbc_armr4.20.max_profile_veloc_COMPU_METHOD "" LINEAR "%6.3" "" COEFFS_LINEAR 1 0 /end COMPU_METHOD
/begin MEASUREMENT wbc_armr4.20.max_profile_veloc "max_profile_velocity" FLOAT64_IEEE wbc_armr4.20.max_profile_veloc_COMPU_METHOD 0 0 -1E12 1E12 ECU_ADDRESS 0x70190
 /begin IF_DATA XCP
  /begin DAQ_EVENT FIXED_EVENT_LIST EVENT 0x0 /end DAQ_EVENT
 /end IF_DATA
/end MEASUREMENT
/begin COMPU_METHOD wbc_armr4.20.voltage_COMPU_METHOD "" LINEAR "%6.3" "" COEFFS_LINEAR 1 0 /end COMPU_METHOD
/begin MEASUREMENT wbc_armr4.20.voltage "voltage" FLOAT64_IEEE wbc_armr4.20.voltage_COMPU_METHOD 0 0 -1E12 1E12 ECU_ADDRESS 0x701A0
 /begin IF_DATA XCP
  /begin DAQ_EVENT FIXED_EVENT_LIST EVENT 0x0 /end DAQ_EVENT
 /end IF_DATA
/end MEASUREMENT
/begin COMPU_METHOD wbc_armr4.20.enabled_COMPU_METHOD "" LINEAR "%6.3" "" COEFFS_LINEAR 1 0 /end COMPU_METHOD
/begin MEASUREMENT wbc_armr4.20.enabled "enabled" SBYTE wbc_armr4.20.enabled_COMPU_METHOD 0 0 -128 127 ECU_ADDRESS 0x70198
 /begin IF_DATA XCP
  /begin DAQ_EVENT FIXED_EVENT_LIST EVENT 0x0 /end DAQ_EVENT
 /end IF_DATA
/end MEASUREMENT
/begin COMPU_METHOD wbc_armr4.20.error_COMPU_METHOD "" LINEAR "%6.3" "" COEFFS_LINEAR 1 0 /end COMPU_METHOD
/begin MEASUREMENT wbc_armr4.20.error "error" SBYTE wbc_armr4.20.error_COMPU_METHOD 0 0 -128 127 ECU_ADDRESS 0x70199
 /begin IF_DATA XCP
  /begin DAQ_EVENT FIXED_EVENT_LIST EVENT 0x0 /end DAQ_EVENT
 /end IF_DATA
/end MEASUREMENT
/begin COMPU_METHOD wbc_armr4.20.operation_mode_di_COMPU_METHOD "" LINEAR "%6.3" "" COEFFS_LINEAR 1 0 /end COMPU_METHOD
/begin MEASUREMENT wbc_armr4.20.operation_mode_di "operation_mode_display" SBYTE wbc_armr4.20.operation_mode_di_COMPU_METHOD 0 0 -128 127 ECU_ADDRESS 0x7019A
 /begin IF_DATA XCP
  /begin DAQ_EVENT FIXED_EVENT_LIST EVENT 0x0 /end DAQ_EVENT
 /end IF_DATA
/end MEASUREMENT
/begin GROUP joints_status.20.wbc_armr4 ""
 /begin REF_MEASUREMENT wbc_armr4.20.pos_fb wbc_armr4.20.vel_fb wbc_armr4.20.torque_fb wbc_armr4.20.current_fb wbc_armr4.20.motor_temper wbc_armr4.20.min_soft_position wbc_armr4.20.max_soft_position wbc_armr4.20.max_profile_veloc wbc_armr4.20.voltage wbc_armr4.20.enabled wbc_armr4.20.error wbc_armr4.20.operation_mode_di /end REF_MEASUREMENT
/end GROUP
/begin COMPU_METHOD wbc_armr5.21.pos_cmd_COMPU_METHOD "" LINEAR "%6.3" "" COEFFS_LINEAR 1 0 /end COMPU_METHOD
/begin MEASUREMENT wbc_armr5.21.pos_cmd "pos_cmd" FLOAT64_IEEE wbc_armr5.21.pos_cmd_COMPU_METHOD 0 0 -1E12 1E12 ECU_ADDRESS 0x710B8
 /begin IF_DATA XCP
  /begin DAQ_EVENT FIXED_EVENT_LIST EVENT 0x0 /end DAQ_EVENT
 /end IF_DATA
/end MEASUREMENT
/begin COMPU_METHOD wbc_armr5.21.vel_cmd_COMPU_METHOD "" LINEAR "%6.3" "" COEFFS_LINEAR 1 0 /end COMPU_METHOD
/begin MEASUREMENT wbc_armr5.21.vel_cmd "vel_cmd" FLOAT64_IEEE wbc_armr5.21.vel_cmd_COMPU_METHOD 0 0 -1E12 1E12 ECU_ADDRESS 0x710C0
 /begin IF_DATA XCP
  /begin DAQ_EVENT FIXED_EVENT_LIST EVENT 0x0 /end DAQ_EVENT
 /end IF_DATA
/end MEASUREMENT
/begin COMPU_METHOD wbc_armr5.21.torque_cmd_COMPU_METHOD "" LINEAR "%6.3" "" COEFFS_LINEAR 1 0 /end COMPU_METHOD
/begin MEASUREMENT wbc_armr5.21.torque_cmd "torque_cmd" FLOAT64_IEEE wbc_armr5.21.torque_cmd_COMPU_METHOD 0 0 -1E12 1E12 ECU_ADDRESS 0x710C8
 /begin IF_DATA XCP
  /begin DAQ_EVENT FIXED_EVENT_LIST EVENT 0x0 /end DAQ_EVENT
 /end IF_DATA
/end MEASUREMENT
/begin COMPU_METHOD wbc_armr5.21.current_cmd_COMPU_METHOD "" LINEAR "%6.3" "" COEFFS_LINEAR 1 0 /end COMPU_METHOD
/begin MEASUREMENT wbc_armr5.21.current_cmd "current_cmd" FLOAT64_IEEE wbc_armr5.21.current_cmd_COMPU_METHOD 0 0 -1E12 1E12 ECU_ADDRESS 0x710D0
 /begin IF_DATA XCP
  /begin DAQ_EVENT FIXED_EVENT_LIST EVENT 0x0 /end DAQ_EVENT
 /end IF_DATA
/end MEASUREMENT
/begin COMPU_METHOD wbc_armr5.21.velocity_COMPU_METHOD "" LINEAR "%6.3" "" COEFFS_LINEAR 1 0 /end COMPU_METHOD
/begin MEASUREMENT wbc_armr5.21.velocity "velocity" FLOAT64_IEEE wbc_armr5.21.velocity_COMPU_METHOD 0 0 -1E12 1E12 ECU_ADDRESS 0x710D8
 /begin IF_DATA XCP
  /begin DAQ_EVENT FIXED_EVENT_LIST EVENT 0x0 /end DAQ_EVENT
 /end IF_DATA
/end MEASUREMENT
/begin COMPU_METHOD wbc_armr5.21.max_velocity_COMPU_METHOD "" LINEAR "%6.3" "" COEFFS_LINEAR 1 0 /end COMPU_METHOD
/begin MEASUREMENT wbc_armr5.21.max_velocity "max_velocity" FLOAT64_IEEE wbc_armr5.21.max_velocity_COMPU_METHOD 0 0 -1E12 1E12 ECU_ADDRESS 0x710E0
 /begin IF_DATA XCP
  /begin DAQ_EVENT FIXED_EVENT_LIST EVENT 0x0 /end DAQ_EVENT
 /end IF_DATA
/end MEASUREMENT
/begin COMPU_METHOD wbc_armr5.21.acceleration_COMPU_METHOD "" LINEAR "%6.3" "" COEFFS_LINEAR 1 0 /end COMPU_METHOD
/begin MEASUREMENT wbc_armr5.21.acceleration "acceleration" FLOAT64_IEEE wbc_armr5.21.acceleration_COMPU_METHOD 0 0 -1E12 1E12 ECU_ADDRESS 0x710E8
 /begin IF_DATA XCP
  /begin DAQ_EVENT FIXED_EVENT_LIST EVENT 0x0 /end DAQ_EVENT
 /end IF_DATA
/end MEASUREMENT
/begin COMPU_METHOD wbc_armr5.21.deceleration_COMPU_METHOD "" LINEAR "%6.3" "" COEFFS_LINEAR 1 0 /end COMPU_METHOD
/begin MEASUREMENT wbc_armr5.21.deceleration "deceleration" FLOAT64_IEEE wbc_armr5.21.deceleration_COMPU_METHOD 0 0 -1E12 1E12 ECU_ADDRESS 0x710F0
 /begin IF_DATA XCP
  /begin DAQ_EVENT FIXED_EVENT_LIST EVENT 0x0 /end DAQ_EVENT
 /end IF_DATA
/end MEASUREMENT
/begin COMPU_METHOD wbc_armr5.21.KP_COMPU_METHOD "" LINEAR "%6.3" "" COEFFS_LINEAR 1 0 /end COMPU_METHOD
/begin MEASUREMENT wbc_armr5.21.KP "KP" FLOAT64_IEEE wbc_armr5.21.KP_COMPU_METHOD 0 0 -1E12 1E12 ECU_ADDRESS 0x710F8
 /begin IF_DATA XCP
  /begin DAQ_EVENT FIXED_EVENT_LIST EVENT 0x0 /end DAQ_EVENT
 /end IF_DATA
/end MEASUREMENT
/begin COMPU_METHOD wbc_armr5.21.KD_COMPU_METHOD "" LINEAR "%6.3" "" COEFFS_LINEAR 1 0 /end COMPU_METHOD
/begin MEASUREMENT wbc_armr5.21.KD "KD" FLOAT64_IEEE wbc_armr5.21.KD_COMPU_METHOD 0 0 -1E12 1E12 ECU_ADDRESS 0x71100
 /begin IF_DATA XCP
  /begin DAQ_EVENT FIXED_EVENT_LIST EVENT 0x0 /end DAQ_EVENT
 /end IF_DATA
/end MEASUREMENT
/begin COMPU_METHOD wbc_armr5.21.enable_COMPU_METHOD "" LINEAR "%6.3" "" COEFFS_LINEAR 1 0 /end COMPU_METHOD
/begin MEASUREMENT wbc_armr5.21.enable "enable" SBYTE wbc_armr5.21.enable_COMPU_METHOD 0 0 -128 127 ECU_ADDRESS 0x71108
 /begin IF_DATA XCP
  /begin DAQ_EVENT FIXED_EVENT_LIST EVENT 0x0 /end DAQ_EVENT
 /end IF_DATA
/end MEASUREMENT
/begin COMPU_METHOD wbc_armr5.21.operation_mode_COMPU_METHOD "" LINEAR "%6.3" "" COEFFS_LINEAR 1 0 /end COMPU_METHOD
/begin MEASUREMENT wbc_armr5.21.operation_mode "operation_mode" SBYTE wbc_armr5.21.operation_mode_COMPU_METHOD 0 0 -128 127 ECU_ADDRESS 0x71109
 /begin IF_DATA XCP
  /begin DAQ_EVENT FIXED_EVENT_LIST EVENT 0x0 /end DAQ_EVENT
 /end IF_DATA
/end MEASUREMENT
/begin COMPU_METHOD wbc_armr5.21.polarity_COMPU_METHOD "" LINEAR "%6.3" "" COEFFS_LINEAR 1 0 /end COMPU_METHOD
/begin MEASUREMENT wbc_armr5.21.polarity "polarity" UBYTE wbc_armr5.21.polarity_COMPU_METHOD 0 0 0 255 ECU_ADDRESS 0x7110A
 /begin IF_DATA XCP
  /begin DAQ_EVENT FIXED_EVENT_LIST EVENT 0x0 /end DAQ_EVENT
 /end IF_DATA
/end MEASUREMENT
/begin GROUP joints_cmd.21.wbc_armr5 ""
 /begin REF_MEASUREMENT wbc_armr5.21.pos_cmd wbc_armr5.21.vel_cmd wbc_armr5.21.torque_cmd wbc_armr5.21.current_cmd wbc_armr5.21.velocity wbc_armr5.21.max_velocity wbc_armr5.21.acceleration wbc_armr5.21.deceleration wbc_armr5.21.KP wbc_armr5.21.KD wbc_armr5.21.enable wbc_armr5.21.operation_mode wbc_armr5.21.polarity /end REF_MEASUREMENT
/end GROUP
/begin COMPU_METHOD wbc_armr5.21.pos_fb_COMPU_METHOD "" LINEAR "%6.3" "" COEFFS_LINEAR 1 0 /end COMPU_METHOD
/begin MEASUREMENT wbc_armr5.21.pos_fb "pos_fb" FLOAT64_IEEE wbc_armr5.21.pos_fb_COMPU_METHOD 0 0 -1E12 1E12 ECU_ADDRESS 0x701A8
 /begin IF_DATA XCP
  /begin DAQ_EVENT FIXED_EVENT_LIST EVENT 0x0 /end DAQ_EVENT
 /end IF_DATA
/end MEASUREMENT
/begin COMPU_METHOD wbc_armr5.21.vel_fb_COMPU_METHOD "" LINEAR "%6.3" "" COEFFS_LINEAR 1 0 /end COMPU_METHOD
/begin MEASUREMENT wbc_armr5.21.vel_fb "vel_fb" FLOAT64_IEEE wbc_armr5.21.vel_fb_COMPU_METHOD 0 0 -1E12 1E12 ECU_ADDRESS 0x701B0
 /begin IF_DATA XCP
  /begin DAQ_EVENT FIXED_EVENT_LIST EVENT 0x0 /end DAQ_EVENT
 /end IF_DATA
/end MEASUREMENT
/begin COMPU_METHOD wbc_armr5.21.torque_fb_COMPU_METHOD "" LINEAR "%6.3" "" COEFFS_LINEAR 1 0 /end COMPU_METHOD
/begin MEASUREMENT wbc_armr5.21.torque_fb "torque_fb" FLOAT64_IEEE wbc_armr5.21.torque_fb_COMPU_METHOD 0 0 -1E12 1E12 ECU_ADDRESS 0x701B8
 /begin IF_DATA XCP
  /begin DAQ_EVENT FIXED_EVENT_LIST EVENT 0x0 /end DAQ_EVENT
 /end IF_DATA
/end MEASUREMENT
/begin COMPU_METHOD wbc_armr5.21.current_fb_COMPU_METHOD "" LINEAR "%6.3" "" COEFFS_LINEAR 1 0 /end COMPU_METHOD
/begin MEASUREMENT wbc_armr5.21.current_fb "current_fb" FLOAT64_IEEE wbc_armr5.21.current_fb_COMPU_METHOD 0 0 -1E12 1E12 ECU_ADDRESS 0x701C0
 /begin IF_DATA XCP
  /begin DAQ_EVENT FIXED_EVENT_LIST EVENT 0x0 /end DAQ_EVENT
 /end IF_DATA
/end MEASUREMENT
/begin COMPU_METHOD wbc_armr5.21.motor_temper_COMPU_METHOD "" LINEAR "%6.3" "" COEFFS_LINEAR 1 0 /end COMPU_METHOD
/begin MEASUREMENT wbc_armr5.21.motor_temper "motor_temper" FLOAT64_IEEE wbc_armr5.21.motor_temper_COMPU_METHOD 0 0 -1E12 1E12 ECU_ADDRESS 0x701C8
 /begin IF_DATA XCP
  /begin DAQ_EVENT FIXED_EVENT_LIST EVENT 0x0 /end DAQ_EVENT
 /end IF_DATA
/end MEASUREMENT
/begin COMPU_METHOD wbc_armr5.21.min_soft_position_COMPU_METHOD "" LINEAR "%6.3" "" COEFFS_LINEAR 1 0 /end COMPU_METHOD
/begin MEASUREMENT wbc_armr5.21.min_soft_position "min_soft_position_limit" FLOAT64_IEEE wbc_armr5.21.min_soft_position_COMPU_METHOD 0 0 -1E12 1E12 ECU_ADDRESS 0x701D0
 /begin IF_DATA XCP
  /begin DAQ_EVENT FIXED_EVENT_LIST EVENT 0x0 /end DAQ_EVENT
 /end IF_DATA
/end MEASUREMENT
/begin COMPU_METHOD wbc_armr5.21.max_soft_position_COMPU_METHOD "" LINEAR "%6.3" "" COEFFS_LINEAR 1 0 /end COMPU_METHOD
/begin MEASUREMENT wbc_armr5.21.max_soft_position "max_soft_position_limit" FLOAT64_IEEE wbc_armr5.21.max_soft_position_COMPU_METHOD 0 0 -1E12 1E12 ECU_ADDRESS 0x701D8
 /begin IF_DATA XCP
  /begin DAQ_EVENT FIXED_EVENT_LIST EVENT 0x0 /end DAQ_EVENT
 /end IF_DATA
/end MEASUREMENT
/begin COMPU_METHOD wbc_armr5.21.max_profile_veloc_COMPU_METHOD "" LINEAR "%6.3" "" COEFFS_LINEAR 1 0 /end COMPU_METHOD
/begin MEASUREMENT wbc_armr5.21.max_profile_veloc "max_profile_velocity" FLOAT64_IEEE wbc_armr5.21.max_profile_veloc_COMPU_METHOD 0 0 -1E12 1E12 ECU_ADDRESS 0x701E0
 /begin IF_DATA XCP
  /begin DAQ_EVENT FIXED_EVENT_LIST EVENT 0x0 /end DAQ_EVENT
 /end IF_DATA
/end MEASUREMENT
/begin COMPU_METHOD wbc_armr5.21.voltage_COMPU_METHOD "" LINEAR "%6.3" "" COEFFS_LINEAR 1 0 /end COMPU_METHOD
/begin MEASUREMENT wbc_armr5.21.voltage "voltage" FLOAT64_IEEE wbc_armr5.21.voltage_COMPU_METHOD 0 0 -1E12 1E12 ECU_ADDRESS 0x701F0
 /begin IF_DATA XCP
  /begin DAQ_EVENT FIXED_EVENT_LIST EVENT 0x0 /end DAQ_EVENT
 /end IF_DATA
/end MEASUREMENT
/begin COMPU_METHOD wbc_armr5.21.enabled_COMPU_METHOD "" LINEAR "%6.3" "" COEFFS_LINEAR 1 0 /end COMPU_METHOD
/begin MEASUREMENT wbc_armr5.21.enabled "enabled" SBYTE wbc_armr5.21.enabled_COMPU_METHOD 0 0 -128 127 ECU_ADDRESS 0x701E8
 /begin IF_DATA XCP
  /begin DAQ_EVENT FIXED_EVENT_LIST EVENT 0x0 /end DAQ_EVENT
 /end IF_DATA
/end MEASUREMENT
/begin COMPU_METHOD wbc_armr5.21.error_COMPU_METHOD "" LINEAR "%6.3" "" COEFFS_LINEAR 1 0 /end COMPU_METHOD
/begin MEASUREMENT wbc_armr5.21.error "error" SBYTE wbc_armr5.21.error_COMPU_METHOD 0 0 -128 127 ECU_ADDRESS 0x701E9
 /begin IF_DATA XCP
  /begin DAQ_EVENT FIXED_EVENT_LIST EVENT 0x0 /end DAQ_EVENT
 /end IF_DATA
/end MEASUREMENT
/begin COMPU_METHOD wbc_armr5.21.operation_mode_di_COMPU_METHOD "" LINEAR "%6.3" "" COEFFS_LINEAR 1 0 /end COMPU_METHOD
/begin MEASUREMENT wbc_armr5.21.operation_mode_di "operation_mode_display" SBYTE wbc_armr5.21.operation_mode_di_COMPU_METHOD 0 0 -128 127 ECU_ADDRESS 0x701EA
 /begin IF_DATA XCP
  /begin DAQ_EVENT FIXED_EVENT_LIST EVENT 0x0 /end DAQ_EVENT
 /end IF_DATA
/end MEASUREMENT
/begin GROUP joints_status.21.wbc_armr5 ""
 /begin REF_MEASUREMENT wbc_armr5.21.pos_fb wbc_armr5.21.vel_fb wbc_armr5.21.torque_fb wbc_armr5.21.current_fb wbc_armr5.21.motor_temper wbc_armr5.21.min_soft_position wbc_armr5.21.max_soft_position wbc_armr5.21.max_profile_veloc wbc_armr5.21.voltage wbc_armr5.21.enabled wbc_armr5.21.error wbc_armr5.21.operation_mode_di /end REF_MEASUREMENT
/end GROUP
/begin COMPU_METHOD wbc_armr6.22.pos_cmd_COMPU_METHOD "" LINEAR "%6.3" "" COEFFS_LINEAR 1 0 /end COMPU_METHOD
/begin MEASUREMENT wbc_armr6.22.pos_cmd "pos_cmd" FLOAT64_IEEE wbc_armr6.22.pos_cmd_COMPU_METHOD 0 0 -1E12 1E12 ECU_ADDRESS 0x71110
 /begin IF_DATA XCP
  /begin DAQ_EVENT FIXED_EVENT_LIST EVENT 0x0 /end DAQ_EVENT
 /end IF_DATA
/end MEASUREMENT
/begin COMPU_METHOD wbc_armr6.22.vel_cmd_COMPU_METHOD "" LINEAR "%6.3" "" COEFFS_LINEAR 1 0 /end COMPU_METHOD
/begin MEASUREMENT wbc_armr6.22.vel_cmd "vel_cmd" FLOAT64_IEEE wbc_armr6.22.vel_cmd_COMPU_METHOD 0 0 -1E12 1E12 ECU_ADDRESS 0x71118
 /begin IF_DATA XCP
  /begin DAQ_EVENT FIXED_EVENT_LIST EVENT 0x0 /end DAQ_EVENT
 /end IF_DATA
/end MEASUREMENT
/begin COMPU_METHOD wbc_armr6.22.torque_cmd_COMPU_METHOD "" LINEAR "%6.3" "" COEFFS_LINEAR 1 0 /end COMPU_METHOD
/begin MEASUREMENT wbc_armr6.22.torque_cmd "torque_cmd" FLOAT64_IEEE wbc_armr6.22.torque_cmd_COMPU_METHOD 0 0 -1E12 1E12 ECU_ADDRESS 0x71120
 /begin IF_DATA XCP
  /begin DAQ_EVENT FIXED_EVENT_LIST EVENT 0x0 /end DAQ_EVENT
 /end IF_DATA
/end MEASUREMENT
/begin COMPU_METHOD wbc_armr6.22.current_cmd_COMPU_METHOD "" LINEAR "%6.3" "" COEFFS_LINEAR 1 0 /end COMPU_METHOD
/begin MEASUREMENT wbc_armr6.22.current_cmd "current_cmd" FLOAT64_IEEE wbc_armr6.22.current_cmd_COMPU_METHOD 0 0 -1E12 1E12 ECU_ADDRESS 0x71128
 /begin IF_DATA XCP
  /begin DAQ_EVENT FIXED_EVENT_LIST EVENT 0x0 /end DAQ_EVENT
 /end IF_DATA
/end MEASUREMENT
/begin COMPU_METHOD wbc_armr6.22.velocity_COMPU_METHOD "" LINEAR "%6.3" "" COEFFS_LINEAR 1 0 /end COMPU_METHOD
/begin MEASUREMENT wbc_armr6.22.velocity "velocity" FLOAT64_IEEE wbc_armr6.22.velocity_COMPU_METHOD 0 0 -1E12 1E12 ECU_ADDRESS 0x71130
 /begin IF_DATA XCP
  /begin DAQ_EVENT FIXED_EVENT_LIST EVENT 0x0 /end DAQ_EVENT
 /end IF_DATA
/end MEASUREMENT
/begin COMPU_METHOD wbc_armr6.22.max_velocity_COMPU_METHOD "" LINEAR "%6.3" "" COEFFS_LINEAR 1 0 /end COMPU_METHOD
/begin MEASUREMENT wbc_armr6.22.max_velocity "max_velocity" FLOAT64_IEEE wbc_armr6.22.max_velocity_COMPU_METHOD 0 0 -1E12 1E12 ECU_ADDRESS 0x71138
 /begin IF_DATA XCP
  /begin DAQ_EVENT FIXED_EVENT_LIST EVENT 0x0 /end DAQ_EVENT
 /end IF_DATA
/end MEASUREMENT
/begin COMPU_METHOD wbc_armr6.22.acceleration_COMPU_METHOD "" LINEAR "%6.3" "" COEFFS_LINEAR 1 0 /end COMPU_METHOD
/begin MEASUREMENT wbc_armr6.22.acceleration "acceleration" FLOAT64_IEEE wbc_armr6.22.acceleration_COMPU_METHOD 0 0 -1E12 1E12 ECU_ADDRESS 0x71140
 /begin IF_DATA XCP
  /begin DAQ_EVENT FIXED_EVENT_LIST EVENT 0x0 /end DAQ_EVENT
 /end IF_DATA
/end MEASUREMENT
/begin COMPU_METHOD wbc_armr6.22.deceleration_COMPU_METHOD "" LINEAR "%6.3" "" COEFFS_LINEAR 1 0 /end COMPU_METHOD
/begin MEASUREMENT wbc_armr6.22.deceleration "deceleration" FLOAT64_IEEE wbc_armr6.22.deceleration_COMPU_METHOD 0 0 -1E12 1E12 ECU_ADDRESS 0x71148
 /begin IF_DATA XCP
  /begin DAQ_EVENT FIXED_EVENT_LIST EVENT 0x0 /end DAQ_EVENT
 /end IF_DATA
/end MEASUREMENT
/begin COMPU_METHOD wbc_armr6.22.KP_COMPU_METHOD "" LINEAR "%6.3" "" COEFFS_LINEAR 1 0 /end COMPU_METHOD
/begin MEASUREMENT wbc_armr6.22.KP "KP" FLOAT64_IEEE wbc_armr6.22.KP_COMPU_METHOD 0 0 -1E12 1E12 ECU_ADDRESS 0x71150
 /begin IF_DATA XCP
  /begin DAQ_EVENT FIXED_EVENT_LIST EVENT 0x0 /end DAQ_EVENT
 /end IF_DATA
/end MEASUREMENT
/begin COMPU_METHOD wbc_armr6.22.KD_COMPU_METHOD "" LINEAR "%6.3" "" COEFFS_LINEAR 1 0 /end COMPU_METHOD
/begin MEASUREMENT wbc_armr6.22.KD "KD" FLOAT64_IEEE wbc_armr6.22.KD_COMPU_METHOD 0 0 -1E12 1E12 ECU_ADDRESS 0x71158
 /begin IF_DATA XCP
  /begin DAQ_EVENT FIXED_EVENT_LIST EVENT 0x0 /end DAQ_EVENT
 /end IF_DATA
/end MEASUREMENT
/begin COMPU_METHOD wbc_armr6.22.enable_COMPU_METHOD "" LINEAR "%6.3" "" COEFFS_LINEAR 1 0 /end COMPU_METHOD
/begin MEASUREMENT wbc_armr6.22.enable "enable" SBYTE wbc_armr6.22.enable_COMPU_METHOD 0 0 -128 127 ECU_ADDRESS 0x71160
 /begin IF_DATA XCP
  /begin DAQ_EVENT FIXED_EVENT_LIST EVENT 0x0 /end DAQ_EVENT
 /end IF_DATA
/end MEASUREMENT
/begin COMPU_METHOD wbc_armr6.22.operation_mode_COMPU_METHOD "" LINEAR "%6.3" "" COEFFS_LINEAR 1 0 /end COMPU_METHOD
/begin MEASUREMENT wbc_armr6.22.operation_mode "operation_mode" SBYTE wbc_armr6.22.operation_mode_COMPU_METHOD 0 0 -128 127 ECU_ADDRESS 0x71161
 /begin IF_DATA XCP
  /begin DAQ_EVENT FIXED_EVENT_LIST EVENT 0x0 /end DAQ_EVENT
 /end IF_DATA
/end MEASUREMENT
/begin COMPU_METHOD wbc_armr6.22.polarity_COMPU_METHOD "" LINEAR "%6.3" "" COEFFS_LINEAR 1 0 /end COMPU_METHOD
/begin MEASUREMENT wbc_armr6.22.polarity "polarity" UBYTE wbc_armr6.22.polarity_COMPU_METHOD 0 0 0 255 ECU_ADDRESS 0x71162
 /begin IF_DATA XCP
  /begin DAQ_EVENT FIXED_EVENT_LIST EVENT 0x0 /end DAQ_EVENT
 /end IF_DATA
/end MEASUREMENT
/begin GROUP joints_cmd.22.wbc_armr6 ""
 /begin REF_MEASUREMENT wbc_armr6.22.pos_cmd wbc_armr6.22.vel_cmd wbc_armr6.22.torque_cmd wbc_armr6.22.current_cmd wbc_armr6.22.velocity wbc_armr6.22.max_velocity wbc_armr6.22.acceleration wbc_armr6.22.deceleration wbc_armr6.22.KP wbc_armr6.22.KD wbc_armr6.22.enable wbc_armr6.22.operation_mode wbc_armr6.22.polarity /end REF_MEASUREMENT
/end GROUP
/begin COMPU_METHOD wbc_armr6.22.pos_fb_COMPU_METHOD "" LINEAR "%6.3" "" COEFFS_LINEAR 1 0 /end COMPU_METHOD
/begin MEASUREMENT wbc_armr6.22.pos_fb "pos_fb" FLOAT64_IEEE wbc_armr6.22.pos_fb_COMPU_METHOD 0 0 -1E12 1E12 ECU_ADDRESS 0x701F8
 /begin IF_DATA XCP
  /begin DAQ_EVENT FIXED_EVENT_LIST EVENT 0x0 /end DAQ_EVENT
 /end IF_DATA
/end MEASUREMENT
/begin COMPU_METHOD wbc_armr6.22.vel_fb_COMPU_METHOD "" LINEAR "%6.3" "" COEFFS_LINEAR 1 0 /end COMPU_METHOD
/begin MEASUREMENT wbc_armr6.22.vel_fb "vel_fb" FLOAT64_IEEE wbc_armr6.22.vel_fb_COMPU_METHOD 0 0 -1E12 1E12 ECU_ADDRESS 0x70200
 /begin IF_DATA XCP
  /begin DAQ_EVENT FIXED_EVENT_LIST EVENT 0x0 /end DAQ_EVENT
 /end IF_DATA
/end MEASUREMENT
/begin COMPU_METHOD wbc_armr6.22.torque_fb_COMPU_METHOD "" LINEAR "%6.3" "" COEFFS_LINEAR 1 0 /end COMPU_METHOD
/begin MEASUREMENT wbc_armr6.22.torque_fb "torque_fb" FLOAT64_IEEE wbc_armr6.22.torque_fb_COMPU_METHOD 0 0 -1E12 1E12 ECU_ADDRESS 0x70208
 /begin IF_DATA XCP
  /begin DAQ_EVENT FIXED_EVENT_LIST EVENT 0x0 /end DAQ_EVENT
 /end IF_DATA
/end MEASUREMENT
/begin COMPU_METHOD wbc_armr6.22.current_fb_COMPU_METHOD "" LINEAR "%6.3" "" COEFFS_LINEAR 1 0 /end COMPU_METHOD
/begin MEASUREMENT wbc_armr6.22.current_fb "current_fb" FLOAT64_IEEE wbc_armr6.22.current_fb_COMPU_METHOD 0 0 -1E12 1E12 ECU_ADDRESS 0x70210
 /begin IF_DATA XCP
  /begin DAQ_EVENT FIXED_EVENT_LIST EVENT 0x0 /end DAQ_EVENT
 /end IF_DATA
/end MEASUREMENT
/begin COMPU_METHOD wbc_armr6.22.motor_temper_COMPU_METHOD "" LINEAR "%6.3" "" COEFFS_LINEAR 1 0 /end COMPU_METHOD
/begin MEASUREMENT wbc_armr6.22.motor_temper "motor_temper" FLOAT64_IEEE wbc_armr6.22.motor_temper_COMPU_METHOD 0 0 -1E12 1E12 ECU_ADDRESS 0x70218
 /begin IF_DATA XCP
  /begin DAQ_EVENT FIXED_EVENT_LIST EVENT 0x0 /end DAQ_EVENT
 /end IF_DATA
/end MEASUREMENT
/begin COMPU_METHOD wbc_armr6.22.min_soft_position_COMPU_METHOD "" LINEAR "%6.3" "" COEFFS_LINEAR 1 0 /end COMPU_METHOD
/begin MEASUREMENT wbc_armr6.22.min_soft_position "min_soft_position_limit" FLOAT64_IEEE wbc_armr6.22.min_soft_position_COMPU_METHOD 0 0 -1E12 1E12 ECU_ADDRESS 0x70220
 /begin IF_DATA XCP
  /begin DAQ_EVENT FIXED_EVENT_LIST EVENT 0x0 /end DAQ_EVENT
 /end IF_DATA
/end MEASUREMENT
/begin COMPU_METHOD wbc_armr6.22.max_soft_position_COMPU_METHOD "" LINEAR "%6.3" "" COEFFS_LINEAR 1 0 /end COMPU_METHOD
/begin MEASUREMENT wbc_armr6.22.max_soft_position "max_soft_position_limit" FLOAT64_IEEE wbc_armr6.22.max_soft_position_COMPU_METHOD 0 0 -1E12 1E12 ECU_ADDRESS 0x70228
 /begin IF_DATA XCP
  /begin DAQ_EVENT FIXED_EVENT_LIST EVENT 0x0 /end DAQ_EVENT
 /end IF_DATA
/end MEASUREMENT
/begin COMPU_METHOD wbc_armr6.22.max_profile_veloc_COMPU_METHOD "" LINEAR "%6.3" "" COEFFS_LINEAR 1 0 /end COMPU_METHOD
/begin MEASUREMENT wbc_armr6.22.max_profile_veloc "max_profile_velocity" FLOAT64_IEEE wbc_armr6.22.max_profile_veloc_COMPU_METHOD 0 0 -1E12 1E12 ECU_ADDRESS 0x70230
 /begin IF_DATA XCP
  /begin DAQ_EVENT FIXED_EVENT_LIST EVENT 0x0 /end DAQ_EVENT
 /end IF_DATA
/end MEASUREMENT
/begin COMPU_METHOD wbc_armr6.22.voltage_COMPU_METHOD "" LINEAR "%6.3" "" COEFFS_LINEAR 1 0 /end COMPU_METHOD
/begin MEASUREMENT wbc_armr6.22.voltage "voltage" FLOAT64_IEEE wbc_armr6.22.voltage_COMPU_METHOD 0 0 -1E12 1E12 ECU_ADDRESS 0x70240
 /begin IF_DATA XCP
  /begin DAQ_EVENT FIXED_EVENT_LIST EVENT 0x0 /end DAQ_EVENT
 /end IF_DATA
/end MEASUREMENT
/begin COMPU_METHOD wbc_armr6.22.enabled_COMPU_METHOD "" LINEAR "%6.3" "" COEFFS_LINEAR 1 0 /end COMPU_METHOD
/begin MEASUREMENT wbc_armr6.22.enabled "enabled" SBYTE wbc_armr6.22.enabled_COMPU_METHOD 0 0 -128 127 ECU_ADDRESS 0x70238
 /begin IF_DATA XCP
  /begin DAQ_EVENT FIXED_EVENT_LIST EVENT 0x0 /end DAQ_EVENT
 /end IF_DATA
/end MEASUREMENT
/begin COMPU_METHOD wbc_armr6.22.error_COMPU_METHOD "" LINEAR "%6.3" "" COEFFS_LINEAR 1 0 /end COMPU_METHOD
/begin MEASUREMENT wbc_armr6.22.error "error" SBYTE wbc_armr6.22.error_COMPU_METHOD 0 0 -128 127 ECU_ADDRESS 0x70239
 /begin IF_DATA XCP
  /begin DAQ_EVENT FIXED_EVENT_LIST EVENT 0x0 /end DAQ_EVENT
 /end IF_DATA
/end MEASUREMENT
/begin COMPU_METHOD wbc_armr6.22.operation_mode_di_COMPU_METHOD "" LINEAR "%6.3" "" COEFFS_LINEAR 1 0 /end COMPU_METHOD
/begin MEASUREMENT wbc_armr6.22.operation_mode_di "operation_mode_display" SBYTE wbc_armr6.22.operation_mode_di_COMPU_METHOD 0 0 -128 127 ECU_ADDRESS 0x7023A
 /begin IF_DATA XCP
  /begin DAQ_EVENT FIXED_EVENT_LIST EVENT 0x0 /end DAQ_EVENT
 /end IF_DATA
/end MEASUREMENT
/begin GROUP joints_status.22.wbc_armr6 ""
 /begin REF_MEASUREMENT wbc_armr6.22.pos_fb wbc_armr6.22.vel_fb wbc_armr6.22.torque_fb wbc_armr6.22.current_fb wbc_armr6.22.motor_temper wbc_armr6.22.min_soft_position wbc_armr6.22.max_soft_position wbc_armr6.22.max_profile_veloc wbc_armr6.22.voltage wbc_armr6.22.enabled wbc_armr6.22.error wbc_armr6.22.operation_mode_di /end REF_MEASUREMENT
/end GROUP
/begin COMPU_METHOD wbc_armr7.23.pos_cmd_COMPU_METHOD "" LINEAR "%6.3" "" COEFFS_LINEAR 1 0 /end COMPU_METHOD
/begin MEASUREMENT wbc_armr7.23.pos_cmd "pos_cmd" FLOAT64_IEEE wbc_armr7.23.pos_cmd_COMPU_METHOD 0 0 -1E12 1E12 ECU_ADDRESS 0x71168
 /begin IF_DATA XCP
  /begin DAQ_EVENT FIXED_EVENT_LIST EVENT 0x0 /end DAQ_EVENT
 /end IF_DATA
/end MEASUREMENT
/begin COMPU_METHOD wbc_armr7.23.vel_cmd_COMPU_METHOD "" LINEAR "%6.3" "" COEFFS_LINEAR 1 0 /end COMPU_METHOD
/begin MEASUREMENT wbc_armr7.23.vel_cmd "vel_cmd" FLOAT64_IEEE wbc_armr7.23.vel_cmd_COMPU_METHOD 0 0 -1E12 1E12 ECU_ADDRESS 0x71170
 /begin IF_DATA XCP
  /begin DAQ_EVENT FIXED_EVENT_LIST EVENT 0x0 /end DAQ_EVENT
 /end IF_DATA
/end MEASUREMENT
/begin COMPU_METHOD wbc_armr7.23.torque_cmd_COMPU_METHOD "" LINEAR "%6.3" "" COEFFS_LINEAR 1 0 /end COMPU_METHOD
/begin MEASUREMENT wbc_armr7.23.torque_cmd "torque_cmd" FLOAT64_IEEE wbc_armr7.23.torque_cmd_COMPU_METHOD 0 0 -1E12 1E12 ECU_ADDRESS 0x71178
 /begin IF_DATA XCP
  /begin DAQ_EVENT FIXED_EVENT_LIST EVENT 0x0 /end DAQ_EVENT
 /end IF_DATA
/end MEASUREMENT
/begin COMPU_METHOD wbc_armr7.23.current_cmd_COMPU_METHOD "" LINEAR "%6.3" "" COEFFS_LINEAR 1 0 /end COMPU_METHOD
/begin MEASUREMENT wbc_armr7.23.current_cmd "current_cmd" FLOAT64_IEEE wbc_armr7.23.current_cmd_COMPU_METHOD 0 0 -1E12 1E12 ECU_ADDRESS 0x71180
 /begin IF_DATA XCP
  /begin DAQ_EVENT FIXED_EVENT_LIST EVENT 0x0 /end DAQ_EVENT
 /end IF_DATA
/end MEASUREMENT
/begin COMPU_METHOD wbc_armr7.23.velocity_COMPU_METHOD "" LINEAR "%6.3" "" COEFFS_LINEAR 1 0 /end COMPU_METHOD
/begin MEASUREMENT wbc_armr7.23.velocity "velocity" FLOAT64_IEEE wbc_armr7.23.velocity_COMPU_METHOD 0 0 -1E12 1E12 ECU_ADDRESS 0x71188
 /begin IF_DATA XCP
  /begin DAQ_EVENT FIXED_EVENT_LIST EVENT 0x0 /end DAQ_EVENT
 /end IF_DATA
/end MEASUREMENT
/begin COMPU_METHOD wbc_armr7.23.max_velocity_COMPU_METHOD "" LINEAR "%6.3" "" COEFFS_LINEAR 1 0 /end COMPU_METHOD
/begin MEASUREMENT wbc_armr7.23.max_velocity "max_velocity" FLOAT64_IEEE wbc_armr7.23.max_velocity_COMPU_METHOD 0 0 -1E12 1E12 ECU_ADDRESS 0x71190
 /begin IF_DATA XCP
  /begin DAQ_EVENT FIXED_EVENT_LIST EVENT 0x0 /end DAQ_EVENT
 /end IF_DATA
/end MEASUREMENT
/begin COMPU_METHOD wbc_armr7.23.acceleration_COMPU_METHOD "" LINEAR "%6.3" "" COEFFS_LINEAR 1 0 /end COMPU_METHOD
/begin MEASUREMENT wbc_armr7.23.acceleration "acceleration" FLOAT64_IEEE wbc_armr7.23.acceleration_COMPU_METHOD 0 0 -1E12 1E12 ECU_ADDRESS 0x71198
 /begin IF_DATA XCP
  /begin DAQ_EVENT FIXED_EVENT_LIST EVENT 0x0 /end DAQ_EVENT
 /end IF_DATA
/end MEASUREMENT
/begin COMPU_METHOD wbc_armr7.23.deceleration_COMPU_METHOD "" LINEAR "%6.3" "" COEFFS_LINEAR 1 0 /end COMPU_METHOD
/begin MEASUREMENT wbc_armr7.23.deceleration "deceleration" FLOAT64_IEEE wbc_armr7.23.deceleration_COMPU_METHOD 0 0 -1E12 1E12 ECU_ADDRESS 0x711A0
 /begin IF_DATA XCP
  /begin DAQ_EVENT FIXED_EVENT_LIST EVENT 0x0 /end DAQ_EVENT
 /end IF_DATA
/end MEASUREMENT
/begin COMPU_METHOD wbc_armr7.23.KP_COMPU_METHOD "" LINEAR "%6.3" "" COEFFS_LINEAR 1 0 /end COMPU_METHOD
/begin MEASUREMENT wbc_armr7.23.KP "KP" FLOAT64_IEEE wbc_armr7.23.KP_COMPU_METHOD 0 0 -1E12 1E12 ECU_ADDRESS 0x711A8
 /begin IF_DATA XCP
  /begin DAQ_EVENT FIXED_EVENT_LIST EVENT 0x0 /end DAQ_EVENT
 /end IF_DATA
/end MEASUREMENT
/begin COMPU_METHOD wbc_armr7.23.KD_COMPU_METHOD "" LINEAR "%6.3" "" COEFFS_LINEAR 1 0 /end COMPU_METHOD
/begin MEASUREMENT wbc_armr7.23.KD "KD" FLOAT64_IEEE wbc_armr7.23.KD_COMPU_METHOD 0 0 -1E12 1E12 ECU_ADDRESS 0x711B0
 /begin IF_DATA XCP
  /begin DAQ_EVENT FIXED_EVENT_LIST EVENT 0x0 /end DAQ_EVENT
 /end IF_DATA
/end MEASUREMENT
/begin COMPU_METHOD wbc_armr7.23.enable_COMPU_METHOD "" LINEAR "%6.3" "" COEFFS_LINEAR 1 0 /end COMPU_METHOD
/begin MEASUREMENT wbc_armr7.23.enable "enable" SBYTE wbc_armr7.23.enable_COMPU_METHOD 0 0 -128 127 ECU_ADDRESS 0x711B8
 /begin IF_DATA XCP
  /begin DAQ_EVENT FIXED_EVENT_LIST EVENT 0x0 /end DAQ_EVENT
 /end IF_DATA
/end MEASUREMENT
/begin COMPU_METHOD wbc_armr7.23.operation_mode_COMPU_METHOD "" LINEAR "%6.3" "" COEFFS_LINEAR 1 0 /end COMPU_METHOD
/begin MEASUREMENT wbc_armr7.23.operation_mode "operation_mode" SBYTE wbc_armr7.23.operation_mode_COMPU_METHOD 0 0 -128 127 ECU_ADDRESS 0x711B9
 /begin IF_DATA XCP
  /begin DAQ_EVENT FIXED_EVENT_LIST EVENT 0x0 /end DAQ_EVENT
 /end IF_DATA
/end MEASUREMENT
/begin COMPU_METHOD wbc_armr7.23.polarity_COMPU_METHOD "" LINEAR "%6.3" "" COEFFS_LINEAR 1 0 /end COMPU_METHOD
/begin MEASUREMENT wbc_armr7.23.polarity "polarity" UBYTE wbc_armr7.23.polarity_COMPU_METHOD 0 0 0 255 ECU_ADDRESS 0x711BA
 /begin IF_DATA XCP
  /begin DAQ_EVENT FIXED_EVENT_LIST EVENT 0x0 /end DAQ_EVENT
 /end IF_DATA
/end MEASUREMENT
/begin GROUP joints_cmd.23.wbc_armr7 ""
 /begin REF_MEASUREMENT wbc_armr7.23.pos_cmd wbc_armr7.23.vel_cmd wbc_armr7.23.torque_cmd wbc_armr7.23.current_cmd wbc_armr7.23.velocity wbc_armr7.23.max_velocity wbc_armr7.23.acceleration wbc_armr7.23.deceleration wbc_armr7.23.KP wbc_armr7.23.KD wbc_armr7.23.enable wbc_armr7.23.operation_mode wbc_armr7.23.polarity /end REF_MEASUREMENT
/end GROUP
/begin COMPU_METHOD wbc_armr7.23.pos_fb_COMPU_METHOD "" LINEAR "%6.3" "" COEFFS_LINEAR 1 0 /end COMPU_METHOD
/begin MEASUREMENT wbc_armr7.23.pos_fb "pos_fb" FLOAT64_IEEE wbc_armr7.23.pos_fb_COMPU_METHOD 0 0 -1E12 1E12 ECU_ADDRESS 0x70248
 /begin IF_DATA XCP
  /begin DAQ_EVENT FIXED_EVENT_LIST EVENT 0x0 /end DAQ_EVENT
 /end IF_DATA
/end MEASUREMENT
/begin COMPU_METHOD wbc_armr7.23.vel_fb_COMPU_METHOD "" LINEAR "%6.3" "" COEFFS_LINEAR 1 0 /end COMPU_METHOD
/begin MEASUREMENT wbc_armr7.23.vel_fb "vel_fb" FLOAT64_IEEE wbc_armr7.23.vel_fb_COMPU_METHOD 0 0 -1E12 1E12 ECU_ADDRESS 0x70250
 /begin IF_DATA XCP
  /begin DAQ_EVENT FIXED_EVENT_LIST EVENT 0x0 /end DAQ_EVENT
 /end IF_DATA
/end MEASUREMENT
/begin COMPU_METHOD wbc_armr7.23.torque_fb_COMPU_METHOD "" LINEAR "%6.3" "" COEFFS_LINEAR 1 0 /end COMPU_METHOD
/begin MEASUREMENT wbc_armr7.23.torque_fb "torque_fb" FLOAT64_IEEE wbc_armr7.23.torque_fb_COMPU_METHOD 0 0 -1E12 1E12 ECU_ADDRESS 0x70258
 /begin IF_DATA XCP
  /begin DAQ_EVENT FIXED_EVENT_LIST EVENT 0x0 /end DAQ_EVENT
 /end IF_DATA
/end MEASUREMENT
/begin COMPU_METHOD wbc_armr7.23.current_fb_COMPU_METHOD "" LINEAR "%6.3" "" COEFFS_LINEAR 1 0 /end COMPU_METHOD
/begin MEASUREMENT wbc_armr7.23.current_fb "current_fb" FLOAT64_IEEE wbc_armr7.23.current_fb_COMPU_METHOD 0 0 -1E12 1E12 ECU_ADDRESS 0x70260
 /begin IF_DATA XCP
  /begin DAQ_EVENT FIXED_EVENT_LIST EVENT 0x0 /end DAQ_EVENT
 /end IF_DATA
/end MEASUREMENT
/begin COMPU_METHOD wbc_armr7.23.motor_temper_COMPU_METHOD "" LINEAR "%6.3" "" COEFFS_LINEAR 1 0 /end COMPU_METHOD
/begin MEASUREMENT wbc_armr7.23.motor_temper "motor_temper" FLOAT64_IEEE wbc_armr7.23.motor_temper_COMPU_METHOD 0 0 -1E12 1E12 ECU_ADDRESS 0x70268
 /begin IF_DATA XCP
  /begin DAQ_EVENT FIXED_EVENT_LIST EVENT 0x0 /end DAQ_EVENT
 /end IF_DATA
/end MEASUREMENT
/begin COMPU_METHOD wbc_armr7.23.min_soft_position_COMPU_METHOD "" LINEAR "%6.3" "" COEFFS_LINEAR 1 0 /end COMPU_METHOD
/begin MEASUREMENT wbc_armr7.23.min_soft_position "min_soft_position_limit" FLOAT64_IEEE wbc_armr7.23.min_soft_position_COMPU_METHOD 0 0 -1E12 1E12 ECU_ADDRESS 0x70270
 /begin IF_DATA XCP
  /begin DAQ_EVENT FIXED_EVENT_LIST EVENT 0x0 /end DAQ_EVENT
 /end IF_DATA
/end MEASUREMENT
/begin COMPU_METHOD wbc_armr7.23.max_soft_position_COMPU_METHOD "" LINEAR "%6.3" "" COEFFS_LINEAR 1 0 /end COMPU_METHOD
/begin MEASUREMENT wbc_armr7.23.max_soft_position "max_soft_position_limit" FLOAT64_IEEE wbc_armr7.23.max_soft_position_COMPU_METHOD 0 0 -1E12 1E12 ECU_ADDRESS 0x70278
 /begin IF_DATA XCP
  /begin DAQ_EVENT FIXED_EVENT_LIST EVENT 0x0 /end DAQ_EVENT
 /end IF_DATA
/end MEASUREMENT
/begin COMPU_METHOD wbc_armr7.23.max_profile_veloc_COMPU_METHOD "" LINEAR "%6.3" "" COEFFS_LINEAR 1 0 /end COMPU_METHOD
/begin MEASUREMENT wbc_armr7.23.max_profile_veloc "max_profile_velocity" FLOAT64_IEEE wbc_armr7.23.max_profile_veloc_COMPU_METHOD 0 0 -1E12 1E12 ECU_ADDRESS 0x70280
 /begin IF_DATA XCP
  /begin DAQ_EVENT FIXED_EVENT_LIST EVENT 0x0 /end DAQ_EVENT
 /end IF_DATA
/end MEASUREMENT
/begin COMPU_METHOD wbc_armr7.23.voltage_COMPU_METHOD "" LINEAR "%6.3" "" COEFFS_LINEAR 1 0 /end COMPU_METHOD
/begin MEASUREMENT wbc_armr7.23.voltage "voltage" FLOAT64_IEEE wbc_armr7.23.voltage_COMPU_METHOD 0 0 -1E12 1E12 ECU_ADDRESS 0x70290
 /begin IF_DATA XCP
  /begin DAQ_EVENT FIXED_EVENT_LIST EVENT 0x0 /end DAQ_EVENT
 /end IF_DATA
/end MEASUREMENT
/begin COMPU_METHOD wbc_armr7.23.enabled_COMPU_METHOD "" LINEAR "%6.3" "" COEFFS_LINEAR 1 0 /end COMPU_METHOD
/begin MEASUREMENT wbc_armr7.23.enabled "enabled" SBYTE wbc_armr7.23.enabled_COMPU_METHOD 0 0 -128 127 ECU_ADDRESS 0x70288
 /begin IF_DATA XCP
  /begin DAQ_EVENT FIXED_EVENT_LIST EVENT 0x0 /end DAQ_EVENT
 /end IF_DATA
/end MEASUREMENT
/begin COMPU_METHOD wbc_armr7.23.error_COMPU_METHOD "" LINEAR "%6.3" "" COEFFS_LINEAR 1 0 /end COMPU_METHOD
/begin MEASUREMENT wbc_armr7.23.error "error" SBYTE wbc_armr7.23.error_COMPU_METHOD 0 0 -128 127 ECU_ADDRESS 0x70289
 /begin IF_DATA XCP
  /begin DAQ_EVENT FIXED_EVENT_LIST EVENT 0x0 /end DAQ_EVENT
 /end IF_DATA
/end MEASUREMENT
/begin COMPU_METHOD wbc_armr7.23.operation_mode_di_COMPU_METHOD "" LINEAR "%6.3" "" COEFFS_LINEAR 1 0 /end COMPU_METHOD
/begin MEASUREMENT wbc_armr7.23.operation_mode_di "operation_mode_display" SBYTE wbc_armr7.23.operation_mode_di_COMPU_METHOD 0 0 -128 127 ECU_ADDRESS 0x7028A
 /begin IF_DATA XCP
  /begin DAQ_EVENT FIXED_EVENT_LIST EVENT 0x0 /end DAQ_EVENT
 /end IF_DATA
/end MEASUREMENT
/begin GROUP joints_status.23.wbc_armr7 ""
 /begin REF_MEASUREMENT wbc_armr7.23.pos_fb wbc_armr7.23.vel_fb wbc_armr7.23.torque_fb wbc_armr7.23.current_fb wbc_armr7.23.motor_temper wbc_armr7.23.min_soft_position wbc_armr7.23.max_soft_position wbc_armr7.23.max_profile_veloc wbc_armr7.23.voltage wbc_armr7.23.enabled wbc_armr7.23.error wbc_armr7.23.operation_mode_di /end REF_MEASUREMENT
/end GROUP
/begin CHARACTERISTIC gDebugLevel "Console output verbosity" VALUE 0x471C93B0 R_SLONG 0 NO_COMPU_METHOD 0 100 PHYS_UNIT "" /end CHARACTERISTIC
/end MODULE
/end PROJECT
